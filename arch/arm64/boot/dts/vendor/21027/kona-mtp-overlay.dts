/dts-v1/;
/plugin/;

#include <dt-bindings/clock/qcom,gcc-kona.h>
#include <dt-bindings/clock/qcom,camcc-kona.h>
#include <dt-bindings/clock/qcom,rpmh.h>
#include <dt-bindings/interrupt-controller/arm-gic.h>

#include "kona-mtp.dtsi"

/ {
	model = "Qualcomm Technologies, Inc. kona MTP";
	compatible = "qcom,kona-mtp", "qcom,kona", "qcom,mtp";
	qcom,board-id = <0x10008 0>;
	oplus,dtsi_no = <21027>;
};

&soc {
	wireless_chg_hall1 {
		compatible = "oplus,simulated_hall";
		hall-id = <1>;
		pinctrl-names = "wireless_chg_hall1_active" , "wireless_chg_hall1_sleep";

		pinctrl-0 = <&wireless_chg_hall1_active>;
		pinctrl-1 = <&wireless_chg_hall1_sleep>;

		interrupt-parent = <&tlmm>;
		interrupts = <113 0x2003>;      //both rising and falling edge
		irq-gpio = <&tlmm 113 0x2003>;
		optional-handle-type = <1>;
		irq_active_low;
	};

	wireless_chg_hall2 {
		compatible = "oplus,simulated_hall";
		hall-id = <2>;
		pinctrl-names = "wireless_chg_hall2_active" , "wireless_chg_hall2_sleep";

		pinctrl-0 = <&wireless_chg_hall2_active>;
		pinctrl-1 = <&wireless_chg_hall2_sleep>;

		interrupt-parent = <&tlmm>;
		interrupts = <129 0x2003>;      //both rising and falling edge
		irq-gpio = <&tlmm 129 0x2003>;
		optional-handle-type = <1>;
		irq_active_low;
	};
};