
&soc {
	oplus,audio-drv {
		compatible = "oplus,asoc-audio";
		//for nxp speaker
		oplus,speaker-vendor = "nxp";
		oplus,speaker-i2s-id = <0>;
		oplus,speaker-codec-name = "tfa98xx.2-0035", "tfa98xx.2-0034", "tfa98xx.2-0037", "tfa98xx.2-0036";
		oplus,speaker-codec-dai-name = "tfa98xx-aif-2-35", "tfa98xx-aif-2-34", "tfa98xx-aif-2-37", "tfa98xx-aif-2-36";
		/*#ifdef OPLUS_ARCH_EXTENDS*/
		/* 0-default mi2s port id flag, 1-tdm port id flag, */
		oplus,speaker-tdm-port-id-flag = <1>;
		/*#endif OPLUS_ARCH_EXTENDS*/
	};
};
