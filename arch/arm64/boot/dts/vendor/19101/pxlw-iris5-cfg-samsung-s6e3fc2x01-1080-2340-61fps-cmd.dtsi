/*Fullchip dtype, last, wait, ip, opt, dlen sys*/
&dsi_oplus19125samsung_s6e3fc2x01_1080_2340_cmd {
 mdss_iris_cfg_oplus19125samsung_s6e3fc2x01_1080_2340_cmd: pxlw,mdss_iris_cfg_oplus19125samsung_s6e3fc2x01_1080_2340_cmd {

  pxlw,panel-type = "PANEL_OLED";
  /*low power control: dynamic power gating, ulps low power, analog bypass */
  pxlw,low-power = [00 01 01];
  pxlw,chip-ver = <0x6935>;
  pxlw,pkt-payload-size = <228>;
  pxlw,last-for-per-pkt = <0>;
  pxlw,min-color-temp = <2500>;
  pxlw,max-color-temp = <10000>;
  pxlw,iris-memc-hres = <720>;
  pxlw,iris-memc-vres = <1280>;
  /* TODO: default use 6.5bpp, 0x68 */
  pxlw,iris-memc-dsc-bpp = <0x68>;
  //pxlw,iris-memc-dsc-bpp = <0x80>;
  /* 0: DSI_VIDEO_MODE, 1: DSI_CMD_MODE */
  pxlw,iris-tx-mode = /bits/ 8 <1>;
  pxlw,panel-dimming-brightness = <4095>;
  //pxlw,panel-hbm = [28 e8];
  pxlw,panel-te = <60>;
  pxlw,ap-te = <60>;

  pxlw,iris-lightup-sequence-pre0 = [
    /*sys*/
    00  a0  00
    00  00  00
  ];


  pxlw,iris-lightup-sequence-pre1 = [
    /*sys*/
    00  a0  00
    00  00  00
  ];
  pxlw,iris-lightup-sequence-cont-splash = [

    /* rx ctrl */
    01  f0  00
    /* tx */
    02  01  00
    02  00  00
    /* dtg */
    05  00  00
    05  f0  00
    /*dport*/
    04  f0  00
    04  80  00

    /*pwil*/
    03  00  00
    03  01  00
    03  02  00
    03  03  00
    03  04  00
    03  80  00

    23  00  00
    23  80  00

    /* dsc decoder */
    07  fa  01
    07  8a  01
    /* dsc encoder */
    08  fa  01
    08  8a  00
  ];
  pxlw,iris-lightup-sequence = [
    /* rx ctrl */
    01  f0  01
    /*rx author*/
    21  f1  01
    21  f0  01
    /*tx*/
    02  01  01
    02  00  00
    /*dtg*/
    05  00  00
    05  f0  00
    /* blc_pwm */
    06  f0  01
    06  00  01
    /* hdr init */
    09  70  01
    /*lut*/
    80  00  01
    80  01  01
    80  f1  00
    81  00  01
    81  01  01
    81  02  01
    86  00  00
    83  00  01
    8a  00  01
    89  00  00
    82  04  01
    82  14  01
    82  24  01
    82  34  01
    82  44  01
    82  54  01
    82  64  01
    82  74  00
    82  84  00
    84  00  01
    85  00  01
    /*DMA */
    11  f1  01
    /*dport*/
    04  f0  01
    04  80  01
    /*pwil*/
    03  f0  01
    03  f1  01
    03  f2  01
    03  f3  01
    03  f4  01
    03  20  01
    03  a0  01
    03  b0  01
    03  c0  01
    03  d0  01
    03  40  01
    03  80  01
    /*pwil_v6*/
    23  f0  01
    /*blending*/
    2e  f0  01
    /*peaking*/
    0c  f0  01
    0c  a0  01
    0c  80  01
    /*dpp*/
    0e  f0  01
    0e  f1  01
    0e  a0  01
    0e  80  01
    /*hdr*/
    09  a0  01
    09  80  01
    /*cm*/
    0a  f0  01
    0a  a0  01
    0a  80  01
    /*lce*/
    0d  f0  01
    0d  a0  01
    0d  80  01
    0d  70  01
    0d  71  01
    /* scaler1d */
    0b  f0  01
    0b  a0  01
    /* scaler1d pp */
    2f  f0  01
    /* dbc */
    0f  f0  01
    0f  a0  01
    0f  70  01
    /*psr mif*/
    2d  f0  01
    /* dsc decoder */
    07  f0  00
    07  a0  00
    07  80  00
    /*dsc aux*/
    37  f0  00
    /* dsc encoder */
    08  f0  00
    /* dsc decoder 2 */
    25  f0  01
    25  f1  01
    /* dsc encoder 2 */
    24  f0  01
    24  f1  01
    /* osd_comp */
    2a  f0  01
    2b  f0  01
    /* pq configure */
    /* peaking */
    0c  00  01
    0c  11  01
    /* cm */
    0a  00  01
    0a  10  01
    0a  b0  01
    0a  b1  01
    0a  b2  01
    0a  b3  01
    0a  b4  01
    0a  b5  01
    0a  40  01
    0a  fb  01
    /* lce */
    0d  00  01
    0d  10  01
    0d  fd  01
    /* dbc */
    0f  00  01
    0f  fc  01
    /* dpp */
    0e  00  01
    0e  fd  01
    0e  fc  01
    0e  40  01
    0e  50  01
    /* pwil */
    03  61  01
    03  95  01
    03  51  01
    03  23  01
    /*hdr*/
    09  00  01
    09  93  01
    /*DMA*/
    11  e1  00
    /* manual power */
    00  f0  00
    00  07  00
  ];


  pxlw,iris-pq-default-val = [
    /* peaking */
    0c  00
    0c  11
    /* cm */
    0a  00
    0a  10
    0a  b0
    0a  b1
    0a  b2
    0a  b3
    0a  b4
    0a  b5
    0a  40
    0a  fb
    /* lce */
    0d  00
    0d  10
    0d  fd
    0d  a0
    /* dbc */
    0f  00
    0f  fc
    /* dpp */
    0e  00
    0e  40
    0e  fc
    0e  fd
    0e  50
    /* pwil */
    03  f1
    03  f2
    03  f4
    03  23
    03  a0
    03  b0
    03  c0
    03  d0
    03  40
    03  80
    03  61
    03  95
    03  51
    /*hdr*/
    09  00
    09  93
    /*blc_pwm*/
    06  00
    /* lut */
    80  00
    80  01
    80  f1
    81  00
    81  01
    81  02
    86  00
    83  00
    8a  00
    89  00
    82  04
    82  14
    82  24
    82  34
    82  44
    82  54
    82  64
    82  74
    82  84
    84  00
    85  00
    /*DMA */
    11  f1
    /*MIPI_TX*/
    02  e0
    /*DTG*/
    05  00
    05  f0
    /*DPORT*/
    04  f0
    04  80
  ];


  pxlw,iris-cmd-list =
  <
    // version: v0.64.1 build: 08-23-2019 16:05
    // mipi_rx: dphy
    0x29 0x01 0x00 0x01 0x01F1 0x09 0xFFFFFFF4
                                    0xF1800808 0x10020200 0xF1800818 0x00000007 0xF1800A00 0x00000060
                                    0xF1800A08 0x000004F7

    // mipi_rx: ctrl
    0x29 0x01 0x00 0x01 0x00F0 0x11 0xFFFFFFF4
                                    0xF1800238 0x00770000 0xF1800300 0x04370000 0xF1800304 0x09230000
                                    0xF1801804 0x00000780 0xF1800104 0x00000000 0xF1800144 0x001E0438
                                    0xF1800148 0x00000438 0xF1800080 0x00000100

    // mipi_rx: enter TTL bypass
    0x29 0x01 0x00 0x01 0x00D0 0x03 0xFFFFFFF4
                                    0xF1800010 0x00200317

    // mipi_rx: exit TTL bypass
    0x29 0x01 0x00 0x01 0x00D1 0x03 0xFFFFFFF4
                                    0xF1800010 0x00200217

    // mipi: abyp
    0x29 0x01 0x00 0x01 0x00E0 0x23 0x0001000C 0xF1311E10
                                    0x10020200 0x00000007 0x00000060 0x000004F7 0x00770000 0x04370000
                                    0x09230000 0x00000780 0x00000000 0x001E0438 0x00000438 0x00000100
                                    0x00000060 0x00410304 0x0000027F 0x3F030007 0x260A250A 0x260A2409
                                    0x00000201 0x034E0100 0x0088B800 0x00FFFFFF 0x0A8C0780 0x00CB40C4
                                    0x00000018 0x001E0438 0x00000438 0x04370000 0x09230000 0x00000071
                                    0x056F0438 0xC201C139 0x00200317

    // sys: a0: init 0
    0x29 0x01 0x01 0x00 0x00A0 0x15 0xFFFFFFF4
                                    0xF0000004 0x002A82A5 0xF0000008 0x0010F010 0xF0000020 0x002A80B7
                                    0xF0000024 0x0000F012 0xF0000000 0x00000051 0xF0000000 0x00000052
                                    0xF0000000 0x00000050 0xF000001C 0x00000081 0xF000001C 0x00000082
                                    0xF000001C 0x00000080

    // sys: misc
    0x29 0x01 0x00 0x00 0x0000 0x13 0xFFFFFFF4
                                    0xF000004C 0x02108460 0xF0000048 0x00005320 0xF00000E0 0x00008180
                                    0xF00000E4 0x0000D400 0xF0000060 0x0F1BC3FE 0xF00000C0 0x000001D5
                                    0xF00000C4 0x000009EF 0xF0000088 0x00000020 0xF00000F4 0x00330640

    // sys: abyp: enter
    0x29 0x01 0x00 0x00 0x0104 0x05 0xFFFFFFF4
                                    0xF00000EC 0x00000002 0xF00000EC 0x00000000

    // sys: abyp: exit
    0x29 0x01 0x00 0x00 0x0105 0x05 0xFFFFFFF4
                                    0xF00000EC 0x00000001 0xF00000EC 0x00000000

    // sys: abyp: lp enter
    0x29 0x01 0x00 0x00 0x0008 0x07 0xFFFFFFF4
                                    0xF0000060 0x4F9BC144 0xF00000EC 0x00000002 0xF00000EC 0x00000000

    // sys: pad select bitmask
    0x29 0x01 0x00 0x00 0x0006 0x03 0xFFFFFFF4
                                    0xF00000E8 0x00000000

    // sys: mem repair bitmask
    0x29 0x01 0x00 0x00 0x0007 0x03 0xFFFFFFF4
                                    0xF00000F4 0x00000640

    // sys: efuse for video abyp
    0x29 0x01 0x00 0x00 0x0010 0x05 0xFFFFFFF4
                                    0xF0010004 0xA0F000C0 0xF0010008 0x80000000

    // dtg: init
    0x29 0x01 0x00 0x05 0x0000 0x030 0x00000000 0xF1200000
                                    0x00000010 0x00000050 0x00000438 0x0000003C 0x00000002 0x00000014
                                    0x00000924 0x00000010 0xA0914A53 0x80000921 0x80000921 0x00000004
                                    0x000008D7 0x00000000 0x00000000 0x00000000 0x000008C3 0x002BBD2B
                                    0x00000000 0x00001334 0x00001334 0x000004D4 0x00000000 0x002D92AA
                                    0x00000000 0x00000000 0x0005B255 0x00000000 0x10000101 0x00010001
                                    0x80000921 0x002B2514 0x002B2514 0x000004D4 0x00000000 0x00000000
                                    0x002D92AA 0x002D3583 0x00000000 0x00000005 0x0000011A 0x00000101
                                    0x0025C3F8 0x00000000 0x00000000 0x00000005

    // dtg: init 2nd timing
    0x29 0x01 0x00 0x05 0x0001 0x30 0x00000000 0xF1200000
                                    0x00000010 0x00000050 0x00000438 0x0000003C 0x00000002 0x00000014
                                    0x00000924 0x00000010 0xA0914A53 0x80000921 0x80000921 0x00000004
                                    0x000008D7 0x00000000 0x00000000 0x00000000 0x000008C3 0x002BBD2B
                                    0x00000000 0x00001334 0x00001334 0x000004D4 0x00000000 0x002D92AA
                                    0x00000000 0x00000000 0x0005B255 0x00000000 0x10000101 0x00010001
                                    0x80000921 0x002B2514 0x002B2514 0x000004D4 0x00000000 0x00000000
                                    0x002D92AA 0x002D3583 0x00000000 0x00000005 0x0000011A 0x00000101
                                    0x0025C3F8 0x00000000 0x00000000 0x00000005

    // dtg: update
    0x29 0x01 0x00 0x05 0x00F0 0x03 0xFFFFFFF4
                                    0xF1210000 0x0000000F

    // mipi_tx: init
    0x29 0x01 0x00 0x02 0x0000 0x23 0xFFFFFFF4
                                    0xF1880050 0x3F030007 0xF1880054 0x260A250A 0xF1880058 0x260A2409
                                    0xF1880004 0x00000201 0xF1880020 0x034E0100 0xF188002C 0x0088B800
                                    0xF1880030 0x00FFFFFF 0xF1880034 0x0A8C0780 0xF1880038 0x00CB40C4
                                    0xF1880044 0x00000018 0xF1880010 0x001E0438 0xF1880014 0x00000438
                                    0xF1880018 0x04370000 0xF188001C 0x09230000 0xF1880008 0x00000071
                                    0xF188000C 0x056F0438 0xF1880000 0xC201C139

    // mipi_tx: dphy
    0x29 0x01 0x00 0x02 0x0001 0x07 0xFFFFFFF4
                                    0xF18C0200 0x00000060 0xF18C0004 0x00410304 0xF18C0210 0x0000027F

    // dport: init
    0x29 0x01 0x00 0x04 0x00F0 0x009 0x0001000C 0xF1311558
                                    0xE0008007 0x21000803 0x49240438 0x46000800 0x06081802 0x00040100
                                    0x00000000

    // dport: update
    0x29 0x01 0x00 0x04 0x0080 0x003 0x0001000C 0xF1311574
                                    0x00000001

    // hdr: 0
    0x29 0x01 0x00 0x09 0x0000 0x5E 0x0001000C 0xF1310FB8
                                    0x0000016D 0x0FFF0000 0x0FFF0000 0x04E80273 0x0000075C 0x099804CB
                                    0x00000E65 0x0FFF082E 0x0FFF082E 0x099904CC 0x00000E66 0x00140A02
                                    0x00000000 0x000000C8 0x00002828 0x00002828 0x02220028 0x02220028
                                    0x04380924 0x0000006A 0x00000100 0x00000020 0x00000000 0x092C030D
                                    0x0FFF0DC4 0x1E061E06 0x1E061E06 0x00000008 0x018C0049 0x0000001E
                                    0x01750000 0x000E0151 0x00000002 0x00000000 0x00000000 0x00000000
                                    0x00000009 0x056D7E29 0x7FD77E8F 0x02000079 0x021A0200 0x00007F71
                                    0x00000000 0x00000000 0x00000000 0x00000000 0x00000000 0x00000000
                                    0x00000000 0x00000000 0x00000000 0x00000000 0x00000000 0x00000000
                                    0x00000000 0x00000000 0x00000000 0x00000000 0x00000000 0x00000000
                                    0x00000000 0x00000000 0x00000000 0x00000000 0x00000000 0x00000000
                                    0x00000000 0x00000000 0x00000000 0x00000000 0x00000000 0x00000000
                                    0x0015EB43 0x002FAED1 0x000FB947 0x00408040 0x00000000 0x00000003
                                    0x1D0E3617 0x00140000 0x0007FFFF 0x00140000 0x00040000 0x00000000
                                    0x00000000 0x00000000 0x00000000 0x00000000 0x00000000 0x07940708
                                    0x00000000 0x01100001

    // hdr: 2
    0x29 0x01 0x00 0x09 0x0002 0x5E 0x0001000C 0xF1310FB8
                                    0x0000006D 0x0FFF0000 0x0FFF0000 0x04E80273 0x0000075C 0x099804CB
                                    0x00000E65 0x0FFF082E 0x0FFF082E 0x099904CC 0x00000E66 0x00140A02
                                    0x00000000 0x000000C8 0x00002828 0x00002828 0x02220028 0x02220028
                                    0x04380924 0x0000006A 0x00000100 0x00000020 0x00000000 0x092C030D
                                    0x0FFF0DC4 0x1E061E06 0x1E061E06 0x00000008 0x018C0049 0x0000001E
                                    0x01750000 0x000E0151 0x00000002 0x00000000 0x00000000 0x00000000
                                    0x00000009 0x056D7C52 0x7FAE7D1E 0x04000079 0x021A0400 0x00007EE2
                                    0x00000000 0x00000000 0x00000000 0x00000000 0x00000000 0x00000000
                                    0x00000000 0x00000000 0x00000000 0x00000000 0x00000000 0x00000000
                                    0x00000000 0x00000000 0x00000000 0x00000000 0x00000000 0x00000000
                                    0x00000000 0x00000000 0x00000000 0x00000000 0x00000000 0x00000000
                                    0x00000000 0x00000000 0x00000000 0x00000000 0x00000000 0x00000000
                                    0x0015EB43 0x002FAED1 0x000FB947 0x00408040 0x00000000 0x00000003
                                    0x1D0E3617 0x00140000 0x0007FFFF 0x00140000 0x00040000 0x00000000
                                    0x00000000 0x00000000 0x00000000 0x00000000 0x00000000 0x07940708
                                    0x00000000 0x01100001

    // hdr: 5
    0x29 0x01 0x00 0x09 0x0005 0x5E 0x0001000C 0xF1310FB8
                                    0x00001028 0x0FFF0000 0x0FFF0000 0x058F0124 0x00000804 0x0AE0023C
                                    0x00000FAD 0x00000011 0x0FFF082E 0x026600CC 0x002800CC 0x10080C06
                                    0x20CC0F33 0x000AFFFF 0x00006461 0x00006461 0x00A30064 0x00A30064
                                    0x04380924 0x0000006A 0x0000020B 0x00000020 0x00000000 0x092C030D
                                    0x0FFF0DC4 0x1E061E06 0x1E061E06 0x00000008 0x01790087 0x00120024
                                    0x016F0005 0x001C0101 0x00000007 0x00000000 0x00000000 0x00000000
                                    0x00000009 0x056D7C52 0x7FAE7D1E 0x04000079 0x021A0400 0x00007EE2
                                    0x00000000 0x00000000 0x00000000 0x00000000 0x00000000 0x00000000
                                    0x00000000 0x00000000 0x00000000 0x00000000 0x00000000 0x00000000
                                    0x00000000 0x00000000 0x00000000 0x00000000 0x00000000 0x00000000
                                    0x00000000 0x00000000 0x00000000 0x00000000 0x00000000 0x00000000
                                    0x00000000 0x00000000 0x00000000 0x00000000 0x00000000 0x00000000
                                    0x0020E04A 0x003C9FC4 0x0017AF51 0x00408040 0x00000000 0x00000000
                                    0x1C1C044E 0x00140000 0x0007FFFF 0x00140000 0x00040000 0x00000000
                                    0x00000000 0x0003FFFF 0x0003FFFF 0x00000000 0x00000000 0x07940708
                                    0x00000000 0x01400001

    // hdr: 9
    0x29 0x01 0x00 0x09 0x0009 0x5E 0x0001000C 0xF1310FB8
                                    0x0000006D 0x0FFF0000 0x0FFF0000 0x04E80273 0x0000075C 0x099804CB
                                    0x00000E65 0x0FFF082E 0x0FFF082E 0x099904CC 0x00000E66 0x00140A02
                                    0x00000000 0x000000C8 0x00002828 0x00002828 0x02220028 0x02220028
                                    0x04380924 0x0000006A 0x00000100 0x00000020 0x00000000 0x092C030D
                                    0x0FFF0DC4 0x1E061E06 0x1E061E06 0x00000008 0x018C0049 0x0000001E
                                    0x01750000 0x000E0151 0x00000002 0x00000000 0x00000000 0x00000000
                                    0x00000009 0x056D7C52 0x7FAE7D1E 0x04000079 0x021A0400 0x00007EE2
                                    0x00000000 0x00000000 0x00000000 0x00000004 0x08000800 0x00000800
                                    0x0F0D7EAF 0x7B6E0BCC 0x00000000 0x00000000 0x00000000 0x00000000
                                    0x00000008 0x056D7C52 0x7FAE7D1E 0x04000079 0x021A0400 0x00007EE2
                                    0x00040000 0x00000000 0x00040000 0x00000000 0x00000000 0x00000000
                                    0x00000000 0x00000000 0x00000000 0x00000000 0x00000000 0x00000000
                                    0x0015EB43 0x002FAED1 0x000FB947 0x00408040 0x00000000 0x00000003
                                    0x110A3617 0x00140000 0x0007FFFF 0x00140001 0x00040000 0x00000000
                                    0x00000000 0x00000000 0x00000000 0x00000001 0x00000001 0x07940708
                                    0x00000000 0x01100001

    // hdr: c
    0x29 0x01 0x00 0x09 0x000C 0x5E 0x0001000C 0xF1310FB8
                                    0x00001028 0x0FFF0000 0x0FFF0000 0x058F0124 0x00000804 0x0AE0023C
                                    0x00000FAD 0x00000011 0x0FFF082E 0x026600CC 0x002800CC 0x10080C06
                                    0x20CC0F33 0x000AFFFF 0x00006461 0x00006461 0x00A30064 0x00A30064
                                    0x04380924 0x0000006A 0x0000020B 0x00000020 0x00000000 0x092C030D
                                    0x0FFF0DC4 0x1E061E06 0x1E061E06 0x00000008 0x01790087 0x00120024
                                    0x016F0005 0x001C0101 0x00000007 0x00000000 0x00000000 0x00000000
                                    0x00000009 0x056D7C52 0x7FAE7D1E 0x04000079 0x021A0400 0x00007EE2
                                    0x00000000 0x00000000 0x00000000 0x00000004 0x08000800 0x00000800
                                    0x0E2D7D3F 0x7A490B37 0x00000000 0x00000000 0x00000000 0x00000000
                                    0x00000008 0x04B27CA7 0x7F597D5A 0x040000E9 0x02640400 0x00007EA6
                                    0x00040000 0x00000000 0x00040000 0x00000000 0x00000000 0x00000000
                                    0x00000000 0x00000000 0x00000000 0x00000000 0x00000000 0x00000000
                                    0x0020E04A 0x003C9FC4 0x0017AF51 0x00408040 0x00000000 0x00000000
                                    0x1018044E 0x00140000 0x0007FFFF 0x00140000 0x00040000 0x00000000
                                    0x00000000 0x0003FFFF 0x0003FFFF 0x00000001 0x00000001 0x07940708
                                    0x00000000 0x01400001

    // hdr: lut inv_u
    0x29 0x01 0x00 0x09 0x00FE 0x002 0x0001000C 0xF1311128
                                    

    // hdr: lut inv_v
    0x29 0x01 0x00 0x09 0x00FD 0x002 0x0001000C 0xF1311328
                                    

    // hdr: gc
    0x29 0x01 0x00 0x09 0x00A0 0x003 0x0001000C 0xF1311528
                                    0x00000800

    // hdr: update
    0x29 0x01 0x00 0x09 0x0080 0x003 0x0001000C 0xF1311554
                                    0x00000002

    // hdr: Y5P ctrl
    0x29 0x01 0x00 0x09 0x0090 0x03 0x0001000C 0xF1311124
                                    0x01400001

    // hdr: lut2 ctrl
    0x29 0x01 0x00 0x09 0x0091 0x03 0x0001000C 0xF13110FC
                                    0x00140000

    // hdr: luty ctrl
    0x29 0x01 0x00 0x09 0x0092 0x03 0x0001000C 0xF131100C
                                    0x00000020

    // hdr: resolution
    0x29 0x01 0x00 0x09 0x0093 0x04 0x0001000C 0xF1311000
                                    0x04380924 0x0000006A

    // hdr: ext 0
    0x29 0x00 0x00 0x09 0x0070 0x003 0x00000000 0xF12D0028
                                    0x10000000

    // hdr: ext 1
    0x29 0x01 0x00 0x09 0x0070 0x00B 0x00000000 0xF12D0004
                                    0x1F7115F4 0x0AAA27E8 0x00000000 0x061E0294 0x0FFE0F80 0x061E0294
                                    0x0FFE0F80 0x061E0294 0x0FFE0F80

    // hdr: ext - dma
    0x29 0x01 0x00 0x09 0x0070 0x00C 0x0001000C 0xF131152C
                                    0x1F7115F4 0x0AAA27E8 0x00000000 0x061E0294 0x0FFE0F80 0x061E0294
                                    0x0FFE0F80 0x061E0294 0x0FFE0F80 0x10000000

    // pwil: ctrl 0
    0x29 0x01 0x00 0x03 0x00F0 0x00B 0x0001000C 0xF1310608
                                    0xA0E82014 0x00C8B794 0x38820060 0x50000012 0x09240438 0x00000000
                                    0x04380438 0x04380438 0x00000080

    // pwil: ctrl 1
    0x29 0x01 0x00 0x03 0x00F1 0x006 0x0001000C 0xF1310608
                                    0xA0E82014 0x00C8B794 0x38820060 0x50000012

    // pwil: csc-0 (hdr)
    0x29 0x01 0x00 0x03 0x0090 0x0B 0x0001000C 0xF1310630
                                    0x0000001D 0x09510951 0x00000951 0x11227E80 0x7ACC0D6E 0x00000000
                                    0x00000000 0x00000000 0x00000000

    // pwil: csc-1 (hdr)
    0x29 0x01 0x00 0x03 0x0091 0x0B 0x0001000C 0xF1310630
                                    0x0000001D 0x095A095A 0x0014095A 0x051F7FEC 0x7EFC0104 0x00007D12
                                    0x00000000 0x00000000 0x00000000

    // pwil: csc-2 (hdr)
    0x29 0x01 0x00 0x03 0x0092 0x0B 0x0001000C 0xF1310630
                                    0x0000001D 0x095A0000 0x00000000 0x09250000 0x00000925 0x00000000
                                    0x00002000 0x00000000 0x00002000

    // pwil: csc-3 (hdr)
    0x29 0x01 0x00 0x03 0x0093 0x0B 0x0001000C 0xF1310630
                                    0x0000000F 0x0951094E 0x7FFE094E 0x10E47E4C 0x7BBD0E56 0x00000000
                                    0x00000000 0x00000000 0x00000000

    // pwil: csc-4 (hdr)
    0x29 0x01 0x00 0x03 0x0094 0x0B 0x0001000C 0xF1310630
                                    0x00000011 0x09DC773A 0x090B04A8 0x13777E3B 0x013A090B 0x00007132
                                    0x000FFB58 0x000FFB58 0x000FFB58

    // pwil: csc-5 (frc)
    0x29 0x01 0x00 0x03 0x0095 0x0B 0x0001000C 0xF1310630
                                    0x00000011 0x04B27CA7 0x7F597D5A 0x040000E9 0x02640400 0x00007EA6
                                    0x00002000 0x00000000 0x00002000

    // pwil: dpcd
    0x29 0x01 0x00 0x03 0x00F4 0x00C 0x0001000C 0xF1310654
                                    0x00000000 0x00010000 0x00000200 0x00010001 0x00010001 0x000002D0
                                    0x00000200 0x000004FC 0x00000000 0x05000000

    // pwil: piad_info
    0x29 0x01 0x00 0x03 0x0020 0x004 0x0001000C 0xF131067C
                                    0x05000008 0x00000062

    // pwil: ctrl graphic
    0x29 0x01 0x00 0x03 0x00A0 0x00C 0x0001000C 0xF1310684
                                    0xE4100010 0x00010888 0x00000000 0x09240438 0x09240438 0x00000087
                                    0x000B1000 0x00000000 0x09240438 0x09240438

    // pwil: channel-order-0
    0x29 0x01 0x00 0x03 0x0060 0x03 0x0001000C 0xF1310684
                                    0xC9110010

    // pwil: channel-order-1
    0x29 0x01 0x00 0x03 0x0061 0x03 0x0001000C 0xF1310684
                                    0xE4100010

    // pwil: channel-order-2
    0x29 0x01 0x00 0x03 0x0062 0x03 0x0001000C 0xF1310684
                                    0xE4100010

    // pwil: video
    0x29 0x01 0x00 0x03 0x00B0 0x00D 0x0001000C 0xF13106AC
                                    0xE4100030 0x00010888 0x92061B09 0x00000000 0x09240438 0x09240438
                                    0x0000004A 0x000B1000 0x00000000 0x09240438 0x050002D0

    // pwil: cursor
    0x29 0x01 0x00 0x03 0x00C0 0x00D 0x0001000C 0xF13106D8
                                    0xE4D00010 0x00000888 0x00000000 0x09240438 0x09240438 0x00000010
                                    0x00040000 0x00000000 0x00000000 0x00000000 0x09240438

    // pwil: disp
    0x29 0x01 0x00 0x03 0x00D0 0x009 0x0001000C 0xF1310704
                                    0x00000000 0x00000000 0x00000000 0x00000000 0x00000000 0x00008200
                                    0x00000000

    // pwil: disp ctrl0 hw bitmask
    0x29 0x00 0x00 0x03 0x00D1 0x02 0x00000008 0xF12410B0
    0x29 0x01 0x00 0x03 0x00D1 0x04 0x00000005 0xF12410B0 0x00000040 0x00000000

    // pwil: frc
    0x29 0x01 0x00 0x03 0x00F2 0x009 0x0001000C 0xF1310720
                                    0x09230000 0x04370000 0x00000003 0x00040000 0x00040000 0x00300000
                                    0x00000000

    // pwil: ad_blend
    0x29 0x01 0x00 0x03 0x00F3 0x03 0x0001000C 0xF1311E08
                                    0x00000062

    // pwil: pps sel
    0x29 0x01 0x00 0x03 0x0040 0x003 0x0001000C 0xF131062C
                                    0x00000004

    // pwil: update
    0x29 0x01 0x00 0x03 0x0080 0x003 0x0001000C 0xF131073C
                                    0x00000100

    // pwil: force update
    0x29 0x01 0x00 0x03 0x0030 0x03 0xFFFFFFF4
                                    0xF1250000 0x00000200

    // dpp: csc-0
    0x29 0x01 0x00 0x0E 0x0040 0x0B 0x0001000C 0xF1310838
                                    0x00000011 0x08000000 0x00000000 0x08000000 0x00000800 0x00000000
                                    0x00000000 0x00000000 0x00000000

    // dpp: csc-1
    0x29 0x01 0x00 0x0E 0x0041 0x0B 0x0001000C 0xF1310838
                                    0x00000011 0x06A00000 0x00000000 0x06A00000 0x000006A0 0x00000000
                                    0x0B000B00 0x00000B00 0x00000B00

    // dpp: init
    0x29 0x00 0x00 0x0E 0x00F1 0x006 0x0001000C 0xF1310A14
                                    0xB29500A4 0x80808080 0x00000002 0x00FFFFFF

    0x29 0x01 0x00 0x0E 0x00F1 0x024 0x0001000C 0xF1310A24
                                     0x00580800 0x006155E0 0x0066D648 0x006A568B 0x006CE6BC 0x006F46E3
                                     0x00711703 0x0072B71E 0x00742738 0x0075874C 0x0076B762 0x0077C773
                                     0x0078C784 0x0079A792 0x007A97A1 0x007B67AF 0x000007BC 0x007C87C2
                                     0x007D47CE 0x007DE7D9 0x007E97E3 0x007F27ED 0x007FC7F7 0x0080A801
                                     0x00818811 0x0082381D 0x0082A827 0x0082E82C 0x0082E82F 0x0082C82D
                                     0x00824829 0x0081881F 0x0080080E 0x00000800

    // dpp: init
    0x29 0x01 0x00 0x0E 0x00F0 0x00C 0x0001000C 0xF1310834
                                    0x00010000 0x00000010 0x09510000 0x7FFE094E 0x10E47E4C 0x7BBD0E56
                                    0x00000000 0x00000000 0x00000000 0x00000000

    // dpp: gamma disable
    0x29 0x01 0x00 0x0E 0x0000 0x03 0x0001000C 0xF1310834
                                    0x00010000

    // dpp: gamma enable
    0x29 0x01 0x00 0x0E 0x0001 0x03 0x0001000C 0xF1310834
                                    0x00010040

    //dpp: s curve disable
    0x29 0x01 0x00 0x0E 0x0050 0x03 0x0001000C 0xF1310A14
                                    0xB29500A4

    //dpp: s curve enable
    0x29 0x01 0x00 0x0E 0x0051 0x03 0x0001000C 0xF1310A14
                                    0xB29500A5

    // dpp: gamma
    0x29 0x01 0x00 0x0E 0x00FE 0x002 0x0001000C 0xF131085C
                                    

    // dpp: dither
    0x29 0x01 0x00 0x0E 0x00F8 0x002 0x0001000C 0xF1310AAC
                                    

    // dpp: gc
    0x29 0x01 0x00 0x0E 0x00A0 0x003 0x0001000C 0xF1310BAC
                                    0x00000800

    // dpp: update
    0x29 0x01 0x00 0x0E 0x0080 0x003 0x0001000C 0xF1310BB0
                                    0x00000001

    // peaking2d: level0
    0x29 0x01 0x00 0x0C 0x0000 0x1A 0x0001000C 0xF1310740
                                    0x00000000 0x00000000 0x00000000 0x00000000 0x00000000 0x00000000
                                    0x00000000 0x00000000 0x00000000 0x00000000 0x00000000 0x00000000
                                    0x00000000 0x00000000 0x00000000 0x00000000 0x00000000 0x00200040
                                    0x00000000 0x00000000 0x00FF00FF 0x00000000 0x00000000 0x000000E0

    // peaking2d: level1
    0x29 0x01 0x00 0x0C 0x0001 0x1A 0x0001000C 0xF1310740
                                    0x00000000 0x00000000 0x03E00040 0x00600010 0x00020002 0x00000000
                                    0x03F40008 0x00200012 0x00020002 0x00000000 0x03F40008 0x00200012
                                    0x00080008 0x00000000 0x03F80000 0x00200008 0x00200040 0x00200040
                                    0x00000000 0x00000000 0x00FF00FF 0x00FF0002 0x000003FF 0x000000E1

    // peaking2d: level2
    0x29 0x01 0x00 0x0C 0x0002 0x1A 0x0001000C 0xF1310740
                                    0x00000000 0x00000000 0x03E00040 0x00600010 0x00040004 0x00000000
                                    0x03F80010 0x00200012 0x00040004 0x00000000 0x03F80010 0x00200012
                                    0x00100010 0x00000000 0x03F80000 0x00200008 0x00200040 0x00200040
                                    0x00000000 0x00000001 0x00FF00FF 0x00FF0002 0x000003FF 0x000000E1

    // peaking2d: level3
    0x29 0x01 0x00 0x0C 0x0003 0x1A 0x0001000C 0xF1310740
                                    0x00000000 0x00000000 0x03E00040 0x00600010 0x00070007 0x00000000
                                    0x03F70010 0x00200012 0x00070007 0x00000000 0x03F70010 0x00200012
                                    0x00120012 0x00000000 0x03F80000 0x00200008 0x00200040 0x00200040
                                    0x00000000 0x00000001 0x00FF00FF 0x00FF0002 0x000003FF 0x000000E1

    // peaking2d: level4
    0x29 0x01 0x00 0x0C 0x0004 0x1A 0x0001000C 0xF1310740
                                    0x00000000 0x00000000 0x03E00040 0x00600010 0x00090009 0x00000000
                                    0x03F70010 0x00200012 0x00090009 0x00000000 0x03F70010 0x00200012
                                    0x00140014 0x00000000 0x03F40000 0x00200008 0x00200040 0x00200040
                                    0x00000000 0x00000001 0x00FF00FF 0x00FF0002 0x000003FF 0x000000E1

    // peaking2d: csc 0
    0x29 0x01 0x00 0x0C 0x0010 0x04 0x0001000C 0xF13107A0
                                    0x00000009 0x00000009

    // peaking2d: csc 1
    0x29 0x01 0x00 0x0C 0x0011 0x04 0x0001000C 0xF13107A0
                                    0x00000009 0x00000008

    // peaking2d: init
    0x29 0x01 0x00 0x0C 0x00F0 0x01C 0x0001000C 0xF1310740
                                    0x001E000A 0x0000000A 0x00E00020 0x025800A0 0x00780028 0x00000028
                                    0x00E00020 0x032000A0 0x003C003C 0x00000014 0x00800000 0x03200078
                                    0x003C003C 0x0000003C 0x00000000 0x03FC0000 0x00200040 0x00200040
                                    0x00030000 0x00000000 0x00FF00FF 0x00FF0004 0x003F03FF 0x000000F0
                                    0x00000000 0x00000000

    // peaking2d: gc idle clk off
    0x29 0x01 0x00 0x0C 0x00A0 0x003 0x0001000C 0xF13107A8
                                    0x00010800

    // peaking2d: gc idle clk on
    0x29 0x01 0x00 0x0C 0x00A1 0x03 0x0001000C 0xF13107A8
                                    0x00010803

    // peaking2d: update
    0x29 0x01 0x00 0x0C 0x0080 0x003 0x0001000C 0xF13107AC
                                    0x00000001

    // lce: level 0
    0x29 0x01 0x00 0x0D 0x0000 0x10 0x0001000C 0xF1310C24
                                    0x014E1096 0x0A140000 0x002FFFFF 0x0F10012C 0x00001010 0x17C7D1F4
                                    0x1F44B1F4 0x00C80064 0x00004419 0x0000280A 0x000FFC0A 0x03E80010
                                    0x0080100A 0x000040A5

    // lce: level 1
    0x29 0x01 0x00 0x0D 0x0001 0x10 0x0001000C 0xF1310C24
                                    0x014E1096 0x0A140000 0x002FFFFF 0x0F10012C 0x00001010 0x17C7D1F4
                                    0x1F44B1F4 0x00C80064 0x00004419 0x0000280A 0x000FFC0A 0x03E80010
                                    0x0080100A 0x000040A6

    // lce: level 2
    0x29 0x01 0x00 0x0D 0x0002 0x10 0x0001000C 0xF1310C24
                                    0x028E1096 0x0A140000 0x002FFFFF 0x19100258 0x00001010 0x17C7D1F4
                                    0x1F44B1F4 0x00C80096 0x00006446 0x0000280A 0x000FFC0A 0x03E80010
                                    0x0080100A 0x000040A6

    // lce: level 3
    0x29 0x01 0x00 0x0D 0x0003 0x10 0x0001000C 0xF1310C24
                                    0x03CE1096 0x0A140000 0x002FFFFF 0x19100384 0x00001010 0x17C7D1F4
                                    0x1F44B1F4 0x00C80096 0x0000B464 0x0000280A 0x000FFC0A 0x03E80010
                                    0x0080100A 0x000040A6

    // lce: level 4
    0x29 0x01 0x00 0x0D 0x0004 0x10 0x0001000C 0xF1310C24
                                    0x050E1096 0x0A140000 0x002FFFFF 0x191004B0 0x00001010 0x17C7D1F4
                                    0x1F44B1F4 0x00C80096 0x0001186E 0x0000280A 0x000FFC0A 0x03E80010
                                    0x0080100A 0x000040A6

    // lce: level 5
    0x29 0x01 0x00 0x0D 0x0005 0x10 0x0001000C 0xF1310C24
                                    0x064E1096 0x0A140000 0x002FFFFF 0x191005DC 0x00001010 0x17C7D1F4
                                    0x1F44B1F4 0x00C800C8 0x000168A5 0x0000280A 0x000FFC0A 0x03E80010
                                    0x0080100A 0x000040A6

    // lce: level 6
    0x29 0x01 0x00 0x0D 0x0006 0x10 0x0001000C 0xF1310C24
                                    0x014E1096 0x0A140000 0x002FFFFF 0x0F10012C 0x00001010 0x17C7D1F4
                                    0x1F44B1F4 0x00C80064 0x00004419 0x0000280A 0x000FFC0A 0x03E80010
                                    0x0080100A 0x000040A5

    // lce: level 7
    0x29 0x01 0x00 0x0D 0x0007 0x10 0x0001000C 0xF1310C24
                                    0x014E1096 0x0A140000 0x002FFFFF 0x0F10012C 0x00001010 0x17C7D1F4
                                    0x1F4029F4 0x00000064 0x00004419 0x0000280A 0x000FFC0A 0x03E80010
                                    0x0080100A 0x000040A6

    // lce: level 8
    0x29 0x01 0x00 0x0D 0x0008 0x10 0x0001000C 0xF1310C24
                                    0x028E1096 0x0A140000 0x002FFFFF 0x1E100258 0x00001010 0x17C7D1F4
                                    0x1F4029F4 0x00000096 0x00006446 0x0000280A 0x000FFC0A 0x03E80010
                                    0x0080100A 0x000040A6

    // lce: level 9
    0x29 0x01 0x00 0x0D 0x0009 0x10 0x0001000C 0xF1310C24
                                    0x03CE1096 0x0A140000 0x002FFFFF 0x1E100384 0x00001010 0x17C7D1F4
                                    0x1F4029F4 0x00000096 0x0000B46E 0x0000280A 0x000FFC0A 0x03E80010
                                    0x0080100A 0x000040A6

    // lce: level 10
    0x29 0x01 0x00 0x0D 0x000A 0x10 0x0001000C 0xF1310C24
                                    0x050E1096 0x0A140000 0x002FFFFF 0x1E1004B0 0x00001010 0x17C7D1F4
                                    0x1F4029F4 0x00000096 0x0001186E 0x0000280A 0x000FFC0A 0x03E80010
                                    0x0080100A 0x000040A6

    // lce: level 11
    0x29 0x01 0x00 0x0D 0x000B 0x10 0x0001000C 0xF1310C24
                                    0x064E1096 0x0A140000 0x002FFFFF 0x1E1005DC 0x00001010 0x17C7D1F4
                                    0x1F4029F4 0x000000C8 0x000168A5 0x0000280A 0x000FFC0A 0x03E80010
                                    0x0080100A 0x000040A6

    // lce: gra_det 0
    0x29 0x01 0x00 0x0D 0x0010 0x03 0x0001000C 0xF1310C5C
                                    0x2804003C

    // lce: gra_det 1
    0x29 0x01 0x00 0x0D 0x0011 0x03 0x0001000C 0xF1310C5C
                                    0x2804083C

    // lce: reserved: TODO
    0x29 0x00 0x00 0x0D 0x00F0 0x003 0x0001000C 0xF1310C64
                                    0xC77F0437

    // lce: init
    0x29 0x01 0x00 0x0D 0x00F0 0x02D 0x0001000C 0xF1310BB4
                                    0x04370000 0x09230000 0x00018AE0 0x00018AE0 0x00018AE0 0x00018AE0
                                    0x00018662 0x00018A08 0x00018662 0x00018738 0x00018738 0x001D40D8
                                    0x00000100 0x001B00D8 0x00360288 0x003A81D4 0x0075057C 0x00066667
                                    0x00066667 0x00000412 0x00010453 0x00000419 0x00010625 0x00040000
                                    0x00000000 0x00000F30 0x00000702 0x000001A9 0x000E1096 0x0A140000
                                    0x002FFFFF 0x0F100100 0x00001010 0x17C7D1F4 0x1F4029F4 0x00000096
                                    0x00006464 0x0000280A 0x000FFC10 0x03E80010 0x0081100A 0x000040A5
                                    0x2804003C

    // lce: gc
    0x29 0x01 0x00 0x0D 0x00A0 0x003 0x0001000C 0xF1310C60
                                    0x00000000

    // lce: read
    0x29 0x01 0x00 0x0D 0x0070 0x0D4 0x0001000C 0xF1310C68
                                    0x40000000 0x00000043 0x06010020 0x0C028080 0x120400E0 0x18058140
                                    0x1E0701A0 0x24088200 0x2A0A0260 0x300B82C0 0x360D0320 0x3C0E8380
                                    0x00000000 0x00000000 0x00000000 0x00000000 0x00000000 0x00000000
                                    0x00000000 0x00000000 0x00000000 0x00000000 0x00000000 0x00000000
                                    0x00000000 0x00000000 0x00000000 0x00000000 0x00000000 0x00000000
                                    0x00000000 0x00000000 0x00000000 0x00000000 0x00000000 0x00000000
                                    0x00000000 0x00000000 0x00000000 0x00000000 0x00000000 0x00000000
                                    0x00000000 0x00000000 0x00000000 0x00000000 0x000003E0 0x01002000
                                    0x00000000 0x00000000 0x00000000 0x00000000 0x00000000 0x00000000
                                    0x00000000 0x00000000 0x00000000 0x00000000 0x00000000 0x00000000
                                    0x00000000 0x00000000 0x00000000 0x00000000 0x00000000 0x00000000
                                    0x00000000 0x00000000 0x00000000 0x00000000 0x00000000 0x00000000
                                    0x00000000 0x00000000 0x00000000 0x00000000 0x00000000 0x00000000
                                    0x00000000 0x00000000 0x00000000 0x00000000 0x00000000 0x00000000
                                    0x00000000 0x00000000 0x00000000 0x00000000 0x00000000 0x00000000
                                    0x00000000 0x00000000 0x00000000 0x00000000 0x00000000 0x00000000
                                    0x00000000 0x00000000 0x00000000 0x00000000 0x00000000 0x00000000
                                    0x00000000 0x00000000 0x00000000 0x00000000 0x00000000 0x00000000
                                    0x00000000 0x00000000 0x00000000 0x00000000 0x00000000 0x00000000
                                    0x00000000 0x00000000 0x00000000 0x00000000 0x00000000 0x00000000
                                    0x00000000 0x00000000 0x00000000 0x00000000 0x00000000 0x00000000
                                    0x00000000 0x00000000 0x00000000 0x00000000 0x00000000 0x00000000
                                    0x00000000 0x00000000 0x00000000 0x00000000 0x00000000 0x00000000
                                    0x00000000 0x00000000 0x00000000 0x00000000 0x00000000 0x00000000
                                    0x00000000 0x00000000 0x00000000 0x00000000 0x00000000 0x00000000
                                    0x00000000 0x00000000 0x00000000 0x00000000 0x00000000 0x00000000
                                    0x00000000 0x00000000 0x00000000 0x00000000 0x00000000 0x00000000
                                    0x00000000 0x00000000 0x00000000 0x00000000 0x00000000 0x00000000
                                    0x00000000 0x00000000 0x00000000 0x00000000 0x00000000 0x00000000
                                    0x00000000 0x00000000 0x00000000 0x00000000 0x00000000 0x00000000
                                    0x00000000 0x00000000 0x00000000 0x00000000 0x00000000 0x00000000
                                    0x00000000 0x00000000 0x00000000 0x00000000 0x00000000 0x00000000
                                    0x00000000 0x00000000 0x00000000 0x00000000 0x00000000 0x00000000
                                    0x00000000 0x00000000 0x00000000 0x00000000 0x00000000 0x00000000
                                    0x00000000 0x00000000 0x00000000 0x00000000 0x00000000 0x00000000

    // lce: update
    0x29 0x01 0x00 0x0D 0x0080 0x003 0x0001000C 0xF1310FB0
                                    0x00000004

    // lce: read update
    0x29 0x01 0x00 0x0D 0x0071 0x003 0x0001000C 0xF1310FB4
                                    0x80000001

    // cm: 6axis 0
    0x29 0x01 0x00 0x0A 0x0000 0x04 0x0001000C 0xF13107B0
                                    0x0820E000 0x03400010

    // cm: 6axis 1
    0x29 0x01 0x00 0x0A 0x0001 0x04 0x0001000C 0xF13107B0
                                    0x0820E800 0x03000000

    // cm: 6axis 2
    0x29 0x01 0x00 0x0A 0x0002 0x04 0x0001000C 0xF13107B0
                                    0x0820EC00 0x03000000

    // cm: 6axis 3
    0x29 0x01 0x00 0x0A 0x0003 0x04 0x0001000C 0xF13107B0
                                    0x0820EFC0 0x03000000

    // cm: ftc 0
    0x29 0x01 0x00 0x0A 0x0010 0x03 0x0001000C 0xF13107C4
                                    0x00002215

    // cm: ftc 1
    0x29 0x01 0x00 0x0A 0x0011 0x03 0x0001000C 0xF13107C4
                                    0x002C2215

    // cm: csc 0
    0x29 0x01 0x00 0x0A 0x0040 0x08 0x0001000C 0xF1310808
                                    0x00000019 0x08000800 0x00000800 0x0E307D40 0x7A480B38 0x00000000

    // cm: csc 1
    0x29 0x01 0x00 0x0A 0x0041 0x08 0x0001000C 0xF1310808
                                    0x00000019 0x08000800 0x00000800 0x07177EA0 0x7D25059C 0x00000000

    // cm: csc 2
    0x29 0x01 0x00 0x0A 0x0045 0x08 0x0001000C 0xF1310808
                                    0x00000019 0x08000800 0x00000800 0x0F0D7EAF 0x7B6E0BCC 0x00000000

    // cm: csc 3
    0x29 0x01 0x00 0x0A 0x0046 0x08 0x0001000C 0xF1310808
                                    0x00000019 0x08000800 0x00000800 0x0F0D7EAF 0x7B6E0BCC 0x00000000

    // cm: init
    0x29 0x00 0x00 0x0A 0x00F0 0x012 0x0001000C 0xF13107B0
                                    0x0820EFC0 0x13000000 0x7A067844 0x1C43FF10 0x15450018 0x002C2215
                                    0x3FE6B47F 0x00A05000 0x28ABF44B 0x7FF8103F 0x7840473A 0x005537B7
                                    0x88034C40 0x708200D3 0x88034C40 0x70820384

    // cm: init csc
    0x29 0x01 0x00 0x0A 0x00F0 0x00B 0x0001000C 0xF1310808
                                    0x0000001D 0x0951094E 0x7FFE094E 0x10E47E4C 0x7BBD0E56 0x00000000
                                    0x00000000 0x00000000 0x00000000

    // cm: gc
    0x29 0x01 0x00 0x0A 0x00A0 0x003 0x0001000C 0xF131082C
                                    0x00000800

    // cm: update
    0x29 0x01 0x00 0x0A 0x0080 0x003 0x0001000C 0xF1310830
                                    0x00000100

    // scaler1d
    0x29 0x01 0x00 0x0B 0x00F0 0x013 0x0001000C 0xF1311578
                                    0x00026620 0x00000441 0x000EA000 0x000EA000 0x00006410 0x05000500
                                    0x00000003 0x00000003 0x00000000 0x0000001E 0x02D002D0 0x000C0000
                                    0x000C0000 0x00010003 0x00010003 0x00006410 0x00000000

    // scaler1d: gc
    0x29 0x01 0x00 0x0B 0x00A0 0x003 0x0001000C 0xF13115BC
                                    0x00000800

    // dbc: gc
    0x29 0x01 0x00 0x0F 0x00A0 0x003 0x0001000C 0xF1311728
                                    0x00000800

    // dbc: init
    0x29 0x00 0x00 0x0F 0x00F0 0x037 0x0001000C 0xF13118B0
                                    0x50850421 0x00000000 0x00000000 0x0000003F 0x00000000 0x00000080
                                    0x0000012C 0x00000400 0x00000600 0x00000E00 0x000002EC 0x00000400
                                    0x00000448 0x00000197 0x000002C5 0x00000300 0x000000D6 0x00000067
                                    0x00000009 0x00000043 0x00000026 0x00000004 0x00000140 0x000003CB
                                    0x000001C0 0x0000003F 0x00000002 0x00000FFF 0x000003CB 0x000001C0
                                    0x00000000 0x0000000E 0x00000800 0x00000000 0x00000B38 0x00000800
                                    0x00007D3E 0x00007A4A 0x00000800 0x00000E2C 0x00007FFE 0x00000800
                                    0x00000000 0x00000B38 0x00000800 0x00007D3E 0x00007A4A 0x00000800
                                    0x00000E2C 0x00007FFE 0x00000000 0x000003FF 0x00000FFF

    // dbc: init plcdcompw
    0x29 0x01 0x00 0x0F 0x00F0 0x023 0x0001000C 0xF131172C
                                    0x000003FF 0x000003E0 0x000003C0 0x000003A0 0x00000380 0x00000360
                                    0x00000340 0x00000320 0x00000300 0x000002E6 0x000002CD 0x000002B3
                                    0x0000029A 0x00000280 0x00000266 0x0000024D 0x00000233 0x0000021A
                                    0x00000200 0x000001E6 0x000001CD 0x000001B3 0x0000019A 0x00000180
                                    0x00000166 0x0000013A 0x0000010D 0x000000E0 0x000000B3 0x00000087
                                    0x0000005A 0x0000002D 0x00000000

    // dbc: COREX0K0
    0x29 0x01 0x00 0x0F 0x00FE 0x002 0x0001000C 0xF13117B0
                                    

    // dbc: read
    0x29 0x01 0x00 0x0F 0x0070 0x01A 0x0001000C 0xF1311984
                                    0x00000000 0x00000000 0x00000000 0x00000000 0x00000FFF 0x00000FFF
                                    0x00001000 0x00000000 0x00000000 0x00000000 0x00000000 0x00000000
                                    0x000003FF 0x00000000 0x00000000 0x00000000 0x00000000 0x00000000
                                    0x00000000 0x00000000 0x00000000 0x00000063 0x00000000 0x00000FFF

    // dbc: off
    0x29 0x01 0x00 0x0F 0x0000 0x03 0x0001000C 0xF13118B0
                                    0x40850423

    // dbc: on
    0x29 0x01 0x00 0x0F 0x0001 0x03 0x0001000C 0xF13118B0
                                    0x40840423

    // dbc: level 0
    0x29 0x01 0x00 0x0F 0x0010 0x04 0x0001000C 0xF1311914
                                    0x00000000 0x00000000

    // dbc: level 1
    0x29 0x01 0x00 0x0F 0x0011 0x04 0x0001000C 0xF1311914
                                    0x00000027 0x00000002

    // dbc: level 2
    0x29 0x01 0x00 0x0F 0x0012 0x04 0x0001000C 0xF1311914
                                    0x00000022 0x00000002

    // dbc: level 3
    0x29 0x01 0x00 0x0F 0x0013 0x04 0x0001000C 0xF1311914
                                    0x0000001B 0x00000002

    // dbc: compenk table 0
    0x29 0x01 0x00 0x0F 0x0020 0x03 0x0001000C 0xF13118B4
                                    0x00000000

    // dbc: compenk table 1
    0x29 0x01 0x00 0x0F 0x0021 0x03 0x0001000C 0xF13118B4
                                    0x00000001

    // dbc: income table 0
    0x29 0x01 0x00 0x0F 0x0030 0x03 0x0001000C 0xF13118B8
                                    0x00000000

    // dbc: income table 1
    0x29 0x01 0x00 0x0F 0x0031 0x03 0x0001000C 0xF13118B8
                                    0x00000001

    // dbc: RGB in
    0x29 0x01 0x00 0x0F 0x0040 0x03 0x0001000C 0xF131192C
                                    0x00000006

    // dbc: YUV in
    0x29 0x01 0x00 0x0F 0x0041 0x03 0x0001000C 0xF131192C
                                    0x00000007

    // dsc_dec: init
    0x29 0x01 0x00 0x07 0x00F0 0x01A 0x0001000C 0xF13115C0
                                    0x00480150 0x03C003C0 0xAB000011 0x24098030 0x1E003804 0x38043804
                                    0x1C030002 0xDD032000 0x0C000F00 0xB2015003 0xF0100018 0x00201007
                                    0x330F0F06 0x382A1C0E 0x69625446 0x7B797770 0x02027E7D 0x402A0022
                                    0xFC3ABE2A 0xF83AFA3A 0x783B383B 0xF64BB63B 0x744C344C 0xF48C745C

    // dsc_dec: gc
    0x29 0x01 0x00 0x07 0x00A0 0x003 0x0001000C 0xF1311620
                                    0x00000800

    // dsc_dec: update
    0x29 0x01 0x00 0x07 0x0080 0x003 0x0001000C 0xF1311624
                                    0x00000001

    // dsc_enc: init
    0x29 0x01 0x00 0x08 0x00F0 0x042 0x0001000C 0xF1311628
                                    0x00000003 0x00000002 0x01680168 0x00010438 0x0168010E 0x00007E90
                                    0x00007E90 0x00001FA4 0xC0002000 0x01680438 0x01680168 0x00010438
                                    0x0168010E 0x00007E90 0x00007E90 0x00001FA4 0x00002000 0x01680438
                                    0x00000000 0xAB000011 0x24098030 0x1E003804 0x38043804 0x1C030002
                                    0xDD032000 0x0C000F00 0xB2015003 0xF0100018 0x00201007 0x330F0F06
                                    0x382A1C0E 0x69625446 0x7B797770 0x02027E7D 0x402A0022 0xFC3ABE2A
                                    0xF83AFA3A 0x783B383B 0xF64BB63B 0x744C344C 0xF48C745C 0xAB000011
                                    0x24098030 0x1E003804 0x38043804 0x1C030002 0xDD032000 0x0C000F00
                                    0xB2015003 0xF0100018 0x00201007 0x330F0F06 0x382A1C0E 0x69625446
                                    0x7B797770 0x02027E7D 0x402A0022 0xFC3ABE2A 0xF83AFA3A 0x783B383B
                                    0xF64BB63B 0x744C344C 0xF48C745C 0x00000004

    // dma: init
    0x29 0x01 0x00 0x11 0x00F0 0x184 0x0001000C 0xF1310000
                                    0x80080608 0xF1240000 0x80010628 0xF1240038 0x8001062C 0xF1240054
                                    0x80090630 0xF1240078 0x800A0654 0xF12400A0 0x8001067C 0xF1240108
                                    0x80010680 0xF1240120 0x800A0684 0xF1241000 0x800B06AC 0xF1241028
                                    0x800B06D8 0xF1241084 0x80070704 0xF12410B4 0x80070720 0xF12410F0
                                    0x8001073C 0xF1250000 0x80180740 0xF1A00000 0x800207A0 0xF1A0006C
                                    0x800107A8 0xF1A00060 0x800107AC 0xF1A00090 0x801007B0 0xF1560000
                                    0x800107F0 0xF1560058 0x800107F4 0xF1560074 0x800107F8 0xF1560090
                                    0x800107FC 0xF15600AC 0x80010800 0xF15600C8 0x80010804 0xF15600E4
                                    0x80090808 0xF1560130 0x8001082C 0xF1560118 0x80010830 0xF1560160
                                    0x80010834 0xF1580000 0x80090838 0xF1580014 0x8063085C 0xF1580100
                                    0x800209E8 0xF158003C 0x000909F0 0xF1580048 0x80030A14 0xF158006C
                                    0x00010A20 0xF1580394 0x80220A24 0xF1580078 0x80400AAC 0xF1580294
                                    0x80010BAC 0xF158000C 0x80010BB0 0xF1580290 0x84020BB4 0xF1520064
                                    0x840F0BBC 0xF1520094 0x840B0BF8 0xF15200F8 0x840E0C24 0xF1520000
                                    0x84010C5C 0xF1520054 0x84010C60 0xF1520058 0x84010C64 0xF1520070
                                    0xC4D20C68 0xF1531008 0x84010FB0 0xF1531000 0xC4010FB4 0xF1531004
                                    0x805C0FB8 0xF12C0000 0x81001128 0xF12C1400 0x80011528 0xF12CFF08
                                    0xC00A152C 0xF12D0004 0x80011554 0xF12D0000 0x80061558 0xF1220000
                                    0x80011570 0xF1220028 0x80011574 0xF1220064 0x80111578 0xF1A20000
                                    0x800115BC 0xF1A20044 0x000215C0 0xF1680000 0x001615C8 0xF168000C
                                    0x00011620 0xF1680008 0x00011624 0xF169FF00 0x080A1628 0xF1640000
                                    0x08081650 0xF1640030 0x08011670 0xF1640054 0x082D1674 0xF1640064
                                    0x84011728 0xF1500404 0x8421172C 0xF1500178 0x844017B0 0xF1500304
                                    0x840518B0 0xF1500000 0x841218C4 0xF1500014 0x8402190C 0xF1500080
                                    0x84021914 0xF15000C8 0x8401191C 0xF15000DC 0x84021920 0xF1500100
                                    0x84011928 0xF150015C 0x8413192C 0xF150040C 0x84031978 0xF1500458
                                    0xC4181984 0xF1518000 0x800319E4 0xF1400000 0x800119F0 0xF1400010
                                    0xC00119F4 0xF1400010 0x800119F8 0xF140001C 0x800119FC 0xF140002C
                                    0x80011A00 0xF14000A8 0x80011A04 0xF14000C8 0x80041A08 0xF1400104
                                    0x80021A18 0xF140011C 0x80011A20 0xF141FF00 0x80011A24 0xF17A0000
                                    0x80011A28 0xF17BE000 0x0C191A2C 0xF1720000 0x0C011A90 0xF173FF00
                                    0x0C0A1A94 0xF1700000 0x0C011ABC 0xF1700054 0x0C161AC0 0xF1700064
                                    0x0C011B18 0xF1700114 0x80121B1C 0xF1A40000 0x8C2F1B64 0xF16A0000
                                    0x8C011C20 0xF16BFF00 0x8C2F1C24 0xF16C0000 0x8C011CE0 0xF16DFF00
                                    0x8C0A1CE4 0xF1620000 0x8C081D0C 0xF1620030 0x8C011D2C 0xF1620054
                                    0x8C2D1D30 0xF1620064 0x80071DE4 0xF1540000 0x80011E00 0xF1540060
                                    0x80011E04 0xF1550030 0x80011E08 0xF1240120 0x80011E0C 0xF1240014
                                    0x9C011E10 0xF1800808 0x9C011E14 0xF1800818 0x9C011E18 0xF1800A00
                                    0x9C011E1C 0xF1800A08 0x9C011E20 0xF1800238 0x9C021E24 0xF1800300
                                    0x9C011E2C 0xF1801804 0x9C011E30 0xF1800104 0x9C021E34 0xF1800144
                                    0x9C011E3C 0xF1800080 0x9C011E40 0xF18C0200 0x9C011E44 0xF18C0004
                                    0x9C011E48 0xF18C0210 0x9C031E4C 0xF1880050 0x9C011E58 0xF1880004
                                    0x9C011E5C 0xF1880020 0x9C041E60 0xF188002C 0x9C011E70 0xF1880044
                                    0x9C041E74 0xF1880010 0x9C021E84 0xF1880008 0x9C011E8C 0xF1880000
                                    0x9C011E90 0xF1800010 0xB0081E94 0xF1240000 0xB0011EB4 0xF1240038
                                    0xB0011EB8 0xF1240054 0xB0091EBC 0xF1240078 0xB00A1EE0 0xF12400A0
                                    0xB0011F08 0xF1240108 0x30011F0C 0xF1240120 0xB00A1F10 0xF1241000
                                    0xB00B1F38 0xF1241028 0xB00B1F64 0xF1241084 0xB0071F90 0xF12410B4
                                    0xB0071FAC 0xF12410F0 0xB0011FC8 0xF1250000 0xB0181FCC 0xF1A00000
                                    0xB002202C 0xF1A0006C 0xB0012034 0xF1A00060 0xB0012038 0xF1A00090
                                    0xB010203C 0xF1560000 0xB001207C 0xF1560058 0xB0012080 0xF1560074
                                    0xB0012084 0xF1560090 0xB0012088 0xF15600AC 0xB001208C 0xF15600C8
                                    0xB0012090 0xF15600E4 0xB0092094 0xF1560130 0xB00120B8 0xF1560118
                                    0xB00120BC 0xF1560160 0xB00120C0 0xF1580000 0xB00920C4 0xF1580014
                                    0xB06320E8 0xF1580100 0xB0022274 0xF158003C 0x3009227C 0xF1580048
                                    0xB04022A0 0xF1580294 0xB00123A0 0xF158000C 0xB00123A4 0xF1580290
                                    0xB00223A8 0xF1520064 0xB00F23B0 0xF1520094 0xB00B23EC 0xF15200F8
                                    0xB00E2418 0xF1520000 0xB0012450 0xF1520054 0xB0012454 0xF1520058
                                    0xB0012458 0xF1520070 0xB001245C 0xF1531000 0xB05C2460 0xF12C0000
                                    0xB10025D0 0xF12C1400 0xB00129D0 0xF12CFF08 0xB00129D4 0xF12D0000
                                    0xB00129D8 0xF1500404 0xB02129DC 0xF1500178 0xB0402A60 0xF1500304
                                    0xB0052B60 0xF1500000 0xB0122B74 0xF1500014 0xB0022BBC 0xF1500080
                                    0xB0022BC4 0xF15000C8 0xB0012BCC 0xF15000DC 0xB0022BD0 0xF1500100
                                    0xB0012BD8 0xF150015C 0xB0132BDC 0xF150040C 0xB0032C28 0xF1500458
                                    0xB0012C34 0xF1240014

    // dma: init no read
    0x29 0x01 0x00 0x11 0x00F1 0x184 0x0001000C 0xF1310000
                                    0x80080608 0xF1240000 0x80010628 0xF1240038 0x8001062C 0xF1240054
                                    0x80090630 0xF1240078 0x800A0654 0xF12400A0 0x8001067C 0xF1240108
                                    0x80010680 0xF1240120 0x800A0684 0xF1241000 0x800B06AC 0xF1241028
                                    0x800B06D8 0xF1241084 0x80070704 0xF12410B4 0x80070720 0xF12410F0
                                    0x8001073C 0xF1250000 0x80180740 0xF1A00000 0x800207A0 0xF1A0006C
                                    0x800107A8 0xF1A00060 0x800107AC 0xF1A00090 0x801007B0 0xF1560000
                                    0x800107F0 0xF1560058 0x800107F4 0xF1560074 0x800107F8 0xF1560090
                                    0x800107FC 0xF15600AC 0x80010800 0xF15600C8 0x80010804 0xF15600E4
                                    0x80090808 0xF1560130 0x8001082C 0xF1560118 0x80010830 0xF1560160
                                    0x80010834 0xF1580000 0x80090838 0xF1580014 0x8063085C 0xF1580100
                                    0x800209E8 0xF158003C 0x000909F0 0xF1580048 0x80030A14 0xF158006C
                                    0x00010A20 0xF1580394 0x80220A24 0xF1580078 0x80400AAC 0xF1580294
                                    0x80010BAC 0xF158000C 0x80010BB0 0xF1580290 0x84020BB4 0xF1520064
                                    0x840F0BBC 0xF1520094 0x840B0BF8 0xF15200F8 0x840E0C24 0xF1520000
                                    0x84010C5C 0xF1520054 0x84010C60 0xF1520058 0x84010C64 0xF1520070
                                    0x44D20C68 0xF1531008 0x84010FB0 0xF1531000 0x44010FB4 0xF1531004
                                    0x805C0FB8 0xF12C0000 0x81001128 0xF12C1400 0x80011528 0xF12CFF08
                                    0x400A152C 0xF12D0004 0x80011554 0xF12D0000 0x80061558 0xF1220000
                                    0x80011570 0xF1220028 0x80011574 0xF1220064 0x80111578 0xF1A20000
                                    0x800115BC 0xF1A20044 0x000215C0 0xF1680000 0x001615C8 0xF168000C
                                    0x00011620 0xF1680008 0x00011624 0xF169FF00 0x080A1628 0xF1640000
                                    0x08081650 0xF1640030 0x08011670 0xF1640054 0x082D1674 0xF1640064
                                    0x84011728 0xF1500404 0x8421172C 0xF1500178 0x844017B0 0xF1500304
                                    0x840518B0 0xF1500000 0x841218C4 0xF1500014 0x8402190C 0xF1500080
                                    0x84021914 0xF15000C8 0x8401191C 0xF15000DC 0x84021920 0xF1500100
                                    0x84011928 0xF150015C 0x8413192C 0xF150040C 0x84031978 0xF1500458
                                    0x44181984 0xF1518000 0x800319E4 0xF1400000 0x800119F0 0xF1400010
                                    0x400119F4 0xF1400010 0x800119F8 0xF140001C 0x800119FC 0xF140002C
                                    0x80011A00 0xF14000A8 0x80011A04 0xF14000C8 0x80041A08 0xF1400104
                                    0x80021A18 0xF140011C 0x80011A20 0xF141FF00 0x80011A24 0xF17A0000
                                    0x80011A28 0xF17BE000 0x0C191A2C 0xF1720000 0x0C011A90 0xF173FF00
                                    0x0C0A1A94 0xF1700000 0x0C011ABC 0xF1700054 0x0C161AC0 0xF1700064
                                    0x0C011B18 0xF1700114 0x80121B1C 0xF1A40000 0x8C2F1B64 0xF16A0000
                                    0x8C011C20 0xF16BFF00 0x8C2F1C24 0xF16C0000 0x8C011CE0 0xF16DFF00
                                    0x8C0A1CE4 0xF1620000 0x8C081D0C 0xF1620030 0x8C011D2C 0xF1620054
                                    0x8C2D1D30 0xF1620064 0x80071DE4 0xF1540000 0x80011E00 0xF1540060
                                    0x80011E04 0xF1550030 0x80011E08 0xF1240120 0x80011E0C 0xF1240014
                                    0x9C011E10 0xF1800808 0x9C011E14 0xF1800818 0x9C011E18 0xF1800A00
                                    0x9C011E1C 0xF1800A08 0x9C011E20 0xF1800238 0x9C021E24 0xF1800300
                                    0x9C011E2C 0xF1801804 0x9C011E30 0xF1800104 0x9C021E34 0xF1800144
                                    0x9C011E3C 0xF1800080 0x9C011E40 0xF18C0200 0x9C011E44 0xF18C0004
                                    0x9C011E48 0xF18C0210 0x9C031E4C 0xF1880050 0x9C011E58 0xF1880004
                                    0x9C011E5C 0xF1880020 0x9C041E60 0xF188002C 0x9C011E70 0xF1880044
                                    0x9C041E74 0xF1880010 0x9C021E84 0xF1880008 0x9C011E8C 0xF1880000
                                    0x9C011E90 0xF1800010 0xB0081E94 0xF1240000 0xB0011EB4 0xF1240038
                                    0xB0011EB8 0xF1240054 0xB0091EBC 0xF1240078 0xB00A1EE0 0xF12400A0
                                    0xB0011F08 0xF1240108 0x30011F0C 0xF1240120 0xB00A1F10 0xF1241000
                                    0xB00B1F38 0xF1241028 0xB00B1F64 0xF1241084 0xB0071F90 0xF12410B4
                                    0xB0071FAC 0xF12410F0 0xB0011FC8 0xF1250000 0xB0181FCC 0xF1A00000
                                    0xB002202C 0xF1A0006C 0xB0012034 0xF1A00060 0xB0012038 0xF1A00090
                                    0xB010203C 0xF1560000 0xB001207C 0xF1560058 0xB0012080 0xF1560074
                                    0xB0012084 0xF1560090 0xB0012088 0xF15600AC 0xB001208C 0xF15600C8
                                    0xB0012090 0xF15600E4 0xB0092094 0xF1560130 0xB00120B8 0xF1560118
                                    0xB00120BC 0xF1560160 0xB00120C0 0xF1580000 0xB00920C4 0xF1580014
                                    0xB06320E8 0xF1580100 0xB0022274 0xF158003C 0x3009227C 0xF1580048
                                    0xB04022A0 0xF1580294 0xB00123A0 0xF158000C 0xB00123A4 0xF1580290
                                    0xB00223A8 0xF1520064 0xB00F23B0 0xF1520094 0xB00B23EC 0xF15200F8
                                    0xB00E2418 0xF1520000 0xB0012450 0xF1520054 0xB0012454 0xF1520058
                                    0xB0012458 0xF1520070 0xB001245C 0xF1531000 0xB05C2460 0xF12C0000
                                    0xB10025D0 0xF12C1400 0xB00129D0 0xF12CFF08 0xB00129D4 0xF12D0000
                                    0xB00129D8 0xF1500404 0xB02129DC 0xF1500178 0xB0402A60 0xF1500304
                                    0xB0052B60 0xF1500000 0xB0122B74 0xF1500014 0xB0022BBC 0xF1500080
                                    0xB0022BC4 0xF15000C8 0xB0012BCC 0xF15000DC 0xB0022BD0 0xF1500100
                                    0xB0012BD8 0xF150015C 0xB0132BDC 0xF150040C 0xB0032C28 0xF1500458
                                    0xB0012C34 0xF1240014

    // dma: init ctrl
    0x29 0x01 0x00 0x11 0x00E1 0x09 0xFFFFFFF4
                                    0xF1300000 0x00000001 0xF1300004 0x00000000 0xF1300008 0x00C10000
                                    0xF1300004 0x0000000B

    // dma: write core
    0x29 0x01 0x00 0x11 0x00E2 0x05 0xFFFFFFF4
                                    0xF1300004 0x00000000 0xF1300004 0x00000001

    // dma: write lce
    0x29 0x01 0x00 0x11 0x00E3 0x05 0xFFFFFFF4
                                    0xF1300004 0x00000000 0xF1300004 0x00000002

    // dma: read core lce
    0x29 0x01 0x00 0x11 0x00E4 0x05 0xFFFFFFF4
                                    0xF1300004 0x00000000 0xF1300004 0x00030000

    // dma: write all
    0x29 0x01 0x00 0x11 0x00E5 0x05 0xFFFFFFF4
                                    0xF1300004 0x00000000 0xF1300004 0x0000000B

    // dma: write sw channel 8
    0x29 0x01 0x00 0x11 0x00E6 0x05 0xFFFFFFF4
                                    0xF1300004 0x00000000 0xF1300004 0x00000100

    // dma: write sw pq
    0x29 0x01 0x00 0x11 0x00E7 0x05 0xFFFFFFF4
                                    0xF1300004 0x00000000 0xF1300004 0x00001000

    // dma: write dsc
    0x29 0x01 0x00 0x11 0x00E8 0x05 0xFFFFFFF4
                                    0xF1300004 0x00000000 0xF1300004 0x00000008

    // blc_pwm: init
    0x29 0x01 0x00 0x06 0x00F0 0x03 0xFFFFFFF4
                                    0xF10C0014 0x0001100A

    // blc_pwm: disable
    0x29 0x01 0x00 0x06 0x0000 0x03 0xFFFFFFF4
                                    0xF10C0000 0x00001481

    // blc_pwm: enable
    0x29 0x01 0x00 0x06 0x0001 0x03 0xFFFFFFF4
                                    0xF10C0000 0x00001484

    // psr_mif: init
    0x29 0x01 0x00 0x2D 0x00F0 0x012 0x0001000C 0xF13119E4
                                    0x08C0CE14 0x140A1085 0x48004C02 0x00004082 0x00004082 0x00100E20
                                    0x00200196 0x00004040 0x10410400 0x04380438 0x02400240 0x04380008
                                    0x04380008 0x00040000 0x00000408 0x00000001

    // psr_mif: efifo_ctrl
    0x29 0x01 0x00 0x2D 0x00FD 0x03 0x0001000C 0xF13119E8
                                    0x140A1085

    // osd_decomp: init
    0x29 0x01 0x00 0x2B 0x00F0 0x004 0x0001000C 0xF1311A24
                                    0x00000033 0x00000100

    // dsc_decoder_psr: init
    0x29 0x01 0x00 0x25 0x00F0 0x01C 0x0001000C 0xF1311A2C
                                    0x00480158 0x03C003C0 0x00000800 0x89000011 0x24098030 0x24093804
                                    0x38043804 0x1C030002 0x7E232000 0x0C000F00 0x06000B00 0xF0100018
                                    0x00200C03 0x330B0B06 0x382A1C0E 0x69625446 0x7B797770 0x02017E7D
                                    0x40090001 0xFC19BE09 0xF819FA19 0x781A381A 0xF62AB61A 0x742B342B
                                    0xF46B743B 0x00000001

    // dsc_encoder_psr: init
    0x29 0x01 0x00 0x24 0x00F0 0x024 0x0001000C 0xF1311A94
                                    0x00000003 0x00000002 0x01680168 0x00010438 0x0168010E 0x00268FE0
                                    0x00268FE0 0x0009A3F8 0xC0003000 0x01680438 0x00000000 0x89000011
                                    0x24098030 0x24093804 0x38043804 0x1C030002 0x7E232000 0x0C000F00
                                    0x06000B00 0xF0100018 0x00200C03 0x330B0B06 0x382A1C0E 0x69625446
                                    0x7B797770 0x02017E7D 0x40090001 0xFC19BE09 0xF819FA19 0x781A381A
                                    0xF62AB61A 0x742B342B 0xF46B743B 0x00000004

    // scaler_pp: init
    0x29 0x01 0x00 0x2F 0x00F0 0x014 0x0001000C 0xF1311B1C
                                    0x00026620 0x00000441 0x00046046 0x00046046 0x00006410 0x09240924
                                    0x00040003 0x00040003 0x00000000 0x0000001E 0x04380438 0x00055555
                                    0x00055555 0x00030003 0x00030003 0x00006410 0x00000000 0x00000800

    // dsc_decoder_frc: init 0
    0x29 0x00 0x00 0x25 0x00F1 0x032 0x0001000C 0xF1311B64
                                    0x00480158 0x03C003C0 0x00000800 0x89000011 0x24098030 0x24093804
                                    0x38043804 0x1C030002 0x7E232000 0x0C000F00 0x06000B00 0xF0100018
                                    0x00200C03 0x330B0B06 0x382A1C0E 0x69625446 0x7B797770 0x02017E7D
                                    0x40090001 0xFC19BE09 0xF819FA19 0x781A381A 0xF62AB61A 0x742B342B
                                    0xF46B743B 0xAB000011 0x00056830 0x2000D002 0x4902D002 0xF7027602
                                    0x16032000 0x0C000A00 0x63021903 0xF1100018 0x00201007 0x330F0F06
                                    0x382A1C0E 0x69625446 0x7B797770 0x02027E7D 0x402A0022 0xFC3ABE2A
                                    0xF83AFA3A 0x783B383B 0xF64BB63B 0x744C344C 0xF48C745C 0x00000001

    // dsc_decoder_frc: init 1
    0x29 0x01 0x00 0x25 0x00F1 0x032 0x0001000C 0xF1311C24
                                    0x00480158 0x03C003C0 0x00000800 0x89000011 0x24098030 0x24093804
                                    0x38043804 0x1C030002 0x7E232000 0x0C000F00 0x06000B00 0xF0100018
                                    0x00200C03 0x330B0B06 0x382A1C0E 0x69625446 0x7B797770 0x02017E7D
                                    0x40090001 0xFC19BE09 0xF819FA19 0x781A381A 0xF62AB61A 0x742B342B
                                    0xF46B743B 0xAB000011 0x00056830 0x2000D002 0x4902D002 0xF7027602
                                    0x16032000 0x0C000A00 0x63021903 0xF1100018 0x00201007 0x330F0F06
                                    0x382A1C0E 0x69625446 0x7B797770 0x02027E7D 0x402A0022 0xFC3ABE2A
                                    0xF83AFA3A 0x783B383B 0xF64BB63B 0x744C344C 0xF48C745C 0x00000001

    // dsc_encoder_frc: init
    0x29 0x01 0x00 0x24 0x00F1 0x042 0x0001000C 0xF1311CE4
                                    0x00000003 0x00000002 0x01680168 0x00010438 0x0168010E 0x00268FE0
                                    0x00268FE0 0x0009A3F8 0xC0003000 0x01680438 0x00F000F0 0x000102D0
                                    0x00F00093 0x00004920 0x00004A00 0x00001260 0x00002000 0x00F002D0
                                    0x00000000 0x89000011 0x24098030 0x24093804 0x38043804 0x1C030002
                                    0x7E232000 0x0C000F00 0x06000B00 0xF0100018 0x00200C03 0x330B0B06
                                    0x382A1C0E 0x69625446 0x7B797770 0x02017E7D 0x40090001 0xFC19BE09
                                    0xF819FA19 0x781A381A 0xF62AB61A 0x742B342B 0xF46B743B 0xAB000011
                                    0x00056830 0x2000D002 0x4902D002 0xF7027602 0x16032000 0x0C000A00
                                    0x63021903 0xF1100018 0x00201007 0x330F0F06 0x382A1C0E 0x69625446
                                    0x7B797770 0x02027E7D 0x402A0022 0xFC3ABE2A 0xF83AFA3A 0x783B383B
                                    0xF64BB63B 0x744C344C 0xF48C745C 0x00000004

    // blending: init
    0x29 0x01 0x00 0x2E 0x00F0 0x00B 0x0001000C 0xF1311DE4
                                    0x03E80081 0x09240438 0x09240438 0x09240438 0x010003D1 0x000003D1
                                    0x00000022 0x000003D1 0x00000001

    // blending: frc
    0x29 0x01 0x00 0x2E 0x0010 0x03 0x0001000C 0xF1311DFC
                                    0x000003D1

    // blending: frc ocp
    0x29 0x01 0x00 0x2E 0x0011 0x03 0xFFFFFFF4
                                    0xF1540018 0x000003D1

    // blending: pt
    0x29 0x01 0x00 0x2E 0x0020 0x03 0x0001000C 0xF1311DFC
                                    0x00000022

    // blending: pt ocp
    0x29 0x01 0x00 0x2E 0x0021 0x03 0xFFFFFFF4
                                    0xF1540018 0x00000022

    // dsc_decoder_aux: init
    0x29 0x01 0x00 0x37 0x00F0 0x35 0xFFFFFFF4
                                    0xF16E0000 0x00480150 0xF16E0004 0x03C003C0 0xF16E000C 0xAB000011
                                    0xF16E0010 0x24098030 0xF16E0014 0x1E003804 0xF16E0018 0x38043804
                                    0xF16E001C 0x1C030002 0xF16E0020 0xDD032000 0xF16E0024 0x0C000F00
                                    0xF16E0028 0xB2015003 0xF16E002C 0xF0100018 0xF16E0030 0x00201007
                                    0xF16E0034 0x330F0F06 0xF16E0038 0x382A1C0E 0xF16E003C 0x69625446
                                    0xF16E0040 0x7B797770 0xF16E0044 0x02027E7D 0xF16E0048 0x402A0022
                                    0xF16E004C 0xFC3ABE2A 0xF16E0050 0xF83AFA3A 0xF16E0054 0x783B383B
                                    0xF16E0058 0xF64BB63B 0xF16E005C 0x744C344C 0xF16E0060 0xF48C745C
                                    0xF16FFF00 0x00000001 0xF16E0008 0x00000800

    // bwosd init
    0x29 0x01 0x00 0x2C 0x00F0 0x03 0xFFFFFFF4
                                    0xF17E0008 0x07800438

    // osd_comp init
    0x29 0x01 0x00 0x2A 0x00F0 0x09 0xFFFFFFF4
                                    0xF17C0000 0x09240438 0xF17C0004 0x00000010 0xF17C0008 0x93070380
                                    0xF17D1000 0x00000001

    // pwil_v6 init
    0x29 0x01 0x00 0x23 0x00F0 0x31 0xFFFFFFF4
                                    0xF1280004 0x00000001 0xF1280008 0x00000020 0xF128000C 0x00000000
                                    0xF1280010 0x09240438 0xF1280014 0x0710441E 0xF1280018 0x00870010
                                    0xF1280030 0x00400000 0xF1280038 0x04380438 0xF128003C 0x04380438
                                    0xF1281000 0xE4D00010 0xF1281004 0x00800888 0xF1281008 0x00000000
                                    0xF128100C 0x09240438 0xF1281010 0x09240438 0xF1281014 0x00000010
                                    0xF1281018 0x00040000 0xF128101C 0x00000000 0xF1281020 0x09240438
                                    0xF1281024 0x09240438 0xF1281028 0x00000000 0xF128102C 0x09230000
                                    0xF1281030 0x04370000 0xF1280000 0xA0800008 0xF1290000 0x00000004

    // pwil_v6 sw_rst
    0x29 0x01 0x00 0x23 0x00F1 0x03 0xFFFFFFF4
                                    0xF1280000 0xA0800009

    // mipi_rx_aux: dphy
    0x29 0x01 0x00 0x21 0x00F1 0x09 0xFFFFFFF4
                                    0xF1840808 0x10020200 0xF1840818 0x00000007 0xF1840A00 0x00000060
                                    0xF1840A08 0x000004F7

    // mipi_rx_aux: ctrl
    0x29 0x01 0x00 0x21 0x00F0 0x11 0xFFFFFFF4
                                    0xF1840238 0x00770000 0xF1840300 0x04370000 0xF1840304 0x09230000
                                    0xF1841804 0x00000780 0xF1840104 0x00000000 0xF1840144 0x001E0438
                                    0xF1840148 0x00000438 0xF1840080 0x00000000

    // bitmask pwil capen 0
    0x29 0x01 0x00 0x03 0x0050 0x03 0xFFFFFFF4
                                    0xF1240014 0x00000000

    // bitmask pwil capen 1
    0x29 0x01 0x00 0x03 0x0051 0x03 0x0001000C 0xF1311E0C
                                    0x00000001

    // bitmask pwil capen 0 (dma)
    0x29 0x01 0x00 0x03 0x0052 0x03 0x0001000C 0xF1311E0C
                                    0x00000000

    // bitmask pwil ad_frc
    0x29 0x01 0x00 0x03 0x0023 0x03 0x0001000C 0xF131067C
                                    0x05000008

    // bitmask pwil fbo
    0x29 0x01 0x00 0x03 0x0022 0x03 0x0001000C 0xF1310718
                                    0x00008200

    // bitmask dpp cm cntl 2
    0x29 0x01 0x00 0x0E 0x00FC 0x03 0x0001000C 0xF13109EC
                                    0x0000006E

    // bitmask dpp cm cntl 3
    0x29 0x01 0x00 0x0E 0x00FD 0x03 0x0001000C 0xF13109E8
                                    0x00000100

    // bitmask cm cntl
    0x29 0x01 0x00 0x0A 0x00FB 0x03 0x0001000C 0xF13107B0
                                    0x0820E000

    // bitmask cm magenta 6
    0x29 0x01 0x00 0x0A 0x00B0 0x03 0x0001000C 0xF13107F0
                                    0x00A1B818

    // bitmask cm red 6
    0x29 0x01 0x00 0x0A 0x00B1 0x03 0x0001000C 0xF13107F4
                                    0x00A1B816

    // bitmask cm yellow 6
    0x29 0x01 0x00 0x0A 0x00B2 0x03 0x0001000C 0xF13107F8
                                    0x00A1B812

    // bitmask cm green 6
    0x29 0x01 0x00 0x0A 0x00B3 0x03 0x0001000C 0xF13107FC
                                    0x00A1B81D

    // bitmask cm blue 6
    0x29 0x01 0x00 0x0A 0x00B4 0x03 0x0001000C 0xF1310800
                                    0x00A1B812

    // bitmask cm cyan 6
    0x29 0x01 0x00 0x0A 0x00B5 0x03 0x0001000C 0xF1310804
                                    0x00A1B823

    // bitmask lce ahe_ctrl3 1
    0x29 0x01 0x00 0x0D 0x00FD 0x03 0x0001000C 0xF1310C30
                                    0x0F100100

    // bitmask blc_pwm  PWM_GEN_FREQ_SET
    0x29 0x01 0x00 0x06 0x00FD 0x03 0xFFFFFFF4
                                    0xF10C0010 0x00000001

    // bitmask dbc bl_user
    0x29 0x01 0x00 0x0F 0x00FD 0x03 0x0001000C 0xF131191C
                                    0x00000FFF

    // bitmask dbc led0d_gain
    0x29 0x01 0x00 0x0F 0x00FC 0x03 0x0001000C 0xF1311914
                                    0x00000000

    // bitmask sys pmu ctrl
    0x29 0x01 0x00 0x00 0x00F0 0x03 0xFFFFFFF4
                                    0xF0000060 0x0F1BC046

    // bitmask sys ulps ctrl
    0x29 0x01 0x00 0x00 0x00F1 0x03 0xFFFFFFF4
                                    0xF00000C0 0x000001D5

    // lk: dport: init
    0x29 0x00 0x00 0x04 0x00FA 0x0D 0xFFFFFFF4
                                    0xF1220000 0xE0008007 0xF1220004 0x21000803 0xF1220008 0x49240438
                                    0xF122000C 0x46000800 0xF1220010 0x06081802 0xF1220014 0x00040100

    // lk: dport: init
    0x29 0x01 0x00 0x04 0x00FA 0x03 0xFFFFFFF4
                                    0xF1220028 0x00000000

    // lk: dport: update
    0x29 0x01 0x00 0x04 0x008A 0x03 0xFFFFFFF4
                                    0xF1220064 0x00000001

    // lk: pwil: ctrl
    0x29 0x00 0x00 0x03 0x00FA 0x19 0xFFFFFFF4
                                    0xF1240000 0xA0E82014 0xF1240004 0x00C8B794 0xF1240008 0x38820060
                                    0xF124000C 0x50000012 0xF1240010 0x09240438 0xF1240014 0x00000000
                                    0xF1240018 0x04380438 0xF124001C 0x04380438 0xF1240038 0x00000080
                                    0xF1240054 0x00000004 0xF1240078 0x0000001D 0xF124007C 0x0951094E

    // lk: pwil: ctrl
    0x29 0x01 0x00 0x03 0x00FA 0x07 0xFFFFFFF4
                                    0x00000000 0x00000000 0x00000000 0x00000000 0x00000000 0x00000000

    // lk: pwil: update
    0x29 0x01 0x00 0x03 0x008A 0x03 0xFFFFFFF4
                                    0x00000000 0x00000000

    // lk: dsc_dec: init
    0x29 0x00 0x00 0x07 0x00FA 0x05 0xFFFFFFF4
                                    0xF1680000 0x00480150 0xF1680004 0x03C003C0

    // lk: dsc_dec: init pps
    0x29 0x01 0x00 0x07 0x00FA 0x2D 0xFFFFFFF4
                                    0xF168000C 0xAB000011 0xF1680010 0x24098030 0xF1680014 0x1E003804
                                    0xF1680018 0x38043804 0xF168001C 0x1C030002 0xF1680020 0xDD032000
                                    0xF1680024 0x0C000F00 0xF1680028 0xB2015003 0xF168002C 0xF0100018
                                    0xF1680030 0x00201007 0xF1680034 0x330F0F06 0xF1680038 0x382A1C0E
                                    0xF168003C 0x69625446 0xF1680040 0x7B797770 0xF1680044 0x02027E7D
                                    0xF1680048 0x402A0022 0xF168004C 0xFC3ABE2A 0xF1680050 0xF83AFA3A
                                    0xF1680054 0x783B383B 0xF1680058 0xF64BB63B 0xF168005C 0x744C344C
                                    0xF1680060 0xF48C745C

    // lk: dsc_dec: update
    0x29 0x01 0x00 0x07 0x008A 0x03 0xFFFFFFF4
                                    0xF169FF00 0x00000001

    // lk: dsc_enc: init
    0x29 0x00 0x00 0x08 0x00FA 0x05 0xFFFFFFF4
                                    0xF1640000 0x00000003 0xF1640004 0x00000002

    // lk: dsc_enc: init pps
    0x29 0x00 0x00 0x08 0x00FA 0x2D 0xFFFFFFF4
                                    0xF1640008 0x01680168 0xF164000C 0x00010438 0xF1640010 0x0168010E
                                    0xF1640014 0x00007E90 0xF1640018 0x00007E90 0xF164001C 0x00001FA4
                                    0xF1640020 0xC0002000 0xF1640024 0x01680438 0xF1640030 0x01680168
                                    0xF1640034 0x00010438 0xF1640038 0x0168010E 0xF164003C 0x00007E90
                                    0xF1640040 0x00007E90 0xF1640044 0x00001FA4 0xF1640048 0x00002000
                                    0xF164004C 0x01680438 0xF1640054 0x00000000 0xF1640064 0xAB000011
                                    0xF1640068 0x24098030 0xF164006C 0x1E003804 0xF1640070 0x38043804
                                    0xF1640074 0x1C030002

    // lk: dsc_enc: init
    0x29 0x01 0x00 0x08 0x00FA 0x11 0xFFFFFFF4
                                    0xF1640078 0xDD032000 0xF164007C 0x0C000F00 0xF1640080 0xB2015003
                                    0xF1640084 0xF0100018 0xF1640088 0x00201007 0xF164008C 0x330F0F06
                                    0xF1640090 0x382A1C0E 0xF1640094 0x69625446

    // lk: dsc_enc: update
    0x29 0x01 0x00 0x08 0x008A 0x03 0xFFFFFFF4
                                    0xF164009C 0x02027E7D

    // lk: dpp: disable
    0x29 0x01 0x00 0x0E 0x00FA 0x05 0xFFFFFFF4
                                    0xF1580014 0x0000001C 0xF1580290 0x00000002

    // lk: peaking
    0x29 0x01 0x00 0x0C 0x00FA 0x07 0xFFFFFFF4
                                    0xF1A0005C 0x000000F0 0xF1A00070 0x00000008 0xF1A00090 0x00000001

    // lk: cm
    0x29 0x01 0x00 0x0A 0x00FA 0x05 0xFFFFFFF4
                                    0xF1560118 0xFFFFFFFF 0xF1560160 0x00000001

    // lk: scaler: init
    0x29 0x01 0x00 0x0B 0x00FA 0x23 0xFFFFFFF4
                                    0xF1A20000 0x00026620 0xF1A20004 0x00000441 0xF1A20008 0x000EA000
                                    0xF1A2000C 0x000EA000 0xF1A20010 0x00006410 0xF1A20014 0x05000500
                                    0xF1A20018 0x00000003 0xF1A2001C 0x00000003 0xF1A20020 0x00000000
                                    0xF1A20024 0x0000001E 0xF1A20028 0x02D002D0 0xF1A2002C 0x000C0000
                                    0xF1A20030 0x000C0000 0xF1A20034 0x00010003 0xF1A20038 0x00010003
                                    0xF1A2003C 0x00006410 0xF1A20040 0x00000000

    // lk: scaler: gc
    0x29 0x01 0x00 0x0B 0x00AA 0x03 0xFFFFFFF4
                                    0xF1A20044 0x00000800

    >;
    };
};
