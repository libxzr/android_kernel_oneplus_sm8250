// SPDX-License-Identifier: GPL-2.0-only
/*
 * Copyright (C) 2018-2020 Oplus. All rights reserved.
 */
/dts-v1/;
/plugin/;

#include "kunlun-mtp-overlay.dtsi"
#include "oplus_charge_t0.dtsi"
#include "kunlun_nfc/kunlun-nfc-pn557_t0.dtsi"
#include "storage/kunlun-stg.dtsi"
#include "sensor/kunlun-sensor-20111.dtsi"
#include "fingerprint/kunlun-fingerprint-20111.dtsi"

/ {
	oplus,dtsi_no = <20111>;
	oplus,pcb_range = <0  22>;
};
