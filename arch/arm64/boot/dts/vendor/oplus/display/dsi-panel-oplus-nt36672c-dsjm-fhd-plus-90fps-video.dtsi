/* Copyright (c) 2019, The Linux Foundation. All rights reserved.
 *
 * This program is free software; you can redistribute it and/or modify
 * it under the terms of the GNU General Public License version 2 and
 * only version 2 as published by the Free Software Foundation.
 *
 * This program is distributed in the hope that it will be useful,
 * but WITHOUT ANY WARRANTY; without even the implied warranty of
 * MERCHANTABILITY or FITNESS FOR A PARTICULAR PURPOSE.  See the
 * GNU General Public License for more details.
 */

&mdss_mdp {
	dsi_nt36672c_dsjm_video: qcom,mdss_dsi_nt36672c_dsjm_video {
		qcom,mdss-dsi-panel-name =
			"nt36672c dsjm fhd plus video mode dsi panel";
		qcom,mdss-dsi-panel-type = "dsi_video_mode";
		qcom,dsi-ctrl-num = <0>;
		qcom,dsi-phy-num = <0>;
		qcom,mdss-dsi-virtual-channel-id = <0>;
		qcom,mdss-dsi-stream = <0>;
		qcom,mdss-dsi-h-left-border = <0>;
		qcom,mdss-dsi-h-right-border = <0>;
		qcom,mdss-dsi-v-top-border = <0>;
		qcom,mdss-dsi-v-bottom-border = <0>;
		qcom,mdss-dsi-bpp = <24>;
		qcom,mdss-dsi-color-order = "rgb_swap_rgb";
		qcom,mdss-dsi-underflow-color = <0xff>;
		qcom,mdss-dsi-border-color = <0>;
		qcom,mdss-dsi-h-sync-pulse = <0>;
		qcom,mdss-dsi-traffic-mode = "burst_mode";
		qcom,mdss-dsi-lane-map = "lane_map_0123";
		qcom,mdss-dsi-bllp-eof-power-mode;
		qcom,mdss-dsi-bllp-power-mode;
		qcom,ulps-enabled;
		qcom,mdss-dsi-tx-eot-append;
		qcom,mdss-dsi-lane-0-state;
		qcom,mdss-dsi-lane-1-state;
		qcom,mdss-dsi-lane-2-state;
		qcom,mdss-dsi-lane-3-state;
		qcom,mdss-dsi-dma-trigger = "trigger_sw";
		qcom,mdss-dsi-mdp-trigger = "none";
		qcom,mdss-dsi-reset-sequence = <1 10>, <0 5>, <1 10>;
		qcom,mdss-pan-physical-width-dimension = <68>;
		qcom,mdss-pan-physical-height-dimension = <150>;
		qcom,mdss-dsi-lp11-init;
		qcom,mdss-dsi-bl-min-level = <13>;
		qcom,mdss-dsi-bl-normal-max-level = <3562>;
		qcom,mdss-dsi-bl-max-level = <4095>;
		qcom,mdss-brightness-normal-max-level = <3562>;
		qcom,mdss-brightness-max-level = <4095>;
		qcom,mdss-brightness-default-level = <400>;
		qcom,mdss-dsi-video-mode;
		oplus,mdss-dsi-vendor-name = "NT36672C-90HZ";
		oplus,mdss-dsi-manufacture = "DSJM";

		qcom,mdss-dsi-panel-peak-brightness = <4200000>;
		qcom,mdss-dsi-panel-blackness-level = <3230>;

		qcom,mdss-dsi-display-timings {
			timing@0{
				qcom,mdss-dsi-panel-width = <1080>;
				qcom,mdss-dsi-panel-height = <2400>;
				qcom,mdss-dsi-h-front-porch = <420>;
				qcom,mdss-dsi-h-back-porch = <24>;
				qcom,mdss-dsi-h-pulse-width = <24>;
				qcom,mdss-dsi-h-sync-skew = <0>;
				qcom,mdss-dsi-v-back-porch = <10>;
				qcom,mdss-dsi-v-front-porch = <54>;
				qcom,mdss-dsi-v-pulse-width = <10>;
				qcom,mdss-dsi-panel-framerate = <90>;
				qcom,mdss-dsi-panel-clockrate = <1107000000>;

				qcom,mdss-dsi-on-command = [
					39 01 00 00 00 00 02 FF 10
					39 01 00 00 00 00 02 FB 01
					39 01 00 00 00 00 02 B0 00
					39 01 00 00 00 00 02 C0 03
					39 01 00 00 00 00 11 C1 89 28 00 08 00 AA 02 0E 00 2B 00 07 0D B7 0C B7
					39 01 00 00 00 00 03 C2 1B A0

					39 01 00 00 00 00 02 FF 20
					39 01 00 00 00 00 02 FB 01
					39 01 00 00 00 00 02 18 66
					39 01 00 00 00 00 02 1B 01
					39 01 00 00 00 00 02 2F 83
					39 01 00 00 00 00 02 F2 65
					39 01 00 00 00 00 02 F3 64
					39 01 00 00 00 00 02 F4 65
					39 01 00 00 00 00 02 F5 64
					39 01 00 00 00 00 02 F6 65
					39 01 00 00 00 00 02 F7 64
					39 01 00 00 00 00 02 F8 65
					39 01 00 00 00 00 02 F9 64

					39 01 00 00 00 00 02 FF 24
					39 01 00 00 00 00 02 FB 01
					39 01 00 00 00 00 02 11 20
					39 01 00 00 00 00 02 12 20
					39 01 00 00 00 00 02 13 20
					39 01 00 00 00 00 02 15 20
					39 01 00 00 00 00 02 16 20
					39 01 00 00 00 00 02 17 20
					39 01 00 00 00 00 02 C6 C0
					39 01 00 00 00 00 02 4D 19
					39 01 00 00 00 00 02 4E 45
					39 01 00 00 00 00 02 4F 45
					39 01 00 00 00 00 02 53 45
					39 01 00 00 00 00 02 7B 94
					39 01 00 00 00 00 02 A0 14
					39 01 00 00 00 00 02 A2 14

					39 01 00 00 00 00 02 FF 25
					39 01 00 00 00 00 02 FB 01
					39 01 00 00 00 00 02 18 20
					39 01 00 00 00 00 02 79 7F
					39 01 00 00 00 00 02 7D 40
					39 01 00 00 00 00 02 7E 1D
					39 01 00 00 00 00 02 80 04
					39 01 00 00 00 00 02 84 0D

					39 01 00 00 00 00 02 FF 26
					39 01 00 00 00 00 02 FB 01
					39 01 00 00 00 00 02 15 04
					39 01 00 00 00 00 02 83 02
					39 01 00 00 00 00 02 88 00

					39 01 00 00 00 00 02 FF 27
					39 01 00 00 00 00 02 FB 01
					39 01 00 00 00 00 02 21 E7
					39 01 00 00 00 00 02 E4 DA
					39 01 00 00 00 00 02 E6 6D

					39 01 00 00 00 00 02 FF 2A
					39 01 00 00 00 00 02 FB 01
					39 01 00 00 00 00 02 0A 70
					39 01 00 00 00 00 02 0C 09
					39 01 00 00 00 00 02 0F 00
					39 01 00 00 00 00 02 11 F0
					39 01 00 00 00 00 02 16 B6
					39 01 00 00 00 00 02 19 0E
					39 01 00 00 00 00 02 1A 8A
					39 01 00 00 00 00 02 1E 4F
					39 01 00 00 00 00 02 1F 4F
					39 01 00 00 00 00 02 20 4F
					39 01 00 00 00 00 02 28 EC
					39 01 00 00 00 00 02 29 0C
					39 01 00 00 00 00 02 2A 05
					39 01 00 00 00 00 02 2B 03
					39 01 00 00 00 00 02 2D 06
					39 01 00 00 00 00 02 2F 02
					39 01 00 00 00 00 02 30 4A
					39 01 00 00 00 00 02 31 40
					39 01 00 00 00 00 02 33 0E
					39 01 00 00 00 00 02 34 EE
					39 01 00 00 00 00 02 35 30
					39 01 00 00 00 00 02 36 06
					39 01 00 00 00 00 02 37 E9
					39 01 00 00 00 00 02 38 34
					39 01 00 00 00 00 02 39 02
					39 01 00 00 00 00 02 3A 4A
					39 01 00 00 00 00 02 4E 0E
					39 01 00 00 00 00 02 4F 9B
					39 01 00 00 00 00 02 52 0E
					39 01 00 00 00 00 02 53 6F
					39 01 00 00 00 00 02 57 7E
					39 01 00 00 00 00 02 58 7E
					39 01 00 00 00 00 02 59 7E
					39 01 00 00 00 00 02 61 C7
					39 01 00 00 00 00 02 63 F3
					39 01 00 00 00 00 02 64 03
					39 01 00 00 00 00 02 68 8A
					39 01 00 00 00 00 02 6A 0F
					39 01 00 00 00 00 02 6C 20
					39 01 00 00 00 00 02 6F 22
					39 01 00 00 00 00 02 70 E1
					39 01 00 00 00 00 02 7A 07
					39 01 00 00 00 00 02 7C 02
					39 01 00 00 00 00 02 7F 2C
					39 01 00 00 00 00 02 83 0F
					39 01 00 00 00 00 02 84 12
					39 01 00 00 00 00 02 88 E6
					39 01 00 00 00 00 02 8C 3A
					39 01 00 00 00 00 02 8D 3C
					39 01 00 00 00 00 02 8E 3A
					39 01 00 00 00 00 02 96 FD
					39 01 00 00 00 00 02 97 14
					39 01 00 00 00 00 02 98 32
					39 01 00 00 00 00 02 99 01
					39 01 00 00 00 00 02 9A 08
					39 01 00 00 00 00 02 9C 4C
					39 01 00 00 00 00 02 9D B1
					39 01 00 00 00 00 02 9F 75
					39 01 00 00 00 00 02 A2 42
					39 01 00 00 00 00 02 A3 6F
					39 01 00 00 00 00 02 A4 F9
					39 01 00 00 00 00 02 A5 47
					39 01 00 00 00 00 02 A6 6A
					39 01 00 00 00 00 02 A7 4C
					39 01 00 00 00 00 02 9F 01

					39 01 00 00 00 00 02 FF 2B
					39 01 00 00 00 00 02 FB 01
					39 01 00 00 00 00 02 B7 06
					39 01 00 00 00 00 02 B8 03
					39 01 00 00 00 00 02 C0 03

					39 01 00 00 00 00 02 FF E0
					39 01 00 00 00 00 02 FB 01
					39 01 00 00 00 00 02 35 82

					39 01 00 00 00 00 02 FF F0
					39 01 00 00 00 00 02 FB 01
					39 01 00 00 00 00 02 5A 00
					39 01 00 00 00 00 02 1C 01
					39 01 00 00 00 00 02 33 01

					39 01 00 00 00 00 02 FF D0
					39 01 00 00 00 00 02 FB 01
					39 01 00 00 00 00 02 53 22
					39 01 00 00 00 00 02 54 02

					39 01 00 00 00 00 02 FF C0
					39 01 00 00 00 00 02 FB 01
					39 01 00 00 00 00 02 9C 11
					39 01 00 00 00 00 02 9D 11
					//CABC
					39 01 00 00 00 00 02 FF 23
					39 01 00 00 00 00 02 FB 01
					39 01 00 00 00 00 02 00 80
					39 01 00 00 00 00 02 05 22
					39 01 00 00 00 00 02 06 01
					39 01 00 00 00 00 02 07 00
					39 01 00 00 00 00 02 08 01
					39 01 00 00 00 00 02 09 00
					39 01 00 00 00 00 02 10 82
					39 01 00 00 00 00 02 11 01
					39 01 00 00 00 00 02 12 95
					39 01 00 00 00 00 02 15 68
					39 01 00 00 00 00 02 16 0B
					//CABC_PWM_UI
					39 01 00 00 00 00 02 30 FF
					39 01 00 00 00 00 02 31 FD
					39 01 00 00 00 00 02 32 FA
					39 01 00 00 00 00 02 33 F7
					39 01 00 00 00 00 02 34 F4
					39 01 00 00 00 00 02 35 F0
					39 01 00 00 00 00 02 36 ED
					39 01 00 00 00 00 02 37 EC
					39 01 00 00 00 00 02 38 EB
					39 01 00 00 00 00 02 39 EA
					39 01 00 00 00 00 02 3A E9
					39 01 00 00 00 00 02 3B E8
					39 01 00 00 00 00 02 3D E7
					39 01 00 00 00 00 02 3F E6
					39 01 00 00 00 00 02 40 E5
					39 01 00 00 00 00 02 41 E4
					//CABC_PWM_STILL
					39 01 00 00 00 00 02 45 FF
					39 01 00 00 00 00 02 46 FA
					39 01 00 00 00 00 02 47 F2
					39 01 00 00 00 00 02 48 E8
					39 01 00 00 00 00 02 49 E4
					39 01 00 00 00 00 02 4A DC
					39 01 00 00 00 00 02 4B D7
					39 01 00 00 00 00 02 4C D5
					39 01 00 00 00 00 02 4D D3
					39 01 00 00 00 00 02 4E D2
					39 01 00 00 00 00 02 4F D0
					39 01 00 00 00 00 02 50 CE
					39 01 00 00 00 00 02 51 CD
					39 01 00 00 00 00 02 52 CB
					39 01 00 00 00 00 02 53 C6
					39 01 00 00 00 00 02 54 C3

					39 01 00 00 00 00 02 FF 10
					//39 01 00 00 00 00 03 51 0F FF
					39 01 00 00 00 00 02 53 24
					39 01 00 00 00 00 02 55 01
					39 01 00 00 00 00 02 35 00
					15 01 00 00 0A 00 02 11 00
					15 01 00 00 46 00 02 29 00
				];

				qcom,mdss-dsi-pre-off-command = [
					39 01 00 00 00 00 03 51 00 00
				];

				qcom,mdss-dsi-off-command = [
					15 01 00 00 14 00 02 28 00
					15 01 00 00 78 00 02 10 00
				];

				qcom,mdss-dsi-gamma-nomal-command = [
					//CMD2_Page0
					39 00 00 00 00 00 02 FF 20
					39 00 00 00 00 00 02 FB 01
					//R(+)
					39 00 00 00 00 00 11 B0 00 00 00 15 00 39 00 59 00 70 00 87 00 9A 00 AB
					39 00 00 00 00 00 11 B1 00 BE 00 F4 01 1C 01 5A 01 8C 01 D6 02 11 02 13
					39 00 00 00 00 00 11 B2 02 4B 02 8B 02 B6 02 EE 03 11 03 3D 03 4C 03 5A
					39 00 00 00 00 00 0F B3 03 6C 03 81 03 A3 03 C1 03 D5 03 D8 00 00
					//G(+)
					39 00 00 00 00 00 11 B4 00 00 00 1C 00 44 00 62 00 7D 00 93 00 A7 00 B9
					39 00 00 00 00 00 11 B5 00 C8 00 FC 01 25 01 63 01 92 01 DB 02 15 02 17
					39 00 00 00 00 00 11 B6 02 4F 02 8E 02 BA 02 F1 03 14 03 40 03 4F 03 5E
					39 00 00 00 00 00 0F B7 03 71 03 88 03 A4 03 C1 03 D5 03 D8 00 00
					//B(+)
					39 00 00 00 00 00 11 B8 00 01 00 26 00 4F 00 71 00 87 00 9E 00 B1 00 C2
					39 00 00 00 00 00 11 B9 00 D5 01 09 01 2F 01 68 01 96 01 DE 02 18 02 1A
					39 00 00 00 00 00 11 BA 02 51 02 90 02 BA 02 EE 03 15 03 41 03 4E 03 5F
					39 00 00 00 00 00 0F BB 03 70 03 87 03 A3 03 C0 03 D5 03 D8 00 00
					//CMD2_Page1
					39 00 00 00 00 00 02 FF 21
					39 00 00 00 00 00 02 FB 01
					//R(-)
					39 00 00 00 00 00 11 B0 00 00 00 15 00 39 00 59 00 70 00 87 00 9A 00 AB
					39 00 00 00 00 00 11 B1 00 BE 00 F4 01 1C 01 5A 01 8C 01 D6 02 11 02 13
					39 00 00 00 00 00 11 B2 02 4B 02 8B 02 B6 02 EE 03 11 03 3D 03 4C 03 5A
					39 00 00 00 00 00 0F B3 03 6C 03 81 03 A3 03 C1 03 D5 03 D8 00 00
					//G(-)
					39 00 00 00 00 00 11 B4 00 00 00 1C 00 44 00 62 00 7D 00 93 00 A7 00 B9
					39 00 00 00 00 00 11 B5 00 C8 00 FC 01 25 01 63 01 92 01 DB 02 15 02 17
					39 00 00 00 00 00 11 B6 02 4F 02 8E 02 BA 02 F1 03 14 03 40 03 4F 03 5E
					39 00 00 00 00 00 0F B7 03 71 03 88 03 A4 03 C1 03 D5 03 D8 00 00
					//B(-)
					39 00 00 00 00 00 11 B8 00 01 00 26 00 4F 00 71 00 87 00 9E 00 B1 00 C2
					39 00 00 00 00 00 11 B9 00 D5 01 09 01 2F 01 68 01 96 01 DE 02 18 02 1A
					39 00 00 00 00 00 11 BA 02 51 02 90 02 BA 02 EE 03 15 03 41 03 4E 03 5F
					39 00 00 00 00 00 0F BB 03 70 03 87 03 A3 03 C0 03 D5 03 D8 00 00
					39 01 00 00 00 00 02 FF 10
					29 01 00 00 00 00 02 FB 01
				];

				qcom,mdss-dsi-gamma-lowbl-command = [
					//CMD2_Page0
					39 00 00 00 00 00 02 FF 20
					39 00 00 00 00 00 02 FB 01
					//Gamma Setting +
					39 00 00 00 00 00 11 B0 01 8C 01 8E 01 91 01 95 01 98 01 9C 01 9F 01 A3
					39 00 00 00 00 00 11 B1 01 A6 01 B4 01 C2 01 DC 01 F3 02 1E 02 49 02 4A
					39 00 00 00 00 00 11 B2 02 7A 02 B5 02 DF 03 10 03 30 03 58 03 65 03 74
					39 00 00 00 00 00 0F B3 03 85 03 9F 03 B6 03 C9 03 D6 03 D8 00 00
					39 00 00 00 00 00 11 B4 01 92 01 94 01 97 01 9B 01 9E 01 A1 01 A5 01 A8
					39 00 00 00 00 00 11 B5 01 AC 01 B9 01 C7 01 E1 01 F7 02 22 02 4D 02 4E
					39 00 00 00 00 00 11 B6 02 7D 02 B9 02 E2 03 13 03 33 03 5C 03 6A 03 79
					39 00 00 00 00 00 0F B7 03 8B 03 A1 03 B6 03 C9 03 D6 03 D8 00 00
					39 00 00 00 00 00 11 B8 01 96 01 98 01 9B 01 9E 01 A2 01 A5 01 A9 01 AC
					39 00 00 00 00 00 11 B9 01 AF 01 BD 01 CB 01 E4 01 FA 02 25 02 4F 02 50
					39 00 00 00 00 00 11 BA 02 7F 02 B9 02 E0 03 13 03 34 03 5D 03 69 03 78
					39 00 00 00 00 00 0F BB 03 8A 03 A0 03 B5 03 C8 03 D6 03 D8 00 00
					//CMD2_Page1
					39 00 00 00 00 00 02 FF 21
					39 00 00 00 00 00 02 FB 01
					//Gamma Setting -
					39 00 00 00 00 00 11 B0 01 8C 01 8E 01 91 01 95 01 98 01 9C 01 9F 01 A3
					39 00 00 00 00 00 11 B1 01 A6 01 B4 01 C2 01 DC 01 F3 02 1E 02 49 02 4A
					39 00 00 00 00 00 11 B2 02 7A 02 B5 02 DF 03 10 03 30 03 58 03 65 03 74
					39 00 00 00 00 00 0F B3 03 85 03 9F 03 B6 03 C9 03 D6 03 D8 00 00
					39 00 00 00 00 00 11 B4 01 92 01 94 01 97 01 9B 01 9E 01 A1 01 A5 01 A8
					39 00 00 00 00 00 11 B5 01 AC 01 B9 01 C7 01 E1 01 F7 02 22 02 4D 02 4E
					39 00 00 00 00 00 11 B6 02 7D 02 B9 02 E2 03 13 03 33 03 5C 03 6A 03 79
					39 00 00 00 00 00 0F B7 03 8B 03 A1 03 B6 03 C9 03 D6 03 D8 00 00
					39 00 00 00 00 00 11 B8 01 96 01 98 01 9B 01 9E 01 A2 01 A5 01 A9 01 AC
					39 00 00 00 00 00 11 B9 01 AF 01 BD 01 CB 01 E4 01 FA 02 25 02 4F 02 50
					39 00 00 00 00 00 11 BA 02 7F 02 B9 02 E0 03 13 03 34 03 5D 03 69 03 78
					39 00 00 00 00 00 0F BB 03 8A 03 A0 03 B5 03 C8 03 D6 03 D8 00 00
					39 01 00 00 00 00 02 FF 10
					29 01 00 00 00 00 02 FB 01
				];

				qcom,mdss-dsi-cabc-1-command = [
					29 01 00 00 00 00 02 FF 10
					29 01 00 00 00 00 02 FB 01
					15 01 00 00 00 00 02 53 2C
					15 01 00 00 00 00 02 55 01
				];
				qcom,mdss-dsi-cabc-2-command = [
					29 01 00 00 00 00 02 FF 10
					29 01 00 00 00 00 02 FB 01
					15 01 00 00 00 00 02 53 2C
					15 01 00 00 00 00 02 55 02
				];
				qcom,mdss-dsi-cabc-3-command = [
					29 01 00 00 00 00 02 FF 10
					29 01 00 00 00 00 02 FB 01
					15 01 00 00 00 00 02 53 2C
					15 01 00 00 00 00 02 55 02
				];
				qcom,mdss-dsi-cabc-off-command = [
					29 01 00 00 00 00 02 FF 10
					29 01 00 00 00 00 02 FB 01
					15 01 00 00 00 00 02 53 24
					15 01 00 00 00 00 02 55 00
				];

				qcom,mdss-dsi-on-command-state = "dsi_hs_mode";
				qcom,mdss-dsi-off-command-state = "dsi_hs_mode";
				qcom,mdss-dsi-gamma-nomal-command-state = "dsi_hs_mode";
				qcom,mdss-dsi-gamma-lowbl-command-state = "dsi_hs_mode";
				qcom,mdss-dsi-cabc-1-command-state = "dsi_hs_mode";
				qcom,mdss-dsi-cabc-2-command-state = "dsi_hs_mode";
				qcom,mdss-dsi-cabc-3-command-state = "dsi_hs_mode";
				qcom,mdss-dsi-cabc-off-command-state = "dsi_hs_mode";

				qcom,compression-mode = "dsc";
				qcom,mdss-dsc-slice-height = <8>;
				qcom,mdss-dsc-slice-width = <540>;
				qcom,mdss-dsc-slice-per-pkt = <1>;
				qcom,mdss-dsc-bit-per-component = <8>;
				qcom,mdss-dsc-bit-per-pixel = <8>;
				qcom,mdss-dsc-block-prediction-enable;
			};
		};
	};
};

&dsi_nt36672c_dsjm_video {
	qcom,panel-supply-entries = <&dsi_panel_pwr_supply_vddi>;
	qcom,mdss-dsi-bl-pmic-control-type = "bl_ctrl_dcs";
	qcom,bl-update-flag = "delay_until_first_frame";
	qcom,platform-te-gpio = <&tlmm 10 0>;
	qcom,platform-reset-gpio = <&pm8150l_gpios 3 0>;

	qcom,esd-check-enabled;
	qcom,mdss-dsi-panel-status-check-mode = "reg_read";
	qcom,mdss-dsi-panel-status-command = [06 01 00 01 00 00 01 0a];
	qcom,mdss-dsi-panel-status-command-state = "dsi_lp_mode";
	qcom,mdss-dsi-panel-status-value = <0x9c>;
	qcom,mdss-dsi-panel-status-read-length = <1>;

	oplus,tps65132_support;
	oplus,low-light-adjust-gamma-support;
	oplus,low-light-adjust-gamma-level = <13>;
	oplus,lcd-cabc-support;

	qcom,dsi-supported-dfps-list = <90 60 45>;
	qcom,mdss-dsi-pan-enable-dynamic-fps;
	qcom,mdss-dsi-pan-fps-update =
		"dfps_immediate_porch_mode_vfp";
	qcom,mdss-dsi-min-refresh-rate = <45>;
	qcom,mdss-dsi-max-refresh-rate = <90>;
	oplus,dfps-idle-off;

	qcom,dsi-select-clocks = "mux_byte_clk0", "mux_pixel_clk0";
	qcom,mdss-dsi-t-clk-post = <0x0F>;
	qcom,mdss-dsi-t-clk-pre = <0x1E>;
	qcom,mdss-dsi-display-timings {
		timing@0 {
			qcom,mdss-dsi-panel-phy-timings = [00 24 0A 0A 1A 24 0A 0A
										09 02 04 00 1E 0F];
			qcom,display-topology = <1 1 1>;
			qcom,default-topology-index = <0>;
		};
	};
};

&dsi_nt36672c_dsjm_video {
       qcom,panel_voltage_vddi_name = "vddio";
       qcom,panel_voltage_vddi = <0 1800000 1800000 1800000>;
       qcom,panel_voltage_vddr_name = "vddio";
       qcom,panel_voltage_vddr = <1 1800000 1800000 1800000>;
};
