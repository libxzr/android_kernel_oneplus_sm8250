/**********************************************************************************
* Copyright (c)  2008-2020  Guangdong oplus Mobile Comm Corp., Ltd
* Description: oplus ST nfc dtsi
*
* Version: 1.0
* Date: 2020-10-15
* Author: Lonzuming
*
* ------------------------------ Revision History: --------------------------------
* <version>           <date>                <author>                            <desc>
* Revision 1.0       2020-10-15            Lonzuming           Created for odin ST nfc dts
***********************************************************************************/
&soc {
    //add for nfc_chipset
    nfc_chipset {
        compatible = "oplus-nfc-chipset";
        chipset-20751 = "ST21H";
    };
};


//ifdef OPLUS_FEATURE_NFC_BRINGUP
&qupv3_se7_i2c {
    status = "ok";
    #address-cells = <1>;
    #size-cells = <0>;
    st21nfc@08 {
        compatible = "st,st21nfc";
        reg = <0x08>;
        irq-gpios = <&tlmm 9 0x00>;
        reset-gpios = <&tlmm 6 0x00>;
        clkreq-gpios = <&tlmm 7 0x00>;
        interrupt-parent = <&tlmm>;
        interrupts = <9 0>;
        interrupt-names = "nfc_irq";
        pinctrl-names = "nfc_active", "nfc_suspend";
        pinctrl-0 = <&nfc_int_active &nfc_enable_active>;
        pinctrl-1 = <&nfc_int_suspend &nfc_enable_suspend>;
    };
};
//endif OPLUS_FEATURE_NFC_BRINGUP
