&mdss_mdp {
	dsi_oplus19161boe_nt37800_1080_2400_cmd: qcom,mdss_dsi_oplus19161boe_nt37800_1080_2400_cmd {
		qcom,mdss-dsi-panel-name =
		  "boe nt37800 amoled fhd+ panel with DSC";
		qcom,mdss-dsi-panel-type = "dsi_cmd_mode";
		qcom,mdss-dsi-virtual-channel-id = <0>;
		qcom,mdss-dsi-stream = <0>;
		qcom,mdss-dsi-bpp = <24>;
		qcom,mdss-dsi-color-order = "rgb_swap_rgb";
		qcom,mdss-dsi-underflow-color = <0xff>;
		qcom,mdss-dsi-border-color = <0>;

		qcom,dsi-ctrl-num = <0>;
		qcom,dsi-phy-num = <0>;
		qcom,dsi-select-clocks = "src_byte_clk0", "src_pixel_clk0";

		qcom,mdss-dsi-traffic-mode = "non_burst_sync_event";
		qcom,mdss-dsi-lane-map = "lane_map_0123";
		qcom,mdss-dsi-bllp-eof-power-mode;
		qcom,mdss-dsi-bllp-power-mode;
		qcom,mdss-dsi-lane-0-state;
		qcom,mdss-dsi-lane-1-state;
		qcom,mdss-dsi-lane-2-state;
		qcom,mdss-dsi-lane-3-state;
		qcom,mdss-dsi-dma-trigger = "trigger_sw";
		qcom,mdss-dsi-mdp-trigger = "none";
		qcom,mdss-dsi-reset-sequence = <1 10>, <0 10>, <1 10>;
		qcom,mdss-dsi-te-pin-select = <1>;
		qcom,mdss-dsi-wr-mem-start = <0x2c>;
		qcom,mdss-dsi-wr-mem-continue = <0x3c>;
		qcom,mdss-dsi-te-dcs-command = <1>;
		qcom,mdss-dsi-te-check-enable;
		qcom,mdss-dsi-te-using-te-pin;
		qcom,mdss-dsi-lp11-init;
		qcom,mdss-dsi-panel-hdr-enabled;
		qcom,mdss-dsi-panel-hdr-color-primaries = <15000 15500 34000
			16000 13250 34500 7500 3000>;
		qcom,mdss-dsi-panel-peak-brightness = <4300000>;
		qcom,mdss-dsi-panel-blackness-level = <1023>;
		qcom,mdss-pan-physical-width-dimension = <68>;
		qcom,mdss-pan-physical-height-dimension = <152>;
		qcom,esd-check-enabled;
		qcom,mdss-dsi-panel-status-check-mode = "reg_read";
		qcom,mdss-dsi-panel-status-command = [06 01 00 01 05 00 02 0A 00];
		qcom,mdss-dsi-panel-status-command-state = "dsi_hs_mode";
		qcom,mdss-dsi-panel-status-value = <0x9C>;
		qcom,mdss-dsi-panel-status-read-length = <1>;

		qcom,mdss-dsi-display-timings {
			timing@0{
				qcom,mdss-dsi-panel-clockrate = <652800000>;
				qcom,mdss-mdp-transfer-time-us = <9000>;
				qcom,mdss-dsi-panel-framerate = <90>; /* 90 FPS */
				qcom,mdss-dsi-panel-width = <1080>;
				qcom,mdss-dsi-panel-height = <2400>;
				qcom,mdss-dsi-h-front-porch = <128>;
				qcom,mdss-dsi-h-back-porch = <128>;
				qcom,mdss-dsi-h-pulse-width = <32>;
				qcom,mdss-dsi-h-sync-skew = <0>;
				qcom,mdss-dsi-h-sync-pulse = <0>;
				qcom,mdss-dsi-v-back-porch = <16>;
				qcom,mdss-dsi-v-front-porch = <32>;
				qcom,mdss-dsi-v-pulse-width = <3>;
				qcom,mdss-dsi-h-left-border = <0>;
				qcom,mdss-dsi-h-right-border = <0>;
				qcom,mdss-dsi-v-top-border = <0>;
				qcom,mdss-dsi-v-bottom-border = <0>;
				qcom,mdss-dsi-panel-jitter = <0x4 0x1>;
				oplus,fod-on-vblank = <1>;
				oplus,fod-off-vblank = <1>;
				qcom,mdss-dsi-timing-switch-command = [
					39 01 00 00 00 00 06 F0 55 AA 52 08 00
					15 01 00 00 00 00 02 6F 03
					39 01 00 00 00 00 04 C0 00 00 00
					15 01 00 00 00 00 02 26 02
				];
				qcom,mdss-dsi-on-command = [
					39 01 00 00 00 00 06 F0 55 AA 52 08 00
					39 01 00 00 00 00 03 B5 84 00
					15 01 00 00 00 00 02 6F 05
					39 01 00 00 00 00 05 B5 39 00 11 00
					15 01 00 00 00 00 02 6F 0B
					39 01 00 00 00 00 04 B5 2B 2B 33
					39 01 00 00 00 00 0A B7 47 A8 76 65 43 D7 10 FF C0
					39 01 00 00 00 00 16 B2 00 60 20 20 00 08 08 00 00 20 00 00 00 20 00 00 00 00 00 00 00
					39 01 00 00 00 00 0D B3 00 01 00 80 00 80 00 AF 00 AF 00 E5
					15 01 00 00 00 00 02 6F 0C
					39 01 00 00 00 00 0D B3 00 E5 01 5B 01 5B 01 F2 01 F2 02 58
					15 01 00 00 00 00 02 6F 18
					39 01 00 00 00 00 0D B3 02 58 03 00 03 00 06 F4 06 F4 0F FF
					15 01 00 00 00 00 02 6F 24
					39 01 00 00 00 00 09 B3 02 A0 0F 87 0F 87 0F FF
					39 01 00 00 00 00 0B B4 99 88 88 66 44 22 00 00 00 00
					15 01 00 00 00 00 02 6F 0A
					39 01 00 00 00 00 0B B4 40 40 DF DF 1D 1D FC FC E8 E8
					15 01 00 00 00 00 02 6F 14
					39 01 00 00 00 00 0A B4 8C 8C F2 F2 28 28 28 28 28
					15 01 00 00 00 00 02 6F 24
					39 01 00 00 00 00 0B B4 00 28 00 28 00 28 00 28 00 28
					39 01 00 00 00 00 03 B9 10 00
					39 01 00 00 00 00 09 BA 01 D4 00 08 00 08 80 01
					15 01 00 00 00 00 02 6F 08
					39 01 00 00 00 00 09 BA 01 D4 00 08 00 08 00 10
					15 01 00 00 00 00 02 6F 10
					39 01 00 00 00 00 0F BA 01 D4 00 08 00 08 02 30 00 08 00 08 00 00
					39 01 00 00 00 00 09 BB 01 D4 00 08 00 08 00 31
					39 01 00 00 00 00 04 BD FF 00 FF
					39 01 00 00 00 00 06 BE 0E 11 10 1F 1F
					39 01 00 00 00 00 03 C0 76 73
					15 01 00 00 00 00 02 6F 02
					15 01 00 00 00 00 02 C0 00
					15 01 00 00 00 00 02 6F 0E
					15 01 00 00 00 00 02 BA 18
					15 01 00 00 00 00 02 6F 03
					39 01 00 00 00 00 04 C0 00 00 00
					39 01 00 00 00 00 03 C1 00 70
					15 01 00 00 00 00 02 C2 01
					39 01 00 00 00 00 07 C3 00 00 00 00 00 00
					39 01 00 00 00 00 03 C5 13 00
					39 01 00 00 00 00 05 C6 3F 00 00 00
					15 01 00 00 00 00 02 C8 0D
					15 01 00 00 00 00 02 C9 84
					15 01 00 00 00 00 02 CA 33
					15 01 00 00 00 00 02 CB 88
					15 01 00 00 00 00 02 6F 22
					39 01 00 00 00 00 03 DF 00 80
					39 01 00 00 00 00 06 F0 55 AA 52 08 01
					39 01 00 00 00 00 03 B0 00 00
					39 01 00 00 00 00 03 B3 14 01
					39 01 00 00 00 00 07 B7 1A 1A 1A 1A 1A 1A
					39 01 00 00 00 00 03 B1 00 00
					39 01 00 00 00 00 03 B4 05 01
					39 01 00 00 00 00 05 B8 41 41 41 41
					39 01 00 00 00 00 07 B5 00 DF 00 DF 00 DF
					39 01 00 00 00 00 07 B6 00 50 00 50 00 50
					39 01 00 00 00 00 09 B9 00 2E 00 2E 00 2E 00 2E
					39 01 00 00 00 00 05 BA 10 14 10 14
					39 01 00 00 00 00 03 CD 05 82
					15 01 00 00 00 00 02 C7 01
					15 01 00 00 00 00 02 6F 01
					39 01 00 00 00 00 04 CE 28 01 00
					39 01 00 00 00 00 05 CF 0D 02 14 00
					39 01 00 00 00 00 0D C2 00 DF 00 50 00 DF 00 50 00 DF 00 50
					15 01 00 00 00 00 02 6F 04
					15 01 00 00 00 00 02 DF 00
					39 01 00 00 00 00 06 F0 55 AA 52 08 02
					15 01 00 00 00 00 02 CC 30
					39 01 00 00 00 00 06 F0 55 AA 52 08 02
					15 01 00 00 00 00 02 BF 09
					39 01 00 00 00 00 19 B0 00 00 00 00 00 00 00 00 00 09 00 26 00 3D 00 51 00 63 00 75 00 83 00 9F
					39 01 00 00 00 00 19 B1 00 CD 00 F4 01 15 01 33 01 4C 01 7A 01 A1 01 C7 01 EB 02 10 02 31 02 54
					39 01 00 00 00 00 17 B2 02 65 02 78 02 86 02 9C 02 AD 02 BF 02 D1 02 E2 02 F4 03 FF 03 FF
					39 01 00 00 00 00 19 B3 00 00 00 00 00 00 00 05 00 13 00 21 00 2D 00 39 00 45 00 51 00 5A 00 6E
					39 01 00 00 00 00 19 B4 00 90 00 AD 00 C6 00 DD 00 F1 01 17 01 37 01 56 01 74 01 91 01 AC 01 C8
					39 01 00 00 00 00 17 B5 01 D5 01 E2 01 F0 01 FD 02 0B 02 18 02 26 02 33 02 41 02 FF 03 FF
					39 01 00 00 00 00 19 B6 00 00 00 00 00 00 00 3E 00 4C 00 5F 00 71 00 82 00 92 00 A2 00 AE 00 C8
					39 01 00 00 00 00 19 B7 00 F3 01 18 01 38 01 55 01 6E 01 9A 01 C1 01 E7 02 0C 02 31 02 53 02 76
					39 01 00 00 00 00 17 B8 02 87 02 9B 02 A9 02 C1 02 D2 02 E4 02 F6 03 07 03 19 03 FF 03 FF
					15 01 00 00 00 00 02 BF 08
					39 01 00 00 00 00 19 B0 00 00 00 00 00 00 00 00 00 09 00 26 00 3D 00 51 00 63 00 75 00 83 00 9F
					39 01 00 00 00 00 19 B1 00 CD 00 F4 01 15 01 33 01 4C 01 7A 01 A1 01 C7 01 EB 02 10 02 31 02 54
					39 01 00 00 00 00 17 B2 02 65 02 78 02 86 02 9C 02 AD 02 BF 02 D1 02 E2 02 F4 03 03 03 04
					39 01 00 00 00 00 19 B3 00 00 00 00 00 00 00 05 00 13 00 21 00 2D 00 39 00 45 00 51 00 5A 00 6E
					39 01 00 00 00 00 19 B4 00 90 00 AD 00 C6 00 DD 00 F1 01 17 01 37 01 56 01 74 01 91 01 AC 01 C8
					39 01 00 00 00 00 17 B5 01 D5 01 E2 01 F0 01 FD 02 0B 02 18 02 26 02 33 02 41 02 4F 02 50
					39 01 00 00 00 00 19 B6 00 00 00 00 00 00 00 3E 00 4C 00 5F 00 71 00 82 00 92 00 A2 00 AE 00 C8
					39 01 00 00 00 00 19 B7 00 F3 01 18 01 38 01 55 01 6E 01 9A 01 C1 01 E7 02 0C 02 31 02 53 02 76
					39 01 00 00 00 00 17 B8 02 87 02 9B 02 A9 02 C1 02 D2 02 E4 02 F6 03 07 03 19 03 27 03 28
					15 01 00 00 00 00 02 BF 07
					39 01 00 00 00 00 19 B0 00 00 00 00 00 00 00 00 00 09 00 26 00 3D 00 51 00 63 00 75 00 83 00 9F
					39 01 00 00 00 00 19 B1 00 CD 00 F4 01 15 01 33 01 4C 01 7A 01 A1 01 C7 01 EB 02 10 02 31 02 54
					39 01 00 00 00 00 17 B2 02 65 02 78 02 86 02 9C 02 AD 02 BF 02 D1 02 E2 02 F4 03 03 03 04
					39 01 00 00 00 00 19 B3 00 00 00 00 00 00 00 05 00 13 00 21 00 2D 00 39 00 45 00 51 00 5A 00 6E
					39 01 00 00 00 00 19 B4 00 90 00 AD 00 C6 00 DD 00 F1 01 17 01 37 01 56 01 74 01 91 01 AC 01 C8
					39 01 00 00 00 00 17 B5 01 D5 01 E2 01 F0 01 FD 02 0B 02 18 02 26 02 33 02 41 02 4F 02 50
					39 01 00 00 00 00 19 B6 00 00 00 00 00 00 00 3E 00 4C 00 5F 00 71 00 82 00 92 00 A2 00 AE 00 C8
					39 01 00 00 00 00 19 B7 00 F3 01 18 01 38 01 55 01 6E 01 9A 01 C1 01 E7 02 0C 02 31 02 53 02 76
					39 01 00 00 00 00 17 B8 02 87 02 9B 02 A9 02 C1 02 D2 02 E4 02 F6 03 07 03 19 03 27 03 28
					15 01 00 00 00 00 02 BF 06
					39 01 00 00 00 00 19 B0 00 00 00 00 00 00 00 00 00 09 00 26 00 3D 00 51 00 63 00 75 00 83 00 9F
					39 01 00 00 00 00 19 B1 00 CD 00 F4 01 15 01 33 01 4C 01 7A 01 A1 01 C7 01 EB 02 10 02 31 02 54
					39 01 00 00 00 00 17 B2 02 65 02 78 02 86 02 9C 02 AD 02 BF 02 D1 02 E2 02 F4 03 03 03 04
					39 01 00 00 00 00 19 B3 00 00 00 00 00 00 00 05 00 13 00 21 00 2D 00 39 00 45 00 51 00 5A 00 6E
					39 01 00 00 00 00 19 B4 00 90 00 AD 00 C6 00 DD 00 F1 01 17 01 37 01 56 01 74 01 91 01 AC 01 C8
					39 01 00 00 00 00 17 B5 01 D5 01 E2 01 F0 01 FD 02 0B 02 18 02 26 02 33 02 41 02 4F 02 50
					39 01 00 00 00 00 19 B6 00 00 00 00 00 00 00 3E 00 4C 00 5F 00 71 00 82 00 92 00 A2 00 AE 00 C8
					39 01 00 00 00 00 19 B7 00 F3 01 18 01 38 01 55 01 6E 01 9A 01 C1 01 E7 02 0C 02 31 02 53 02 76
					39 01 00 00 00 00 17 B8 02 87 02 9B 02 A9 02 C1 02 D2 02 E4 02 F6 03 07 03 19 03 27 03 28
					15 01 00 00 00 00 02 BF 05
					39 01 00 00 00 00 19 B0 00 00 00 00 00 00 00 00 00 09 00 26 00 3D 00 51 00 63 00 75 00 83 00 9F
					39 01 00 00 00 00 19 B1 00 CD 00 F4 01 15 01 33 01 4C 01 7A 01 A1 01 C7 01 EB 02 10 02 31 02 54
					39 01 00 00 00 00 17 B2 02 65 02 78 02 86 02 9C 02 AD 02 BF 02 D1 02 E2 02 F4 03 03 03 04
					39 01 00 00 00 00 19 B3 00 00 00 00 00 00 00 05 00 13 00 21 00 2D 00 39 00 45 00 51 00 5A 00 6E
					39 01 00 00 00 00 19 B4 00 90 00 AD 00 C6 00 DD 00 F1 01 17 01 37 01 56 01 74 01 91 01 AC 01 C8
					39 01 00 00 00 00 17 B5 01 D5 01 E2 01 F0 01 FD 02 0B 02 18 02 26 02 33 02 41 02 4F 02 50
					39 01 00 00 00 00 19 B6 00 00 00 00 00 00 00 3E 00 4C 00 5F 00 71 00 82 00 92 00 A2 00 AE 00 C8
					39 01 00 00 00 00 19 B7 00 F3 01 18 01 38 01 55 01 6E 01 9A 01 C1 01 E7 02 0C 02 31 02 53 02 76
					39 01 00 00 00 00 17 B8 02 87 02 9B 02 A9 02 C1 02 D2 02 E4 02 F6 03 07 03 19 03 27 03 28
					15 01 00 00 00 00 02 BF 04
					39 01 00 00 00 00 19 B0 00 00 00 00 00 00 00 00 00 09 00 26 00 3D 00 51 00 63 00 75 00 83 00 9F
					39 01 00 00 00 00 19 B1 00 CD 00 F4 01 15 01 33 01 4C 01 7A 01 A1 01 C7 01 EB 02 10 02 31 02 54
					39 01 00 00 00 00 17 B2 02 65 02 78 02 86 02 9C 02 AD 02 BF 02 D1 02 E2 02 F4 03 03 03 04
					39 01 00 00 00 00 19 B3 00 00 00 00 00 00 00 05 00 13 00 21 00 2D 00 39 00 45 00 51 00 5A 00 6E
					39 01 00 00 00 00 19 B4 00 90 00 AD 00 C6 00 DD 00 F1 01 17 01 37 01 56 01 74 01 91 01 AC 01 C8
					39 01 00 00 00 00 17 B5 01 D5 01 E2 01 F0 01 FD 02 0B 02 18 02 26 02 33 02 41 02 4F 02 50
					39 01 00 00 00 00 19 B6 00 00 00 00 00 00 00 3E 00 4C 00 5F 00 71 00 82 00 92 00 A2 00 AE 00 C8
					39 01 00 00 00 00 19 B7 00 F3 01 18 01 38 01 55 01 6E 01 9A 01 C1 01 E7 02 0C 02 31 02 53 02 76
					39 01 00 00 00 00 17 B8 02 87 02 9B 02 A9 02 C1 02 D2 02 E4 02 F6 03 07 03 19 03 27 03 28
					15 01 00 00 00 00 02 BF 03
					39 01 00 00 00 00 19 B0 00 00 00 00 00 00 00 00 00 05 00 16 00 2D 00 41 00 52 00 62 00 72 00 8B
					39 01 00 00 00 00 19 B1 00 B7 00 DD 00 FD 01 1A 01 34 01 5E 01 85 01 A7 01 C8 01 E8 02 08 02 26
					39 01 00 00 00 00 17 B2 02 34 02 44 02 53 02 62 02 72 02 80 02 90 02 A2 02 B1 02 C1 02 C2
					39 01 00 00 00 00 19 B3 00 00 00 00 00 00 00 03 00 0D 00 19 00 25 00 2F 00 3A 00 44 00 4F 00 60
					39 01 00 00 00 00 19 B4 00 80 00 9C 00 B4 00 CA 00 DE 01 00 01 20 01 3C 01 57 01 71 01 8B 01 A3
					39 01 00 00 00 00 17 B5 01 AF 01 BB 01 C7 01 D3 01 DE 01 EA 01 F6 02 02 02 0E 02 19 02 1A
					39 01 00 00 00 00 19 B6 00 00 00 00 00 00 00 2B 00 46 00 55 00 65 00 74 00 83 00 91 00 9F 00 B6
					39 01 00 00 00 00 19 B7 00 DF 01 02 01 21 01 3D 01 56 01 7F 01 A5 01 C7 01 E8 02 08 02 29 02 47
					39 01 00 00 00 00 17 B8 02 56 02 66 02 75 02 84 02 95 02 A3 02 B4 02 C7 02 D6 02 E6 02 E7
					15 01 00 00 00 00 02 BF 02
					39 01 00 00 00 00 19 B0 00 00 00 00 00 00 00 00 00 00 00 00 00 00 00 11 00 21 00 2F 00 3C 00 53
					39 01 00 00 00 00 19 B1 00 7B 00 9B 00 B8 00 D1 00 E7 01 0F 01 32 01 4F 01 6B 01 84 01 97 01 B4
					39 01 00 00 00 00 17 B2 01 BE 01 C8 01 D1 01 E0 01 E8 01 F1 01 FD 02 05 02 11 02 19 02 19
					39 01 00 00 00 00 19 B3 00 00 00 00 00 00 00 00 00 00 00 05 00 0F 00 16 00 1E 00 25 00 2C 00 3A
					39 01 00 00 00 00 19 B4 00 54 00 6B 00 80 00 92 00 A3 00 C1 00 DC 00 F3 01 09 01 1D 01 2F 01 44
					39 01 00 00 00 00 17 B5 01 4C 01 56 01 5E 01 67 01 6F 01 78 01 80 01 88 01 90 01 98 01 98
					39 01 00 00 00 00 19 B6 00 00 00 00 00 00 00 00 00 00 00 3C 00 46 00 51 00 5B 00 66 00 70 00 84
					39 01 00 00 00 00 19 B7 00 A7 00 C4 00 DF 00 F6 01 0B 01 32 01 54 01 71 01 8C 01 A5 01 B7 01 D5
					39 01 00 00 00 00 17 B8 01 DF 01 E9 01 F1 02 01 02 09 02 12 02 1E 02 26 02 32 02 3A 02 3A
					15 01 00 00 00 00 02 BF 01
					39 01 00 00 00 00 19 B0 00 00 00 00 00 00 00 00 00 00 00 13 00 27 00 39 00 00 01 38 39 01 01 3A
					39 01 00 00 00 00 19 B1 01 3B 01 3C 01 3D 01 3E 01 3F 01 40 01 41 01 42 01 43 01 44 01 45 01 46
					39 01 00 00 00 00 17 B2 01 47 01 48 01 49 01 4A 01 4B 01 52 01 59 01 61 01 67 01 6C 01 6D
					39 01 00 00 00 00 19 B3 00 00 00 00 00 00 00 00 00 06 00 0F 00 1A 00 25 00 00 00 28 00 2A 00 2E
					39 01 00 00 00 00 19 B4 00 36 00 3E 00 46 00 4E 00 56 00 66 00 76 00 86 00 96 00 A6 00 B6 00 C6
					39 01 00 00 00 00 17 B5 00 CE 00 D6 00 DE 00 E6 00 EE 00 F4 00 FA 01 00 01 06 01 0A 01 0B
					39 01 00 00 00 00 19 B6 00 00 00 00 00 00 00 00 00 3B 00 4A 00 5A 00 6A 00 00 01 59 01 5A 01 5B
					39 01 00 00 00 00 19 B7 01 5C 01 5D 01 5E 01 5F 01 60 01 61 01 62 01 63 01 64 01 65 01 66 01 67
					39 01 00 00 00 00 17 B8 01 68 01 69 01 6A 01 6B 01 6C 01 73 01 7A 01 82 01 88 01 8C 01 8D
					15 01 00 00 00 00 02 BF 00
					39 01 00 00 00 00 19 B0 00 00 00 00 00 00 00 00 00 00 00 00 00 00 00 00 00 00 00 00 00 00 00 00
					39 01 00 00 00 00 19 B1 00 00 00 09 00 18 00 29 00 37 00 A3 01 39 01 3A 01 3A 01 3B 01 3B 01 3C
					39 01 00 00 00 00 17 B2 01 3C 01 3C 01 3C 01 3C 01 3D 01 3D 01 3D 01 3D 01 3D 01 3E 01 3E
					39 01 00 00 00 00 19 B3 00 00 00 00 00 00 00 00 00 00 00 00 00 00 00 00 00 00 00 00 00 00 00 00
					39 01 00 00 00 00 19 B4 00 04 00 0A 00 12 00 1B 00 24 00 15 00 2A 00 2E 00 31 00 34 00 37 00 3B
					39 01 00 00 00 00 17 B5 00 3C 00 3E 00 3F 00 41 00 43 00 44 00 46 00 48 00 49 00 4B 00 4B
					39 01 00 00 00 00 19 B6 00 00 00 00 00 00 00 00 00 00 00 00 00 00 00 00 00 00 00 00 00 00 00 00
					39 01 00 00 00 00 19 B7 00 26 00 42 00 4E 00 5B 00 68 00 B5 01 5A 01 5B 01 5B 01 5C 01 5C 01 5D
					39 01 00 00 00 00 17 B8 01 5D 01 5D 01 5D 01 5D 01 5E 01 5E 01 5E 01 5E 01 5E 01 5F 01 5F
					15 01 00 00 00 00 02 CE 01
					15 01 00 00 00 00 02 CC 00
					39 01 00 00 00 00 06 F0 55 AA 52 08 02
					39 01 00 00 00 00 19 B9 00 04 00 0C 00 14 00 1C 00 24 00 2C 00 34 00 3C 00 44 00 4C 00 5C 00 7C
					39 01 00 00 00 00 19 BA 00 9C 00 BC 00 DC 00 FC 01 3C 01 7C 01 BC 01 FC 02 3C 02 7C 02 BC 02 DC
					39 01 00 00 00 00 15 BB 02 FC 03 1C 03 3C 03 5C 03 7C 03 9C 03 BC 03 DC 03 FC 03 FF
					39 01 00 00 00 00 06 F0 55 AA 52 08 02
					15 01 00 00 00 00 02 CC 00
					15 01 00 00 00 00 02 BF 0A
					39 01 00 00 00 00 19 B0 00 00 00 00 00 00 00 00 00 00 00 0B 00 21 00 33 00 43 00 53 00 61 00 7C
					39 01 00 00 00 00 19 B1 00 A6 00 CA 00 E8 01 04 01 1C 01 44 01 6B 01 8E 01 AB 01 C8 01 E5 02 00
					39 01 00 00 00 00 17 B2 02 0E 02 1C 02 2A 02 39 02 43 02 53 02 5E 02 70 02 7B 02 85 02 86
					39 01 00 00 00 00 19 B3 00 00 00 00 00 00 00 00 00 07 00 12 00 1C 00 26 00 2F 00 39 00 42 00 53
					39 01 00 00 00 00 19 B4 00 71 00 8C 00 A2 00 B7 00 CA 00 E9 01 07 01 24 01 3E 01 56 01 6D 01 83
					39 01 00 00 00 00 17 B5 01 8E 01 99 01 A4 01 AF 01 B9 01 C3 01 CE 01 D8 01 E3 01 ED 01 EE
					39 01 00 00 00 00 19 B6 00 00 00 00 00 00 00 00 00 3F 00 4A 00 59 00 67 00 74 00 82 00 8E 00 A6
					39 01 00 00 00 00 19 B7 00 CC 00 EE 01 0B 01 26 01 3E 01 65 01 8B 01 AE 01 CB 01 E8 02 05 02 21
					39 01 00 00 00 00 17 B8 02 2F 02 3D 02 4B 02 5B 02 65 02 75 02 80 02 93 02 9E 02 A8 02 A9
					15 01 00 00 00 00 02 BC 11
					39 01 00 00 00 00 11 BD 96 00 69 00 00 96 00 69 BB 44 44 BB EE 11 11 EE
					15 01 00 00 00 00 02 C1 02
					39 01 00 00 00 00 09 C2 19 00 91 00 19 00 91 00
					39 01 00 00 00 00 03 C0 00 00
					39 01 00 00 00 00 06 F0 55 AA 52 08 03
					39 01 00 00 00 00 06 B0 00 00 00 00 02
					39 01 00 00 00 00 0B B2 00 00 0A 06 01 00 00 0A 06 01
					39 01 00 00 00 00 0B B3 00 00 00 04 26 00 00 00 04 26
					39 01 00 00 00 00 07 B4 00 00 00 00 00 00
					39 01 00 00 00 00 16 B6 03 00 00 00 00 00 00 00 08 00 00 00 00 00 08 00 00 00 00 00 00
					39 01 00 00 00 00 08 BB 11 00 23 63 00 23 63
					39 01 00 00 00 00 08 BC 22 10 19 5A 00 19 5A
					39 01 00 00 00 00 04 C3 00 00 0A
					39 01 00 00 00 00 06 F0 55 AA 52 08 05
					39 01 00 00 00 00 04 B0 03 23 00
					39 01 00 00 00 00 03 B3 88 80
					39 01 00 00 00 00 03 B5 04 05
					39 01 00 00 00 00 03 B6 86 85
					39 01 00 00 00 00 05 B7 04 00 00 05
					39 01 00 00 00 00 05 B8 04 00 00 05
					39 01 00 00 00 00 03 C7 03 01
					15 01 00 00 00 00 02 CA 33
					39 01 00 00 00 00 04 CB 33 33 33
					15 01 00 00 00 00 02 D8 22
					15 01 00 00 00 00 02 D9 01
					39 01 00 00 00 00 04 D0 00 02 10
					39 01 00 00 00 00 04 D1 00 04 10
					39 01 00 00 00 00 05 E0 02 00 00 00
					39 01 00 00 00 00 05 E1 02 00 00 00
					39 01 00 00 00 00 03 EC 01 11
					39 01 00 00 00 00 06 F0 55 AA 52 08 06
					39 01 00 00 00 00 06 B0 34 34 0D 0D 0C
					39 01 00 00 00 00 06 B1 0C 11 11 10 10
					39 01 00 00 00 00 06 B2 04 04 00 00 34
					39 01 00 00 00 00 06 B3 34 34 34 34 34
					39 01 00 00 00 00 05 B4 34 34 34 34
					39 01 00 00 00 00 06 B6 34 34 0D 0D 0C
					39 01 00 00 00 00 06 B7 0C 11 11 10 10
					39 01 00 00 00 00 06 B8 04 04 00 00 34
					39 01 00 00 00 00 06 B9 34 34 34 34 34
					39 01 00 00 00 00 05 BA 34 34 34 34
					15 01 00 00 00 00 02 D0 01
					39 01 00 00 00 00 06 F0 55 AA 52 08 07
					39 01 00 00 00 00 07 B0 A4 40 70 60 00 00
					39 01 00 00 00 00 18 B1 08 18 00 18 08 00 00 00 00 00 00 00 00 00 00 00 00 00 00 00 00 00 00
					39 01 00 00 00 00 B5 B2 20 20 20 20 20 20 20 20 20 20 20 20 20 20 20 20 20 20 20 20 20 20 20 20 20 20 20 20 20 20 20 20 20 20 20 20 20 20 20 20 20 20 20 20 20 20 20 20 20 20 20 20 20 20 32 32 32 32 32 32 32 32 32 00 00 00 00 00 00 00 00 00 32 32 32 32 32 32 32 32 32 00 00 00 00 00 00 00 00 00 32 32 32 32 32 32 32 32 32 00 00 00 00 00 00 00 00 00 32 32 32 32 32 32 32 32 32 00 00 00 00 00 00 00 00 00 32 32 32 32 32 32 32 32 32 00 00 00 00 00 00 00 00 00 32 32 32 32 32 32 32 32 32 00 00 00 00 00 00 00 00 00 00 00 20 00 20 00 00 00 00 00 32 00 00 00 32 00 00 00
					39 01 00 00 00 00 5B B3 00 00 00 00 00 00 00 00 00 00 00 00 00 00 00 00 00 00 00 00 00 00 00 00 00 00 00 00 00 00 00 00 00 00 00 00 00 00 00 00 00 00 00 00 00 00 00 00 00 00 00 00 00 00 00 00 00 00 00 00 00 00 00 00 00 00 00 00 00 00 00 00 00 00 00 00 00 00 00 00 00 00 00 00 00 00 00 00 00 00
					39 01 00 00 00 00 1B B4 C0 00 00 00 00 00 00 00 00 00 00 00 00 00 80 80 80 80 50 80 80 70 80 80 49 80
					39 01 00 00 00 00 49 B5 00 00 00 00 00 00 00 00 00 00 00 00 00 00 00 00 00 00 00 00 00 00 04 00 00 00 00 00 00 00 00 00 00 00 00 00 00 00 00 00 00 00 00 00 00 00 00 00 00 00 00 00 00 00 00 00 00 00 00 00 00 00 00 00 00 00 00 00 00 00 00 00
					39 01 00 00 00 00 25 B6 00 00 00 00 00 00 00 00 00 00 00 00 00 00 00 00 00 00 00 00 00 00 00 00 E0 00 E0 00 00 00 E0 00 E0 00 00 00
					39 01 00 00 00 00 50 B7 24 84 00 08 01 08 01 00 00 00 00 00 00 00 00 00 00 00 00 00 00 00 00 00 00 00 00 00 00 00 00 00 00 00 00 00 00 00 00 00 00 00 00 FD 58 0E A5 78 2A 1A 77 FE CF 7E 0D E5 B2 B7 87 CC 14 80 80 80 80 80 80 80 80 80 80 80 80 80 80 80 80 80 80
					39 01 00 00 00 00 58 B8 00 00 00 00 00 00 00 00 00 00 00 00 00 00 00 00 00 00 00 02 02 00 00 00 00 00 00 00 00 00 00 00 00 00 00 00 00 00 00 00 00 00 00 00 00 00 00 00 00 00 00 00 00 00 00 00 00 00 00 00 00 00 00 00 00 00 00 00 00 00 00 00 00 00 00 00 00 00 00 00 00 00 00 00 00 00 00
					39 01 00 00 00 00 C1 B9 00 00 00 00 00 00 00 00 00 00 00 00 00 00 00 00 00 00 00 00 00 00 00 00 00 00 00 00 00 00 00 00 00 00 00 00 00 00 00 00 00 00 00 00 00 00 00 00 00 00 00 00 00 00 00 00 00 00 00 00 00 00 00 00 00 00 00 00 00 00 00 00 00 00 00 00 00 00 00 00 00 00 00 00 00 00 00 00 00 00 00 00 00 00 00 00 00 00 00 00 00 00 00 00 00 00 00 00 00 00 00 00 00 00 00 00 00 00 00 00 00 00 00 00 00 00 00 00 00 00 00 00 00 00 00 00 00 00 00 00 00 00 00 00 00 00 00 00 00 00 00 00 00 00 00 00 00 00 00 00 00 00 00 00 00 00 00 00 00 00 00 00 00 00 00 00 00 00 00 00 00 00 00 00 00 00 00 00 00 00 00 00
					39 01 00 00 00 00 20 BA 00 00 00 00 00 00 00 00 00 00 00 00 00 00 00 00 00 00 00 00 00 00 00 00 00 00 00 00 00 00 00
					39 01 00 00 00 00 88 BB 00 00 00 00 00 00 00 00 00 00 00 00 00 00 00 00 00 00 00 00 00 00 00 00 00 00 00 00 00 00 00 00 00 00 00 00 00 00 00 00 00 00 00 00 00 00 00 00 00 00 00 00 00 00 00 00 00 00 00 00 00 00 00 00 00 00 00 00 00 00 00 00 00 00 00 00 00 00 00 00 00 00 00 00 00 00 00 00 00 00 00 00 00 00 00 00 00 00 00 00 00 00 00 00 00 00 00 00 00 00 00 00 00 00 00 00 00 00 00 00 00 00 00 00 00 00 00 00 00 00 00 00 00 00 00
					39 01 00 00 00 00 14 BC 00 00 00 00 00 00 00 00 00 00 00 00 00 00 00 00 00 00 00
					39 01 00 00 00 00 0D BD 00 00 00 00 00 00 00 00 00 00 00 00

					39 01 00 00 00 00 06 F0 55 AA 52 08 07
					15 01 00 00 00 00 02 C0 11
					39 01 00 00 00 00 27 C1 60 3C 03 10 F7 78 05 F1 3F FD D2 A0 3F FB CF E8 00 00 63 10 90 1A 00 1B 00 00 76 1C 00 00 00 00 1A 1C F7 FF FF FF
					39 01 00 00 00 00 27 C2 48 3C 01 69 FC 24 02 A4 3F FD 61 7C 3F FE 5E C8 00 00 40 60 24 4F 00 00 1D 00 1A 6C F7 FF FF F7 FF FF F7 FF FF FF
					39 01 00 00 00 00 27 C3 64 00 03 10 07 A8 04 C9 3F FC FC 40 00 03 03 C0 00 00 00 00 00 1C 90 1B 43 90 76 5F 90 00 43 90 1A 5E F7 FF FF FF
					39 01 00 00 00 00 27 C4 4C 00 01 90 04 10 02 A4 3F FC 08 60 00 00 00 00 00 00 00 00 00 50 80 00 F2 90 1A 42 90 00 43 90 1A 5E F7 FF FF FF
					39 01 00 00 00 00 27 C5 6A 3C 02 D9 F8 68 05 10 00 00 CD 08 00 05 44 50 7F FF 63 61 00 00 93 C2 44 94 1A 5F 94 1B 44 94 36 5E F7 FF FF FF
					39 01 00 00 00 00 27 C6 4A 3C 02 D9 FA F0 02 40 00 03 D3 98 00 00 B7 F0 7F FF 8C 22 D0 51 84 1B F2 94 37 43 F7 FF FF F7 FF FF F7 FF FF FF
					39 01 00 00 00 00 27 C7 66 00 02 71 07 08 05 10 00 00 18 C8 3F F9 FF 90 00 00 00 00 00 1B 03 C2 00 04 1A 1B 04 1B 00 04 37 1B F7 FF FF FF
					39 01 00 00 00 00 27 C8 46 00 05 F1 06 18 01 90 00 01 BC F0 3F FE 03 80 00 00 00 00 00 02 04 1B 1C 04 37 6D F7 FF FF F7 FF FF F7 FF FF FF
					39 01 00 00 00 00 27 C9 41 00 03 C1 00 00 03 C1 3F FF 17 42 3F FF 17 42 00 00 0E 17 81 09 00 43 24 00 62 43 F7 FF FF F7 FF FF F7 FF FF FF
					39 01 00 00 00 00 27 CA 4D 00 03 C1 00 00 03 C1 3F FF 17 42 00 00 00 00 00 00 00 00 00 15 00 43 44 00 62 63 F7 FF FF F7 FF FF F7 FF FF FF
					39 01 00 00 00 00 27 CB 4B 00 03 C1 00 00 03 C1 00 00 00 00 00 00 00 00 7F FF F1 E8 7F 15 00 63 44 00 82 63 F7 FF FF F7 FF FF F7 FF FF FF
					39 01 00 00 00 00 27 CC 47 00 03 C1 00 00 03 C1 00 00 00 00 3F FF 17 42 00 00 00 00 00 09 00 63 24 00 82 43 F7 FF FF F7 FF FF F7 FF FF FF
					39 01 00 00 00 00 27 CD 00 00 00 00 00 00 00 00 00 00 00 00 00 00 00 00 00 00 00 00 00 00 F7 FF FF F7 FF FF F7 FF FF F7 FF FF F7 FF FF FF
					39 01 00 00 00 00 27 CE 00 00 00 00 00 00 00 00 00 00 00 00 00 00 00 00 00 00 00 00 00 00 F7 FF FF F7 FF FF F7 FF FF F7 FF FF F7 FF FF FF
					39 01 00 00 00 00 27 CF 00 00 00 00 00 00 00 00 00 00 00 00 00 00 00 00 00 00 00 00 00 00 F7 FF FF F7 FF FF F7 FF FF F7 FF FF F7 FF FF FF
					39 01 00 00 00 00 27 D0 00 00 00 00 00 00 00 00 00 00 00 00 00 00 00 00 00 00 00 00 00 00 F7 FF FF F7 FF FF F7 FF FF F7 FF FF F7 FF FF FF
					39 01 00 00 00 00 06 F0 55 AA 52 08 00
					39 01 00 00 00 00 10 B0 0D 03 0C 1E 38 5B 89 C0 FF 55 56 55 00 00 24
					39 01 00 00 00 00 10 B1 20 40 60 00 FF 05 AF 73 E7 5A CE 42 B5 29 9C
					15 01 00 00 00 00 02 55 00
					39 01 00 00 00 00 06 F0 55 AA 52 08 00
					39 01 00 00 00 00 03 C0 76 33
					39 01 00 00 00 00 06 F0 55 AA 52 08 01
					39 01 00 00 00 00 04 D2 00 41 10
					39 01 00 00 00 00 06 F0 55 AA 52 08 01
					39 01 00 00 00 00 03 B2 02 02
					39 01 00 00 00 00 05 FF AA 55 A5 81
					15 01 00 00 00 00 02 6F 0D
					15 01 00 00 00 00 02 F3 CB
					39 01 00 00 00 00 05 FF AA 55 A5 00
					39 01 00 00 00 00 06 F0 55 AA 52 00 00
					15 01 00 00 00 00 02 35 00
					39 01 00 00 00 00 05 3B 00 08 00 08
					15 01 00 00 00 00 02 53 20
					39 01 00 00 00 00 05 51 06 F4 0F FF
					39 01 00 00 00 00 05 2A 00 00 04 37
					39 01 00 00 00 00 05 2B 00 00 09 5F
					39 01 00 00 00 00 13 93 89 28 00 14 02 00 02 0E 01 E8 00 07 05 0E 05 16 10 F0
					15 01 00 00 00 00 02 03 11
					15 01 00 00 00 00 02 90 01
					05 01 00 00 00 00 01 2C
					39 01 00 00 00 00 05 FF AA 55 A5 81
					15 01 00 00 00 00 02 6F 05
					15 01 00 00 00 00 02 FD 00
					15 01 00 00 00 00 02 6F 06
					15 01 00 00 00 00 02 FD D8
					39 01 00 00 00 00 06 F0 55 AA 52 08 00
					39 01 00 00 00 00 08 EF 00 0C 00 00 00 16 40
					05 01 00 00 14 00 01 11
					];
				qcom,mdss-dsi-post-on-backlight = [
					05 01 00 00 00 00 01 29
					];
				qcom,mdss-dsi-off-command = [
					05 01 00 00 0A 00 01 28
					05 01 00 00 78 00 01 10];
				qcom,mdss-dsi-lp1-command = [    /* AOD ON */
					05 01 00 00 00 00 01 39
					15 01 00 00 00 00 02 65 01
					05 01 00 00 00 00 01 2C
					];
				qcom,mdss-dsi-nolp-command = [    /* AOD OFF */
					15 01 00 00 00 00 02 65 00
					05 01 00 00 00 00 01 38
					05 01 00 00 00 00 01 2C
					];
				qcom,mdss-dsi-aod-hbm-on-command = [  /*AOD->HBM ON PANEL FINGERPRINT OFF*/
					15 00 00 00 00 00 02 65 00
					05 00 00 00 00 00 01 38
					05 00 00 00 00 00 01 2C
					39 01 00 00 00 00 03 51 0F FF
				];
				qcom,mdss-dsi-aod-hbm-off-command = [  /*AOD->HBM ON PANEL FINGERPRINT OFF*/
					05 01 00 00 00 00 01 39
					15 01 00 00 00 00 02 65 01
					05 01 00 00 00 00 01 2C
					39 01 00 00 00 00 03 51 00 01
				];
				qcom,mdss-dsi-hbm-on-command = [
					39 01 00 00 22 00 03 51 0F FF
					];
				qcom,mdss-dsi-normal-hbm-on-command = [
					39 01 00 00 00 00 03 51 0F FF
					];
				qcom,mdss-dsi-aod-high-mode-command = [
					/* AOD 50nit */
					39 01 00 00 00 00 06 F0 55 AA 52 08 00
					15 01 00 00 00 00 02 6F 24
					39 01 00 00 00 00 0B B4 00 28 00 28 00 28 00 28 00 28
					];
				qcom,mdss-dsi-aod-low-mode-command = [
					/* AOD 10nit */
					39 01 00 00 00 00 06 F0 55 AA 52 08 00
					15 01 00 00 00 00 02 6F 24
					39 01 00 00 00 00 0B B4 07 80 07 80 07 80 07 80 07 80
					];
				qcom,mdss-dsi-seed-0-command = [
					39 01 00 00 00 00 02 55 80
					39 01 00 00 00 00 06 F0 55 AA 52 08 00
					39 01 00 00 00 00 19 CC 26 44 11 2B 17 21 23 20 25 2A 2F 34 31 2E 2C 25 1F 50 60 70 58 68 78 77
					39 01 00 00 00 00 12 CD 3C 7C 42 4A 44 49 47 42 44 41 47 4A 42 3F 3E 3C 40
					39 01 00 00 00 00 68 CE 00 36 3D 3F 6E 4E 4F 3C 46 3E 46 3F 4D 40 3B 3B 3B 40 48 6B 42 34 48 40 42 46 3E 3D 3E 46 3A 38 36 33 38 40 43 3C 46 37 47 3E 46 3A 40 3F 49 43 40 40 40 40 47 46 34 42 3D 3A 39 3B 44 3F 47 5A 56 51 50 48 45 47 3D 3C 47 3C 41 3E 3F 3F 3E 3E 44 40 40 3D 3D 41 49 40 45 5D 3E 45 53 57 47 4D 4A 50 4A 42 40 3E 3E
					39 01 00 00 00 00 69 CF 38 3A 3B 3E 40 3F 3D 3E 3F 40 40 40 40 36 38 3A 3C 3F 3F 3F 3E 40 40 3F 40 40 38 37 3A 3B 3C 3D 3C 3D 40 40 40 40 40 35 36 36 3C 39 39 3B 38 3C 3A 40 3D 40 40 40 40 40 40 40 40 40 40 40 40 40 40 37 33 38 3D 39 3E 3B 3B 3C 3C 3E 3A 40 40 40 40 40 40 40 40 40 40 40 40 40 40 40 40 40 40 40 40 40 40 40 40 40 40 40
					39 01 00 00 00 00 07 D0 01 00 FE 77 04 1D
					39 01 00 00 00 00 2e D1 43 4F 49 4A 52 4F 4F 4F 51 59 60 60 60 60 5C 53 4D 48 4F 4D 50 46 4C 4C 27 33 66 44 44 54 55 55 31 33 33 33 00 06 0C 03 09 0F 68 88 00
					39 01 00 00 00 00 34 D2 01 0F 40 82 88 87 87 83 7C 76 72 6D 7B 74 7B 81 88 87 81 93 84 89 82 7A 7C 7A 7D 93 8B 84 84 82 7F 7E 7A 56 5F 63 6D 80 92 9C 9E B1 8B 84 80 7C 7A 7F 86
					39 01 00 00 00 00 07 D3 30 52 74 76 50 10
					39 01 00 00 00 00 1a D4 0F 76 76 05 0D 14 0F 18 1F 05 0D 14 03 07 0A A0 55 FF 79 44 12 00 00 80 00
					39 01 00 00 00 00 67 D5 00 00 00 00 00 00 40 40 40 40 40 40 40 40 40 40 40 40 40 40 40 40 40 40 40 40 40 40 40 40 40 40 40 40 40 40 40 40 40 40 40 40 40 40 40 40 40 40 40 40 40 40 40 40 40 40 40 40 40 40 40 40 40 40 40 40 40 40 40 40 40 40 40 40 40 40 40 40 40 40 40 40 40 40 40 40 40 40 40 40 40 40 40 40 40 40 40 40 40 40 40 40
					39 01 00 00 00 00 4e D6 00 00 00 00 00 00 00 00 00 00 00 00 40 40 40 40 40 40 40 40 40 40 40 40 40 40 40 40 40 40 40 40 40 40 40 40 40 40 40 40 40 40 40 40 40 40 40 40 40 40 40 40 40 40 40 40 40 40 40 40 40 40 40 40 40 40 40 40 40 40 40 40 40 40 40 40 40
					39 01 00 00 00 00 32 D7 30 35 3A 3D 3D 3D 44 48 4D 46 3E 48 3B 39 3B 3D 3C 3C 41 45 46 44 40 45 3C 3D 3C 3C 3C 3C 3F 42 40 42 43 43 3E 3E 3E 3E 3E 3E 3F 41 40 41 41 41 3F
					39 01 00 00 00 00 19 DE 33 33 33 33 33 33 33 33 33 33 33 33 03 31 22 10 32 00 01 64 70 20 21 23
					];
				qcom,mdss-dsi-seed-1-command = [
					39 01 00 00 00 00 02 55 80
					39 01 00 00 00 00 06 F0 55 AA 52 08 00
					39 01 00 00 00 00 19 CC 27 2B 2D 2B 2C 2D 2E 2E 2E 30 2F 2E 2F 2E 2C 2A 28 50 60 70 58 68 78 77
					39 01 00 00 00 00 12 CD 37 40 49 41 47 4A 4F 4F 57 5A 5B 5F 65 64 5D 5B 57
					39 01 00 00 00 00 68 CE 00 4E 64 58 4B 51 55 4E 46 42 4E 3F 42 3D 3A 39 39 3F 41 2B 39 32 34 37 36 34 38 3D 39 37 3E 42 41 42 44 45 41 4E 42 47 46 41 42 42 40 42 3F 3E 3C 3A 3C 3F 48 55 52 49 49 4F 44 44 45 43 3E 3E 3D 3D 3E 40 44 4B 52 57 4D 51 50 55 4B 47 4B 40 3E 3C 38 36 38 3E 3F 3F 40 40 41 3A 40 40 3F 42 3B 3A 40 3F 3D 40 43
					39 01 00 00 00 00 69 CF 40 40 40 40 40 3C 3A 38 38 38 3A 3C 40 40 40 40 40 40 3C 3A 38 38 38 3A 3C 40 40 40 40 40 40 3C 3A 38 38 38 3A 3C 40 40 40 40 40 40 3C 3A 38 38 38 3A 3C 40 40 40 40 40 40 40 40 40 40 40 40 40 40 40 40 40 40 40 40 40 40 40 40 40 40 40 40 40 40 40 40 40 40 40 40 40 40 40 40 40 40 40 40 40 40 40 40 40 40 40 40 40
					39 01 00 00 00 00 07 D0 09 08 FE 7F 04 1D
					39 01 00 00 00 00 2e D1 5F 64 66 6F 76 75 72 72 75 7F 7F 7F 7F 7F 77 65 51 5E 59 5F 68 62 61 5F 66 77 22 22 32 33 33 44 41 44 55 55 00 06 0C 03 09 0F 68 88 00
					39 01 00 00 00 00 34 D2 01 08 40 8A 8F 8F 88 82 76 68 57 49 6D 6C 6E 84 93 97 8C 90 80 77 6E 62 7C 78 76 98 7A 7D 81 81 81 77 60 2E 05 38 50 84 A8 AD A1 B1 86 76 6F 6B 7C 8C 9D
					39 01 00 00 00 00 07 D3 30 52 74 76 50 10
					39 01 00 00 00 00 1a D4 0F 76 76 05 0D 14 0F 18 1F 05 0D 14 03 07 0A A0 55 FF 79 44 12 00 00 80 00
					39 01 00 00 00 00 67 D5 00 00 00 00 00 00 40 40 40 40 40 40 40 40 40 40 40 40 40 40 40 40 40 40 40 40 40 40 40 40 40 40 40 40 40 40 40 40 40 40 40 40 40 40 40 40 40 40 40 40 40 40 40 40 40 40 40 40 40 40 40 40 40 40 40 40 40 40 40 40 40 40 40 40 40 40 40 40 40 40 40 40 40 40 40 40 40 40 40 40 40 40 40 40 40 40 40 40 40 40 40 40
					39 01 00 00 00 00 4e D6 00 00 00 00 00 00 00 00 00 00 00 00 40 40 40 40 40 40 40 40 40 40 40 40 40 40 40 40 40 40 40 40 40 40 40 40 40 40 40 40 40 40 40 40 40 40 40 40 40 40 40 40 40 40 40 40 40 40 40 40 40 40 40 40 40 40 40 40 40 40 40 40 40 40 40 40 40
					39 01 00 00 00 00 32 D7 30 37 3C 40 42 48 51 4F 53 3F 45 4B 41 37 3B 3F 40 42 4A 49 4B 3F 42 46 3E 38 3B 3E 3F 3D 44 44 44 40 40 42 3C 3C 3D 3F 3F 3E 42 42 42 40 40 41 3E
					39 01 00 00 00 00 19 DE 33 33 33 33 33 33 33 33 33 33 33 33 00 00 00 00 00 00 00 60 70 00 00 00
					];
				qcom,mdss-dsi-spr-0-command = [
					39 01 00 00 00 00 06 F0 55 AA 52 08 07
					39 01 00 00 00 00 07 B0 A4 40 70 60 00 00
					39 01 00 00 00 00 18 B1 08 18 00 18 08 00 00 00 00 00 00 00 00 00 00 00 00 00 00 00 00 00 00
					39 01 00 00 00 00 B5 B2 20 20 20 20 20 20 20 20 20 20 20 20 20 20 20 20 20 20 20 20 20 20 20 20 20 20 20 20 20 20 20 20 20 20 20 20 20 20 20 20 20 20 20 20 20 20 20 20 20 20 20 20 20 20 32 32 32 32 32 32 32 32 32 00 00 00 00 00 00 00 00 00 32 32 32 32 32 32 32 32 32 00 00 00 00 00 00 00 00 00 32 32 32 32 32 32 32 32 32 00 00 00 00 00 00 00 00 00 32 32 32 32 32 32 32 32 32 00 00 00 00 00 00 00 00 00 32 32 32 32 32 32 32 32 32 00 00 00 00 00 00 00 00 00 32 32 32 32 32 32 32 32 32 00 00 00 00 00 00 00 00 00 00 00 20 00 20 00 00 00 00 00 32 00 00 00 32 00 00 00
					39 01 00 00 00 00 5B B3 00 00 00 00 00 00 00 00 00 00 00 00 00 00 00 00 00 00 00 00 00 00 00 00 00 00 00 00 00 00 00 00 00 00 00 00 00 00 00 00 00 00 00 00 00 00 00 00 00 00 00 00 00 00 00 00 00 00 00 00 00 00 00 00 00 00 00 00 00 00 00 00 00 00 00 00 00 00 00 00 00 00 00 00 00 00 00 00 00 00
					39 01 00 00 00 00 1B B4 C0 00 00 00 00 00 00 00 00 00 00 00 00 00 80 80 80 80 40 80 80 80 80 80 40 80
					39 01 00 00 00 00 49 B5 00 00 00 00 00 00 00 00 00 00 00 00 00 00 00 00 00 00 00 00 00 00 04 00 00 00 00 00 00 00 00 00 00 00 00 00 00 00 00 00 00 00 00 00 00 00 00 00 00 00 00 00 00 00 00 00 00 00 00 00 00 00 00 00 00 00 00 00 00 00 00 00
					39 01 00 00 00 00 25 B6 00 00 00 00 00 00 00 00 00 00 00 00 00 00 00 00 00 00 00 00 00 00 00 00 E0 00 E0 00 00 00 E0 00 E0 00 00 00
					39 01 00 00 00 00 50 B7 24 84 00 08 01 08 01 00 00 00 00 00 00 00 00 00 00 00 00 00 00 00 00 00 00 00 00 00 00 00 00 00 00 00 00 00 00 00 00 00 00 00 00 FD 58 0E A5 78 2A 1A 77 FE CF 7E 0D E5 B2 B7 87 CC 14 80 80 80 80 80 80 80 80 80 80 80 80 80 80 80 80 80 80
					39 01 00 00 00 00 58 B8 00 00 00 00 00 00 00 00 00 00 00 00 00 00 00 00 00 00 00 02 02 00 00 00 00 00 00 00 00 00 00 00 00 00 00 00 00 00 00 00 00 00 00 00 00 00 00 00 00 00 00 00 00 00 00 00 00 00 00 00 00 00 00 00 00 00 00 00 00 00 00 00 00 00 00 00 00 00 00 00 00 00 00 00 00 00 00
					39 01 00 00 00 00 C1 B9 00 00 00 00 00 00 00 00 00 00 00 00 00 00 00 00 00 00 00 00 00 00 00 00 00 00 00 00 00 00 00 00 00 00 00 00 00 00 00 00 00 00 00 00 00 00 00 00 00 00 00 00 00 00 00 00 00 00 00 00 00 00 00 00 00 00 00 00 00 00 00 00 00 00 00 00 00 00 00 00 00 00 00 00 00 00 00 00 00 00 00 00 00 00 00 00 00 00 00 00 00 00 00 00 00 00 00 00 00 00 00 00 00 00 00 00 00 00 00 00 00 00 00 00 00 00 00 00 00 00 00 00 00 00 00 00 00 00 00 00 00 00 00 00 00 00 00 00 00 00 00 00 00 00 00 00 00 00 00 00 00 00 00 00 00 00 00 00 00 00 00 00 00 00 00 00 00 00 00 00 00 00 00 00 00 00 00 00 00 00 00 00
					39 01 00 00 00 00 20 BA 00 00 00 00 00 00 00 00 00 00 00 00 00 00 00 00 00 00 00 00 00 00 00 00 00 00 00 00 00 00 00
					39 01 00 00 00 00 88 BB 00 00 00 00 00 00 00 00 00 00 00 00 00 00 00 00 00 00 00 00 00 00 00 00 00 00 00 00 00 00 00 00 00 00 00 00 00 00 00 00 00 00 00 00 00 00 00 00 00 00 00 00 00 00 00 00 00 00 00 00 00 00 00 00 00 00 00 00 00 00 00 00 00 00 00 00 00 00 00 00 00 00 00 00 00 00 00 00 00 00 00 00 00 00 00 00 00 00 00 00 00 00 00 00 00 00 00 00 00 00 00 00 00 00 00 00 00 00 00 00 00 00 00 00 00 00 00 00 00 00 00 00 00 00 00
					39 01 00 00 00 00 14 BC 00 00 00 00 00 00 00 00 00 00 00 00 00 00 00 00 00 00 00
					39 01 00 00 00 00 0D BD 00 00 00 00 00 00 00 00 00 00 00 00
					];
				qcom,mdss-dsi-spr-1-command = [
					39 01 00 00 00 00 06 F0 55 AA 52 08 07
					39 01 00 00 00 00 07 B0 A4 40 70 60 00 00
					39 01 00 00 00 00 03 B7 80 90
					39 01 00 00 00 00 02 6F 43
					39 01 00 00 00 00 04 B7 80 70 80
					39 01 00 00 00 00 02 6F 46
					39 01 00 00 00 00 04 B7 80 70 80
					39 01 00 00 00 00 18 B1 0C 1C 00 1C 0C 00 00 00 00 00 00 00 00 00 00 00 00 00 00 00 00 00 00
					39 01 00 00 00 00 B5 B2 22 22 22 22 22 22 22 22 22 22 22 22 22 22 22 22 22 22 00 00 00 00 00 00 00 00 00 22 22 22 22 22 22 22 22 22 22 22 22 22 22 22 22 22 22 00 00 00 00 00 00 00 00 00 3A 3A 3A 3A 3A 3A 3A 3A 3A 05 05 05 05 05 05 05 05 05 3A 3A 3A 3A 3A 3A 3A 3A 3A 05 05 05 05 05 05 05 05 05 00 00 00 00 00 00 00 00 00 00 00 00 00 00 00 00 00 00 3A 3A 3A 3A 3A 3A 3A 3A 3A 05 05 05 05 05 05 05 05 05 3A 3A 3A 3A 3A 3A 3A 3A 3A 05 05 05 05 05 05 05 05 05 00 00 00 00 00 00 00 00 00 00 00 00 00 00 00 00 00 00 00 00 00 00 00 00 00 00 00 00 00 00 00 00 00 00 00 00
					39 01 00 00 00 00 5B B3 00 00 00 00 00 00 00 00 00 00 00 00 00 00 00 00 00 00 00 00 00 00 00 00 00 00 00 00 00 00 00 00 00 00 00 00 00 00 00 00 00 00 00 00 00 00 00 00 00 00 00 00 00 00 00 00 00 00 00 00 00 00 00 00 00 00 00 00 00 00 00 00 00 00 00 00 00 00 00 00 00 00 00 00 00 00 00 00 00 00
					39 01 00 00 00 00 1B B4 C0 00 00 00 00 00 00 00 00 00 00 00 00 00 80 68 80 80 60 80 80 60 80 80 A0 80
					39 01 00 00 00 00 49 B5 00 00 00 00 00 00 00 00 00 00 00 00 00 00 00 00 00 00 00 00 00 00 04 00 00 00 00 00 00 00 00 00 00 00 00 00 00 00 00 00 00 00 00 00 00 00 00 00 00 00 00 00 00 00 00 00 00 00 00 00 00 00 00 00 00 00 00 00 00 00 00 00
					39 01 00 00 00 00 25 B6 00 00 00 00 00 00 00 00 00 00 00 00 00 00 00 00 00 00 00 00 00 00 00 00 E0 00 E0 00 00 00 E0 00 E0 00 00 00
					39 01 00 00 00 00 58 B8 00 00 00 00 00 00 00 00 00 00 00 00 00 00 00 00 00 00 00 02 02 00 00 00 00 00 00 00 00 00 00 00 00 00 00 00 00 00 00 00 00 00 00 00 00 00 00 00 00 00 00 00 00 00 00 00 00 00 00 00 00 00 00 00 00 00 00 00 00 00 00 00 00 00 00 00 00 00 00 00 00 00 00 00 00 00 00
					39 01 00 00 00 00 C1 B9 00 00 00 00 00 00 00 00 00 00 00 00 00 00 00 00 00 00 00 00 00 00 00 00 00 00 00 00 00 00 00 00 00 00 00 00 00 00 00 00 00 00 00 00 00 00 00 00 00 00 00 00 00 00 00 00 00 00 00 00 00 00 00 00 00 00 00 00 00 00 00 00 00 00 00 00 00 00 00 00 00 00 00 00 00 00 00 00 00 00 00 00 00 00 00 00 00 00 00 00 00 00 00 00 00 00 00 00 00 00 00 00 00 00 00 00 00 00 00 00 00 00 00 00 00 00 00 00 00 00 00 00 00 00 00 00 00 00 00 00 00 00 00 00 00 00 00 00 00 00 00 00 00 00 00 00 00 00 00 00 00 00 00 00 00 00 00 00 00 00 00 00 00 00 00 00 00 00 00 00 00 00 00 00 00 00 00 00 00 00 00 00
					39 01 00 00 00 00 20 BA 00 00 00 00 00 00 00 00 00 00 00 00 00 00 00 00 00 00 00 00 00 00 00 00 00 00 00 00 00 00 00
					39 01 00 00 00 00 88 BB 00 00 00 00 00 00 00 00 00 00 00 00 00 00 00 00 00 00 00 00 00 00 00 00 00 00 00 00 00 00 00 00 00 00 00 00 00 00 00 00 00 00 00 00 00 00 00 00 00 00 00 00 00 00 00 00 00 00 00 00 00 00 00 00 00 00 00 00 00 00 00 00 00 00 00 00 00 00 00 00 00 00 00 00 00 00 00 00 00 00 00 00 00 00 00 00 00 00 00 00 00 00 00 00 00 00 00 00 00 00 00 00 00 00 00 00 00 00 00 00 00 00 00 00 00 00 00 00 00 00 00 00 00 00 00
					39 01 00 00 00 00 14 BC 00 00 00 00 00 00 00 00 00 00 00 00 00 00 00 00 00 00 00
					39 01 00 00 00 00 0D BD 00 00 00 00 00 00 00 00 00 00 00 00
					];
				qcom,mdss-dsi-spr-2-command = [
					39 01 00 00 00 00 06 F0 55 AA 52 08 07
					39 01 00 00 00 00 07 B0 A4 40 70 60 00 00
					39 01 00 00 00 00 18 B1 08 18 00 18 08 00 00 00 00 00 00 00 00 00 00 00 00 00 00 00 00 00 00
					39 01 00 00 00 00 B5 B2 20 20 20 20 20 20 20 20 20 20 20 20 20 20 20 20 20 20 20 20 20 20 20 20 20 20 20 20 20 20 20 20 20 20 20 20 20 20 20 20 20 20 20 20 20 20 20 20 20 20 20 20 20 20 03 03 03 03 03 03 03 03 03 00 00 00 00 00 00 00 00 00 03 03 03 03 03 03 03 03 03 00 00 00 00 00 00 00 00 00 03 03 03 03 03 03 03 03 03 00 00 00 00 00 00 00 00 00 03 03 03 03 03 03 03 03 03 00 00 00 00 00 00 00 00 00 03 03 03 03 03 03 03 03 03 00 00 00 00 00 00 00 00 00 03 03 03 03 03 03 03 03 03 00 00 00 00 00 00 00 00 00 00 00 20 00 20 00 00 00 00 00 32 00 00 00 32 00 00 00
					39 01 00 00 00 00 5B B3 00 00 00 00 00 00 00 00 00 00 00 00 00 00 00 00 00 00 00 00 00 00 00 00 00 00 00 00 00 00 00 00 00 00 00 00 00 00 00 00 00 00 00 00 00 00 00 00 00 00 00 00 00 00 00 00 00 00 00 00 00 00 00 00 00 00 00 00 00 00 00 00 00 00 00 00 00 00 00 00 00 00 00 00 00 00 00 00 00 00
					39 01 00 00 00 00 1B B4 C0 00 00 00 00 00 00 00 00 00 00 00 00 00 80 80 80 80 40 80 80 80 80 80 40 80
					39 01 00 00 00 00 49 B5 00 00 00 00 00 00 00 00 00 00 00 00 00 00 00 00 00 00 00 00 00 00 04 00 00 00 00 00 00 00 00 00 00 00 00 00 00 00 00 00 00 00 00 00 00 00 00 00 00 00 00 00 00 00 00 00 00 00 00 00 00 00 00 00 00 00 00 00 00 00 00 00
					39 01 00 00 00 00 25 B6 00 00 00 00 00 00 00 00 00 00 00 00 00 00 00 00 00 00 00 00 00 00 00 00 E0 00 E0 00 00 00 E0 00 E0 00 00 00
					39 01 00 00 00 00 50 B7 24 84 00 08 01 08 01 00 00 00 00 00 00 00 00 00 00 00 00 00 00 00 00 00 00 00 00 00 00 00 00 00 00 00 00 00 00 00 00 00 00 00 00 FD 58 0E A5 78 2A 1A 77 FE CF 7E 0D E5 B2 B7 87 CC 14 80 80 80 80 80 80 80 80 80 80 80 80 80 80 80 80 80 80
					39 01 00 00 00 00 58 B8 00 00 00 00 00 00 00 00 00 00 00 00 00 00 00 00 00 00 00 02 02 00 00 00 00 00 00 00 00 00 00 00 00 00 00 00 00 00 00 00 00 00 00 00 00 00 00 00 00 00 00 00 00 00 00 00 00 00 00 00 00 00 00 00 00 00 00 00 00 00 00 00 00 00 00 00 00 00 00 00 00 00 00 00 00 00 00
					39 01 00 00 00 00 C1 B9 00 00 00 00 00 00 00 00 00 00 00 00 00 00 00 00 00 00 00 00 00 00 00 00 00 00 00 00 00 00 00 00 00 00 00 00 00 00 00 00 00 00 00 00 00 00 00 00 00 00 00 00 00 00 00 00 00 00 00 00 00 00 00 00 00 00 00 00 00 00 00 00 00 00 00 00 00 00 00 00 00 00 00 00 00 00 00 00 00 00 00 00 00 00 00 00 00 00 00 00 00 00 00 00 00 00 00 00 00 00 00 00 00 00 00 00 00 00 00 00 00 00 00 00 00 00 00 00 00 00 00 00 00 00 00 00 00 00 00 00 00 00 00 00 00 00 00 00 00 00 00 00 00 00 00 00 00 00 00 00 00 00 00 00 00 00 00 00 00 00 00 00 00 00 00 00 00 00 00 00 00 00 00 00 00 00 00 00 00 00 00 00
					39 01 00 00 00 00 20 BA 00 00 00 00 00 00 00 00 00 00 00 00 00 00 00 00 00 00 00 00 00 00 00 00 00 00 00 00 00 00 00
					39 01 00 00 00 00 88 BB 00 00 00 00 00 00 00 00 00 00 00 00 00 00 00 00 00 00 00 00 00 00 00 00 00 00 00 00 00 00 00 00 00 00 00 00 00 00 00 00 00 00 00 00 00 00 00 00 00 00 00 00 00 00 00 00 00 00 00 00 00 00 00 00 00 00 00 00 00 00 00 00 00 00 00 00 00 00 00 00 00 00 00 00 00 00 00 00 00 00 00 00 00 00 00 00 00 00 00 00 00 00 00 00 00 00 00 00 00 00 00 00 00 00 00 00 00 00 00 00 00 00 00 00 00 00 00 00 00 00 00 00 00 00 00
					39 01 00 00 00 00 14 BC 00 00 00 00 00 00 00 00 00 00 00 00 00 00 00 00 00 00 00
					39 01 00 00 00 00 0D BD 00 00 00 00 00 00 00 00 00 00 00 00
					];
				qcom,mdss-dsi-data-dimming-on-command = [
					39 00 00 00 00 00 06 F0 55 AA 52 08 00
					39 00 00 00 00 00 02 B2 80
					39 00 00 00 00 00 1E B4
					   00 00 00 00 00 00 00 00 00 00
					   28 28 28 28 28 28 28 28 28 28
					   28 28 28 28 28 28 28 28 28
					39 00 00 00 00 00 25 B3
					   00 00 00 00 00 00 00 00 00 00
					   00 00 00 00 00 00 00 00 00 00
					   00 00 00 00 00 00 00 00 00 00
					   00 00 06 F4 0F FF
				];
				qcom,mdss-dsi-data-dimming-off-command = [
					39 00 00 00 00 00 06 F0 55 AA 52 08 00
					39 00 00 00 00 00 25 B3
					   00 01 00 80 00 80 00 AF 00 AF
					   00 E5 00 E5 01 5B 01 5B 01 F2
					   01 F2 02 68 02 68 03 00 03 00
					   06 F4 06 F4 0F FF
					39 00 00 00 00 00 02 B2 00
					39 00 00 00 00 00 1E B4
					   88 88 77 66 44 22 00 00 00 00
					   7E 7E 5A 5A E1 E1 FC FC E8 E8
					   8C 8C F2 F2 28 28 28 28 28
				];
				qcom,mdss-dsi-data-dimming-on-command-state = "dsi_hs_mode";
				qcom,mdss-dsi-data-dimming-off-command-state = "dsi_hs_mode";
				qcom,mdss-dsi-aod-hbm-on-command-state = "dsi_lp_mode";
				qcom,mdss-dsi-aod-hbm-off-command-state = "dsi_lp_mode";
				qcom,mdss-dsi-hbm-off-command-state = "dsi_hs_mode";
				qcom,mdss-dsi-lp1-command-state = "dsi_lp_mode";
				qcom,mdss-dsi-nolp-command-state = "dsi_lp_mode";
				qcom,mdss-dsi-post-on-backlight-state = "dsi_hs_mode";
				qcom,mdss-dsi-on-command-state = "dsi_lp_mode";
				qcom,mdss-dsi-off-command-state = "dsi_hs_mode";
				qcom,mdss-dsi-normal-hbm-on-command-state = "dsi_hs_mode";
				qcom,mdss-dsi-aod-high-mode-command-state = "dsi_lp_mode";
				qcom,mdss-dsi-aod-low-mode-command-state = "dsi_lp_mode";
				qcom,mdss-dsi-timing-switch-command-state = "dsi_lp_mode";
				qcom,compression-mode = "dsc";
				qcom,mdss-dsc-slice-height = <20>;
				qcom,mdss-dsc-slice-width = <540>;
				qcom,mdss-dsc-slice-per-pkt = <2>;
				qcom,mdss-dsc-bit-per-component = <8>;
				qcom,mdss-dsc-bit-per-pixel = <8>;
				qcom,mdss-dsc-block-prediction-enable;
			};
		};
	};
};

&dsi_oplus19161boe_nt37800_1080_2400_cmd {
	qcom,panel-supply-entries = <&dsi_panel_pwr_supply>;
	qcom,mdss-dsi-bl-pmic-control-type = "bl_ctrl_dcs";
	qcom,mdss-dsi-bl-min-level = <1>;
	qcom,mdss-dsi-bl-normal-max-level = <1780>;
	qcom,mdss-dsi-bl-max-level = <4095>;
	qcom,mdss-brightness-normal-max-level = <1023>;
	qcom,mdss-brightness-max-level = <2047>;
	qcom,mdss-brightness-default-level = <400>;
	qcom,platform-te-gpio = <&tlmm 109 0>;
	qcom,platform-reset-gpio =  <&tlmm 75 0>;

	oplus,mdss-dsi-vendor-name = "NT37800";
	oplus,mdss-dsi-manufacture = "samsung1024";
	oplus,dsi-fod-brightness = <0 0xff>,
				<1 0xf0>,
				<2 0xf0>,
				<3 0xef>,
				<6 0xed>,
				<10 0xec>,
				<17 0xeb>,
				<34 0xea>,
				<52 0xe7>,
				<78 0xe3>,
				<121 0xdd>,
				<173 0xca>,
				<260 0xb6>,
				<394 0x9e>,
				<521 0x8e>,
				<695 0x78>,
				<869 0x6a>,
				<1043 0x60>,
				<1391 0x48>,
				<1780 0x28>;

	qcom,ulps-enabled;
	qcom,dsi-select-clocks = "mux_byte_clk0", "mux_pixel_clk0",
				"src_byte_clk0", "src_pixel_clk0",
				"shadow_byte_clk0", "shadow_pixel_clk0";
	qcom,dsi-select-clocks = "mux_byte_clk0", "mux_pixel_clk0";
	qcom,mdss-dsi-t-clk-post = <0x0E>;
	qcom,mdss-dsi-t-clk-pre = <0x35>;
	qcom,mdss-dsi-display-timings {
		timing@0{
			qcom,mdss-dsi-panel-phy-timings = [00 1A 06 06 22 20 07
				06 04 02 04 00 16 16];

			qcom,display-topology = <2 2 1>;
			qcom,default-topology-index = <0>;
		};
	};
};
