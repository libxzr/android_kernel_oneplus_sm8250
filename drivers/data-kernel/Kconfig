## drivers/data-kernel/rmnet/Kconfig
```kconfig
source "drivers/data-kernel/rmnet/perf/Kconfig"
source "drivers/data-kernel/rmnet/shs/Kconfig"
```

## drivers/misc/oneplus/Kconfig
```kconfig
config PROJECT_INFO
    bool "detect project info"
    default n
    help
      detect projcet info  If unsure, say n.

config OEM_BOOT_MODE
    bool "detect oem boot mode"
    default n
    help
        detect oem boot mode  If unsure, say y.

config RF_CABLE_DETECT
    bool "detect RF cable connection"
    help
      detect RF cable connection for different RF configuration
      To compile this driver as a module, choose M here: the module
      will be called RF cable.
      If unsure, say N.

config GPIO_SWITCH
	tristate "use gpio swith"
	default y
	help
	  we can use gpio switch set gpio out high or low

config REGULATOR_DEMO
	tristate "use regultor demo"
	default y
	help
	  we can use regulator demo to control regulator
```

## drivers/platform/oneplus/Kconfig
```kconfig
# Oneplus configuration options

config MACH_ONEPLUS_SM8250
	bool "Oneplus SM8250"
	depends on ARCH_QCOM
	depends on ARCH_KONA
	help
	  Support for SM8250 Oneplus variants

menu "Oneplus board selection"

	config MACH_ONEPLUS_8
		bool "Oneplus 8 board"
		depends on MACH_ONEPLUS_SM8250
		help
		  Support for Oneplus 8 variant

	config MACH_ONEPLUS_8PRO
		bool "Oneplus 8 Pro board"
		depends on MACH_ONEPLUS_SM8250
		help
		  Support for Oneplus 8 Pro variant
endmenu

config DISABLE_PXLW_IRIS_DUAL
	bool "Disable display techpack config PXLW_IRIS_DUAL"
	depends on MACH_ONEPLUS_8PRO
```

## oplus/kernel/oplus_performance/foreground_io_opt/Kconfig
```kconfig
# SPDX-License-Identifier: GPL-2.0-only
# Copyright (C) 2018-2020 Oplus. All rights reserved.

config OPLUS_FG_IO_OPT
       bool "Enable foreground io optimization"
       depends on FG_TASK_UID
       default y
       help
         foreground io optimization
```

## oplus/kernel/oplus_performance/healthinfo/blk/Kconfig
```kconfig
#ifdef OPLUS_FEATURE_HEALTHINFO
config OPLUS_BLK_MONITOR
	bool "block layer monitor "
	default n
	help
	 block layer monitor.
#endif /* OPLUS_FEATURE_HEALTHINFO */
```

## oplus/kernel/oplus_performance/input_boost/Kconfig
```kconfig
config OPLUS_FEATURE_INPUT_BOOST
        bool "config input boost"
        depends on SCHED_WALT
        default n
        help
          track load of all ux tasks,opt task placement and frequency selection
```

## oplus/kernel/oplus_performance/mm_osvelte/Kconfig
```kconfig
config OPLUS_FEATURE_MM_OSVELTE
	tristate "osvelte driver"
	default n
	help
	  This driver used for memory debugging.
```

## oplus/kernel/oplus_performance/oplus_mm/process_reclaim/Kconfig
```kconfig
# if defined(OPLUS_FEATURE_MEMLEAK_DETECT)
# Support reclaim process inactive pages only
config PROCESS_RECLAIM_ENHANCE
	tristate "Enable process reclaim enchance"
	depends on PROCESS_RECLAIM
	default n
	help
	 It allows to reclaim different type pages of the process by
	 /proc/process_reclaim.

	 (echo inactive_file > /proc/PID/reclaim) reclaims inactive file-backed
		pages only.
	 (echo inactive_anon > /proc/PID/reclaim) reclaims inactive anonymous
		pages only.
	 (echo inactive > /proc/PID/reclaim) reclaims inactive file-backed and
		anonymous pages only.
	 Any other vaule, please reference PROCESS_RECLAIM.
# endif
```

## oplus/kernel/oplus_performance/oplus_mm/zram_opt/Kconfig
```kconfig
# SPDX-License-Identifier: GPL-2.0-only
# Copyright (C) 2020-2022 Oplus. All rights reserved.

config OPLUS_FEATURE_ZRAM_OPT
  tristate "oplus zram opt
  default n
  help
    define this config to enable oplus zram.
```

## oplus/kernel/oplus_performance/uifirst/Kconfig
```kconfig
config OPLUS_FEATURE_UIFIRST
	tristate "uifirst"
	default n
	help
	  turning sched for ui, render and so on to improve UX
config CAMERA_OPT
	bool "config camera opt"
	default n
	help
	  reduce camera provider task runnable time
```

## oplus/kernel/power/cpufreq_effiency/Kconfig
```kconfig
config OPLUS_FEATURE_SUGOV_POWER_EFFIENCY
	tristate "power domain effiency"
	default n
	help
	     Select Left or right frequence point as target frequence base on powerdomain and currenct frequence value
```

## oplus/kernel/power/cpufreq_health/Kconfig
```kconfig
config OPLUS_FEATURE_OCH
	bool "cpufreq_health"
	default n
	help
		This selects cpufreq and vlotage statistics driver
```

## oplus/kernel/secureguard/rootguard/Kconfig
```kconfig
config OPLUS_ROOT_CHECK
    tristate "oplus root check"
    default n
    help
      define this config to enable oplus root check .

config OPLUS_EXECVE_BLOCK
    tristate "oplus execve"
    default n
    help
      define this config to enable oplus execve block .

config OPLUS_MOUNT_BLOCK
    tristate "oplus mount block"
    default n
    help
      define this config to enable oplus mount block .

config OPLUS_SECURE_GUARD
    tristate "oplus secure guard"
    default n
    help
      define this config to enable oplus secure guard .
```

## oplus/kernel/secureguard/securegki/Kconfig
```kconfig
config OPLUS_KERNEL_SECURE_FEATURE
	tristate "config oplus kernel secure guard feature "
	default y
	help
		sdefine this config to add oplus kernel secure guard feature

source "arch/arm64/kernel/secureguard/keventupload/Kconfig"
source "arch/arm64/kernel/secureguard/rootguard/Kconfig"
```

## oplus/kernel/secureguard/securegki/keventupload/Kconfig
```kconfig
config OPLUS_KERNEL_SECURE_KEVENTUPLOAD
	tristate "oplus kernel secure keventupload"
    help
      define this config to enable kernel secure secure keventupload .
```

## oplus/kernel/secureguard/securegki/rootguard/Kconfig
```kconfig
config OPLUS_KERNEL_SECURE_GUARD
    tristate "oplus kernel secure guard"
    default n
    help
      define this config to enable kernel secure guard .
```

## oplus/kernel/touchpanel/oplus_touchscreen/Synaptics/TD4160/Kconfig
```kconfig
config TOUCHPANEL_SYNAPTICS_TD4160
#	default y
	bool "TP td4160 IC enable or not for  OPLUS"
	---help---
	say Y to enable driver for Touchpanel using ilitek ilitek7807s
```

## oplus/sensor/kernel/oplus_consumer_ir/Kconfig
```kconfig
config OPLUS_SENSOR_CONSUMER_IR_CORE
	tristate "sensor consumer ir config for core"
	help
	  To compile this driver as a module, set m in kernel build config
	  module will be called oplus_ir_core.
config OPLUS_SENSOR_CONSUMER_IR_QC
	tristate "sensor consumer ir config for qcom"
	help
	  To compile this driver as a module, set m in kernel build config
	  module will be called oplus_ir_spi.
config OPLUS_SENSOR_CONSUMER_IR_MTK
	tristate "sensor consumer ir config for MediaTek"
	help
	  To compile this driver as a module, set m in kernel build config
	  module will be called oplus_ir_pwm.
```

## oplus/sensor/kernel/oplus_sensor_devinfo/Kconfig
```kconfig
config OPLUS_SENSOR_MTK68XX
	bool "for MediaTek 68xx"
	default n
	help
	  It support 68xx.
config OPLUS_SENSOR_FB_MTK
	tristate "sensor feedback config for qcom"
	help
	  To compile this driver as a module, set M in kernel build config
	  module will be called sensor_feedback.
```

## oplus/sensor/kernel/oplus_virtual_sensor/Kconfig
```kconfig
config OPLUS_FEATURE_SENSOR_ALGORITHM
	bool "oplus vritual sensor config"
	default n
```

## oplus/sensor/kernel/oplus_virtual_sensor/sensors/camera_protecthub/Kconfig
```kconfig
config OPLUS_FEATURE_CAMERA_PROTECT
	bool "camera_protecthub for MediaTek package"
	default n
```

## oplus/sensor/kernel/oplus_virtual_sensor/sensors/elevator_detecthub/Kconfig
```kconfig
config OPLUS_FEATURE_ELEVATOR_DETECT
    bool "elevator_detect for MediaTek package"
    default n
```
