## oplus/sensor/kernel/oplus_virtual_sensor/sensors/fp_displayhub/Kconfig
```kconfig
config OPLUS_FEATURE_FP_DISPLAY
	bool "fp_displayhub for MediaTek package"
	default n
```

## oplus/sensor/kernel/oplus_virtual_sensor/sensors/free_fallhub/Kconfig
```kconfig
config OPLUS_FEATURE_FREE_FALL
	bool "free_fallhub for MediaTek package"
	default n
```

## oplus/sensor/kernel/oplus_virtual_sensor/sensors/oplus_activity_recognitionhub/Kconfig
```kconfig
config OPLUS_FEATURE_ACTIVITY_RECOGNITION
    bool "oplus_activity_recognition for MediaTek package"
    default n
```

## oplus/sensor/kernel/oplus_virtual_sensor/sensors/pedo_minutehub/Kconfig
```kconfig
config OPLUS_FEATURE_PEDO_MINUTE
	bool "pedo_minutehub for MediaTek package"
	default n
```

## oplus/sensor/kernel/oplus_virtual_sensor/sensors/pickup_detecthub/Kconfig
```kconfig
config OPLUS_FEATURE_PICKUP_DETECT
	bool "pickup_detecthub for MediaTek package"
	default n
```

## oplus/sensor/kernel/oplus_virtual_sensor/sensors/sensor_monitor/Kconfig
```kconfig
config OPLUS_FEATURE_SENSOR_MONITOR
	tristate "sensor_monitor for MediaTek package"
	help
	  To compile this driver as a module, set M in kernel build config
	  module will be called sensor_monitor.
```

## oplus/sensor/kernel/oplus_virtual_sensor/sensors/tp_gesturehub/Kconfig
```kconfig
config OPLUS_FEATURE_TP_GESTURE
	bool "tp_gesturehub for MediaTek package"
	default n
```

## oplus/sensor/kernel/sensorhub/oplus_sensor_devinfo/Kconfig
```kconfig
config OPLUS_SENSOR_MTK68XX
	bool "for MediaTek 68xx"
	default n
	help
	  It support 68xx.

config OPLUS_FEATURE_SENSOR_DEVINFO_V1
	tristate "for oplus customization"
	default n
	help
	  It support sensor_devinfo.

config OPLUS_FEATURE_SENSOR_DEVINFO_V2
	tristate "for oplus customization"
	default n
	help
	  It support sensor_devinfo.
```

## oplus/sensor/kernel/sensorhub/oplus_sensor_feedback/Kconfig
```kconfig
config OPLUS_SENSOR_FB_MTK
	tristate "sensor feedback config for qcom"
	help
	  To compile this driver as a module, set M in kernel build config
	  module will be called sensor_feedback.
```
